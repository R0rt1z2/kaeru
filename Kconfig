## configs/huawei/dura2_defconfig
```kconfig
CONFIG_APP_ADDRESS=0x48035280
CONFIG_BOOTLOADER_BASE=0x48000000
CONFIG_BOOTLOADER_SIZE=0x1B06DC
CONFIG_BOOTMODE_ADDRESS=0x481B3D9C
CONFIG_DPRINTF_ADDRESS=0x48061868
CONFIG_FASTBOOT_FAIL_ADDRESS=0x48035A5C
CONFIG_FASTBOOT_INFO_ADDRESS=0x48035A00
CONFIG_FASTBOOT_OKAY_ADDRESS=0x48035BD4
CONFIG_FASTBOOT_PUBLISH_ADDRESS=0x4803575C
CONFIG_FASTBOOT_REGISTER_ADDRESS=0x48035720
CONFIG_FREE_ADDRESS=0x48062A2C
CONFIG_HUAWEI_DURA2=y
CONFIG_INIT_STORAGE_ADDRESS=0x4800C03C
CONFIG_INIT_STORAGE_CALLER=0x4800C236
CONFIG_LK_LOG_STORE_ADDRESS=0x48076A10
CONFIG_MALLOC_ADDRESS=0x48063388
CONFIG_MEDIATEK_MT6762=y
CONFIG_MTK_DETECT_KEY_ADDRESS=0x4800E15C
CONFIG_PARTITION_GET_SIZE_BY_NAME_ADDRESS=0x4807D36C
CONFIG_PARTITION_READ_ADDRESS=0x4807EE24
CONFIG_PLATFORM_INIT_ADDRESS=0x4800C204
CONFIG_PLATFORM_INIT_CALLER=0x4802C390
CONFIG_STAGE1_SUPPORT=y
CONFIG_THREAD_CREATE_ADDRESS=0x4802C71C
CONFIG_THREAD_RESUME_ADDRESS=0x4802C8B0
CONFIG_VIDEO_PRINTF_ADDRESS=0x48061190
```

## configs/huawei/kansas_defconfig
```kconfig
CONFIG_APP_ADDRESS=0x48028C78
CONFIG_APP_CALLER=0x48024AF4
CONFIG_BOOTLOADER_BASE=0x48000000
CONFIG_BOOTLOADER_SIZE=0x16FA94
CONFIG_FASTBOOT_FAIL_ADDRESS=0x48029C58
CONFIG_FASTBOOT_INFO_ADDRESS=0x48029BFC
CONFIG_FASTBOOT_OKAY_ADDRESS=0x48029DD0
CONFIG_FASTBOOT_PUBLISH_ADDRESS=0x48029958
CONFIG_FASTBOOT_REGISTER_ADDRESS=0x4802991C
CONFIG_LK_LOG_STORE_ADDRESS=0x480470CA
CONFIG_MTK_DETECT_KEY_ADDRESS=0x4800942C
CONFIG_PLATFORM_INIT_ADDRESS=0x48007A80
CONFIG_PLATFORM_INIT_CALLER=0x48023BBC
CONFIG_VIDEO_PRINTF_ADDRESS=0x480347F0
CONFIG_HUAWEI_KANSAS=y
CONFIG_MEDIATEK_MT6761=y
CONFIG_BOOTMODE_ADDRESS=0x48172BBC
```

## configs/huawei/kobe2lte_defconfig
```kconfig
CONFIG_APP_ADDRESS=0x4803370C
CONFIG_APP_CALLER=0x4802B8B0
CONFIG_BOOTLOADER_BASE=0x48000000
CONFIG_BOOTLOADER_SIZE=0x198B4C
CONFIG_BOOTMODE_ADDRESS=0x4819C004
CONFIG_FASTBOOT_FAIL_ADDRESS=0x48033EE4
CONFIG_FASTBOOT_INFO_ADDRESS=0x48033E88
CONFIG_FASTBOOT_OKAY_ADDRESS=0x4803405C
CONFIG_FASTBOOT_PUBLISH_ADDRESS=0x48033BE4
CONFIG_FASTBOOT_REGISTER_ADDRESS=0x48033BA8
CONFIG_LK_LOG_STORE_ADDRESS=0x480746A4
CONFIG_MTK_DETECT_KEY_ADDRESS=0x48011588
CONFIG_PLATFORM_INIT_ADDRESS=0x4800F630
CONFIG_PLATFORM_INIT_CALLER=0x4802A974
CONFIG_VIDEO_PRINTF_ADDRESS=0x4805EED4
CONFIG_HUAWEI_KOBE2LTE=y
CONFIG_MEDIATEK_MT6765=y
```
