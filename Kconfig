## Kconfig
```kconfig
mainmenu "Kaeru Configuration"

source "soc/Kconfig"
source "board/Kconfig"
source "drivers/Kconfig"
source "lib/Kconfig"
source "stage1/Kconfig"
```

## arch/Kconfig
```kconfig
menu "Architecture"
	config CACHE_LINE
		int "The CPU cache line"
        default 64
		help
		  Size of a CPU cache line in bytes. Used for cache
		  maintenance operations. Common values are 32 for
		  Cortex-A7/A9 and 64 for Cortex-A15/A53/A55.
endmenu
```

## configs/5028y_defconfig
```kconfig
CONFIG_APP_ADDRESS=0x480230D0
CONFIG_APP_CALLER=0x48020290
CONFIG_BOOTLOADER_BASE=0x48000000
CONFIG_BOOTLOADER_SIZE=0x12247C
CONFIG_BOOTMODE_ADDRESS=0x481255E0
CONFIG_FASTBOOT_FAIL_ADDRESS=0x480244F4
CONFIG_FASTBOOT_INFO_ADDRESS=0x48024498
CONFIG_FASTBOOT_OKAY_ADDRESS=0x480246C0
CONFIG_FASTBOOT_PUBLISH_ADDRESS=0x480241A4
CONFIG_FASTBOOT_REGISTER_ADDRESS=0x48024168
CONFIG_LK_LOG_STORE_ADDRESS=0x480406A0
CONFIG_MTK_DETECT_KEY_ADDRESS=0x48004B14
CONFIG_PLATFORM_INIT_ADDRESS=0x48002954
CONFIG_PLATFORM_INIT_CALLER=0x4801EB58
CONFIG_VIDEO_PRINTF_ADDRESS=0x4802F10C
CONFIG_ALCATEL_5028Y=y
CONFIG_MEDIATEK_MT6765=y
```

## configs/X666_defconfig
```kconfig
CONFIG_APP_ADDRESS=0x4822DCC4
CONFIG_APP_CALLER=0x4822B278
CONFIG_BOOTLOADER_BASE=0x48200000
CONFIG_BOOTLOADER_SIZE=0xF2A34
CONFIG_BOOTMODE_ADDRESS=0x482F5598
CONFIG_FASTBOOT_FAIL_ADDRESS=0x4822E67C
CONFIG_FASTBOOT_INFO_ADDRESS=0x4822E5D4
CONFIG_FASTBOOT_OKAY_ADDRESS=0x4822E858
CONFIG_FASTBOOT_PUBLISH_ADDRESS=0x4822E260
CONFIG_FASTBOOT_REGISTER_ADDRESS=0x4822E224
CONFIG_LK_LOG_STORE_ADDRESS=0x4824F66C
CONFIG_MTK_DETECT_KEY_ADDRESS=0x48204614
CONFIG_PLATFORM_INIT_ADDRESS=0x482026B0
CONFIG_PLATFORM_INIT_CALLER=0x48229B62
CONFIG_VIDEO_PRINTF_ADDRESS=0x4823AE90
CONFIG_INFINIX_X666=y
CONFIG_MEDIATEK_MT6833=y
```

## configs/a5s_defconfig
```kconfig
CONFIG_APP_ADDRESS=0x6002BBB0
CONFIG_APP_CALLER=0x60028D80
CONFIG_BOOTLOADER_BASE=0x60000000
CONFIG_BOOTLOADER_SIZE=0x2514A4
CONFIG_BOOTMODE_ADDRESS=0x602545E4
CONFIG_FASTBOOT_FAIL_ADDRESS=0x6002CA24
CONFIG_FASTBOOT_INFO_ADDRESS=0x6002C9D8
CONFIG_FASTBOOT_OKAY_ADDRESS=0x6002CBF0
CONFIG_FASTBOOT_PUBLISH_ADDRESS=0x6002C738
CONFIG_FASTBOOT_REGISTER_ADDRESS=0x6002C6FC
CONFIG_LK_LOG_STORE_ADDRESS=0x60000AC8
CONFIG_PLATFORM_INIT_ADDRESS=0x60002C8C
CONFIG_PLATFORM_INIT_CALLER=0x60027904
CONFIG_VIDEO_PRINTF_ADDRESS=0x60033EE0
CONFIG_MTK_DETECT_KEY_ADDRESS=0x60005C00
CONFIG_OPPO_A5S=y
CONFIG_MEDIATEK_MT6765=y
```

## configs/amazon/checkers_defconfig
```kconfig
CONFIG_APP_CALLER=0x4BD27048
CONFIG_APP_ADDRESS=0x4BD2811C
CONFIG_BOOTLOADER_BASE=0x4BD00000
CONFIG_BOOTLOADER_SIZE=0x5C3B4
CONFIG_BOOTMODE_ADDRESS=0x4BD66504
CONFIG_FASTBOOT_FAIL_ADDRESS=0x4BD28884
CONFIG_FASTBOOT_INFO_ADDRESS=0x4BD28848
CONFIG_FASTBOOT_OKAY_ADDRESS=0x4BD28A2C
CONFIG_FASTBOOT_REGISTER_ADDRESS=0x4BD28658
CONFIG_FASTBOOT_PUBLISH_ADDRESS=0x4BD286E0
CONFIG_LK_LOG_STORE=n
CONFIG_PLATFORM_INIT_ADDRESS=0x4BD12434
CONFIG_PLATFORM_INIT_CALLER=0x4BD26602
CONFIG_AMAZON_CHECKERS=y
CONFIG_MEDIATEK_MT8163=y
CONFIG_MTK_DETECT_KEY_ADDRESS=0x4BD14928
CONFIG_VIDEO_PRINTF_ADDRESS=0x4BD2C2E2
CONFIG_LEGACY_LK=y
CONFIG_STAGE1_SUPPORT=y
CONFIG_INIT_STORAGE_CALLER=0x4bd12454
CONFIG_INIT_STORAGE_ADDRESS=0x4bd249cc
CONFIG_MALLOC_ADDRESS=0x4bd2d0dc
CONFIG_FREE_ADDRESS=0x4bd2c9d0
CONFIG_DPRINTF_ADDRESS=0x4bd2c718
CONFIG_MT_PART_GET_DEVICE_ADDRESS=0x4bd1fdc0
CONFIG_MT_PART_GET_PARTITION_ADDRESS=0x4bd1fd00
```

## configs/amazon/cronos_defconfig
```kconfig
CONFIG_AMAZON_CRONOS=y
CONFIG_APP_ADDRESS=0x4BD28258
CONFIG_APP_CALLER=0x4BD27180
CONFIG_BOOTLOADER_BASE=0x4BD00000
CONFIG_BOOTLOADER_SIZE=0x5C3B4
CONFIG_BOOTLOADER_PARTITION_NAME="swdl"
CONFIG_BOOTMODE_ADDRESS=0x4BD66504
CONFIG_DPRINTF_ADDRESS=0x4BD2C7C0
CONFIG_FASTBOOT_FAIL_ADDRESS=0x4BD289C0
CONFIG_FASTBOOT_INFO_ADDRESS=0x4BD28984
CONFIG_FASTBOOT_OKAY_ADDRESS=0x4BD28B68
CONFIG_FASTBOOT_PUBLISH_ADDRESS=0x4BD2881C
CONFIG_FASTBOOT_REGISTER_ADDRESS=0x4BD28794
CONFIG_FREE_ADDRESS=0x4BD2CA78
CONFIG_INIT_STORAGE_ADDRESS=0x4BD24B04
CONFIG_INIT_STORAGE_CALLER=0x4BD1257C
CONFIG_LEGACY_LK=y
CONFIG_LK_LOG_STORE=n
CONFIG_MALLOC_ADDRESS=0x4BD2D184
CONFIG_MEDIATEK_MT8163=y
CONFIG_MT_PART_GET_DEVICE_ADDRESS=0x4BD1FEF4
CONFIG_MT_PART_GET_PARTITION_ADDRESS=0x4BD1FE34
CONFIG_MTK_DETECT_KEY_ADDRESS=0x4BD14A50
CONFIG_PLATFORM_INIT_ADDRESS=0x4BD1255C
CONFIG_PLATFORM_INIT_CALLER=0x4BD2673A
CONFIG_STAGE1_SUPPORT=y
CONFIG_VIDEO_PRINTF_ADDRESS=0x4BD2C38A
```

## configs/amazon/crown_defconfig
```kconfig
CONFIG_AMAZON_CROWN=y
CONFIG_APP_ADDRESS=0x4BD27B80
CONFIG_APP_CALLER=0x4BD26AAC
CONFIG_BOOTLOADER_BASE=0x4BD00000
CONFIG_BOOTLOADER_PARTITION_NAME="swdl"
CONFIG_BOOTLOADER_SIZE=0x71BDC
CONFIG_BOOTMODE_ADDRESS=0x4BD7A50C
CONFIG_DPRINTF_ADDRESS=0x4BD2C040
CONFIG_FASTBOOT_FAIL_ADDRESS=0x4BD282E8
CONFIG_FASTBOOT_INFO_ADDRESS=0x4BD282AC
CONFIG_FASTBOOT_OKAY_ADDRESS=0x4BD28490
CONFIG_FASTBOOT_PUBLISH_ADDRESS=0x4BD28144
CONFIG_FASTBOOT_REGISTER_ADDRESS=0x4BD280BC
CONFIG_FREE_ADDRESS=0x4BD2C2F8
CONFIG_INIT_STORAGE_ADDRESS=0x4BD249F4
CONFIG_INIT_STORAGE_CALLER=0x4BD124F8
CONFIG_LEGACY_LK=y
CONFIG_LK_LOG_STORE=n
CONFIG_MALLOC_ADDRESS=0x4BD2CA04
CONFIG_MEDIATEK_MT8163=y
CONFIG_MTK_DETECT_KEY_ADDRESS=0x4BD149B4
CONFIG_PLATFORM_INIT_ADDRESS=0x4BD124D8
CONFIG_PLATFORM_INIT_CALLER=0x4BD26066
CONFIG_STAGE1_SUPPORT=y
CONFIG_THREAD_CREATE_ADDRESS=0x4BD262A0
CONFIG_THREAD_RESUME_ADDRESS=0x4BD26424
CONFIG_THREAD_SUPPORT=y
CONFIG_VIDEO_PRINTF_ADDRESS=0x4BD2BC0A
CONFIG_MT_PART_GET_DEVICE_ADDRESS=0x4BD1FDE4
CONFIG_MT_PART_GET_PARTITION_ADDRESS=0x4BD1FD24
```

## configs/amman_defconfig
```kconfig
CONFIG_APP_ADDRESS=0x4802CA1C
CONFIG_APP_CALLER=0x4802892C
CONFIG_BOOTLOADER_BASE=0x48000000
CONFIG_BOOTLOADER_SIZE=0x174E90
CONFIG_BOOTMODE_ADDRESS=0x48177B7C
CONFIG_FASTBOOT_FAIL_ADDRESS=0x4802D99C
CONFIG_FASTBOOT_INFO_ADDRESS=0x4802D940
CONFIG_FASTBOOT_OKAY_ADDRESS=0x4802DB14
CONFIG_FASTBOOT_PUBLISH_ADDRESS=0x4802D69C
CONFIG_FASTBOOT_REGISTER_ADDRESS=0x4802D660
CONFIG_LK_LOG_STORE_ADDRESS=0x4804AE3E
CONFIG_MTK_DETECT_KEY_ADDRESS=0x48008BA0
CONFIG_PLATFORM_INIT_ADDRESS=0x4800720C
CONFIG_PLATFORM_INIT_CALLER=0x480279F4
CONFIG_VIDEO_PRINTF_ADDRESS=0x480384F4
CONFIG_HUAWEI_AMMAN=y
CONFIG_MEDIATEK_MT6761=y
```

## configs/aquaris_m8_defconfig
```kconfig
CONFIG_APP_ADDRESS=0x41E1CCC8
CONFIG_APP_CALLER=0x41E1B9B4
CONFIG_BOOTLOADER_BASE=0x41E00000
CONFIG_BOOTLOADER_SIZE=0x42418
CONFIG_BOOTMODE_ADDRESS=0x41E44500
CONFIG_FASTBOOT_FAIL_ADDRESS=0x41E1D1D4
CONFIG_FASTBOOT_INFO_ADDRESS=0x41E1D18C
CONFIG_FASTBOOT_OKAY_ADDRESS=0x41E1D37C
CONFIG_FASTBOOT_PUBLISH_ADDRESS=0x41E1CFC0
CONFIG_FASTBOOT_REGISTER_ADDRESS=0x41E1CF8C
CONFIG_LK_LOG_STORE=n
CONFIG_MTK_DETECT_KEY_ADDRESS=0x41E0548C
CONFIG_PLATFORM_INIT_ADDRESS=0x41E02C4C
CONFIG_PLATFORM_INIT_CALLER=0x41E1ADA6
CONFIG_VIDEO_PRINTF_ADDRESS=0x41E20C0C
CONFIG_BQ_AQUARIS_M8=y
CONFIG_MEDIATEK_MT8163=y
```

## configs/blackview/bv9200_defconfig
```kconfig
CONFIG_APP_ADDRESS=0x4C427F28
CONFIG_BOOTLOADER_BASE=0x4C400000
CONFIG_BOOTLOADER_SIZE=0x111FCC
CONFIG_BOOTMODE_ADDRESS=0x4C514594
CONFIG_FASTBOOT_FAIL_ADDRESS=0x4C428928
CONFIG_FASTBOOT_INFO_ADDRESS=0x4C4288A8
CONFIG_FASTBOOT_OKAY_ADDRESS=0x4C428AF4
CONFIG_FASTBOOT_PUBLISH_ADDRESS=0x4C428534
CONFIG_FASTBOOT_REGISTER_ADDRESS=0x4C4284F8
CONFIG_LK_LOG_STORE_ADDRESS=0x4C449C3C
CONFIG_MTK_DETECT_KEY_ADDRESS=0x4C40442C
CONFIG_PLATFORM_INIT_ADDRESS=0x4C40294C
CONFIG_PLATFORM_INIT_CALLER=0x4C424108
CONFIG_VIDEO_PRINTF_ADDRESS=0x4C434EB8
CONFIG_BLACKVIEW_BV9200=y
CONFIG_MEDIATEK_MT6781=y
```

## configs/bq/aquaris_m8_defconfig
```kconfig
CONFIG_APP_ADDRESS=0x41E1CCC8
CONFIG_APP_CALLER=0x41E1B9B4
CONFIG_BOOTLOADER_BASE=0x41E00000
CONFIG_BOOTLOADER_SIZE=0x42418
CONFIG_BOOTMODE_ADDRESS=0x41E44500
CONFIG_BQ_AQUARIS_M8=y
CONFIG_DPRINTF_ADDRESS=0x41E20E70
CONFIG_FASTBOOT_FAIL_ADDRESS=0x41E1D1D4
CONFIG_FASTBOOT_INFO_ADDRESS=0x41E1D18C
CONFIG_FASTBOOT_OKAY_ADDRESS=0x41E1D37C
CONFIG_FASTBOOT_PUBLISH_ADDRESS=0x41E1CFC0
CONFIG_FASTBOOT_REGISTER_ADDRESS=0x41E1CF8C
CONFIG_FREE_ADDRESS=0x41E21194
CONFIG_INIT_STORAGE_ADDRESS=0x41E19034
CONFIG_INIT_STORAGE_CALLER=0x41E02C6C
CONFIG_LEGACY_LK=y
CONFIG_LK_LOG_STORE=n
CONFIG_MALLOC_ADDRESS=0x41E21A20
CONFIG_MEDIATEK_MT8163=y
CONFIG_MT_PART_GET_DEVICE_ADDRESS=0x41E14050
CONFIG_MT_PART_GET_PARTITION_ADDRESS=0x41E13EFC
CONFIG_MTK_DETECT_KEY_ADDRESS=0x41E0548C
CONFIG_PLATFORM_INIT_ADDRESS=0x41E02C4C
CONFIG_PLATFORM_INIT_CALLER=0x41E1ADA6
CONFIG_STAGE1_SUPPORT=y
CONFIG_VIDEO_PRINTF_ADDRESS=0x41E20C0C
```

## configs/bq/brolly_defconfig
```kconfig
CONFIG_APP_ADDRESS=0x81E1AF94
CONFIG_BOOTLOADER_BASE=0x81E00000
CONFIG_BOOTLOADER_SIZE=0x39B44
CONFIG_BOOTMODE_ADDRESS=0x81E3C4D8
CONFIG_FASTBOOT_FAIL_ADDRESS=0x81E1B3A4
CONFIG_FASTBOOT_INFO_ADDRESS=0x81E1B35C
CONFIG_FASTBOOT_OKAY_ADDRESS=0x81E1B52C
CONFIG_FASTBOOT_PUBLISH_ADDRESS=0x81E1B16C
CONFIG_FASTBOOT_REGISTER_ADDRESS=0x81E1B12C
CONFIG_LK_LOG_STORE=n
CONFIG_PLATFORM_INIT_ADDRESS=0x81E00588
CONFIG_PLATFORM_INIT_CALLER=0x81E199EA
CONFIG_BQ_BROLLY=y
CONFIG_MEDIATEK_MT8127=y
CONFIG_MTK_DETECT_KEY_ADDRESS=0x81E06B8C
CONFIG_VIDEO_PRINTF_ADDRESS=0x81E1D3F0
```

## configs/bq/freezerhd_defconfig
```kconfig
CONFIG_APP_ADDRESS=0x5601E0C0
CONFIG_BOOTLOADER_BASE=0x56000000
CONFIG_BOOTLOADER_SIZE=0x486BC
CONFIG_BOOTMODE_ADDRESS=0x5604E100
CONFIG_BQ_FREEZERHD=y
CONFIG_FASTBOOT_FAIL_ADDRESS=0x5601E9B0
CONFIG_FASTBOOT_INFO_ADDRESS=0x5601E968
CONFIG_FASTBOOT_OKAY_ADDRESS=0x5601EB7C
CONFIG_FASTBOOT_PUBLISH_ADDRESS=0x5601E79C
CONFIG_FASTBOOT_REGISTER_ADDRESS=0x5601E760
CONFIG_LK_LOG_STORE=n
CONFIG_MEDIATEK_MT8163=y
CONFIG_MTK_DETECT_KEY_ADDRESS=0x56005538
CONFIG_PLATFORM_INIT_ADDRESS=0x56002CA8
CONFIG_PLATFORM_INIT_CALLER=0x5601B460
CONFIG_VIDEO_PRINTF_ADDRESS=0x56022CAC
```

## configs/bq/kaito_defconfig
```kconfig
CONFIG_STAGE1_SUPPORT=y
CONFIG_LEGACY_LK=y
CONFIG_USE_PMT_PARTITION=y
CONFIG_BOOTLOADER_BASE=0x81E00000
CONFIG_BOOTLOADER_SIZE=0x39DDC
CONFIG_BOOTLOADER_PARTITION_NAME="UBOOT"
CONFIG_MEDIATEK_MT6592=y
CONFIG_BQ_KAITO=y
CONFIG_LK_LOG_STORE=n
CONFIG_APP_ADDRESS=0x81E19B30
CONFIG_BOOTMODE_ADDRESS=0x81E3C438
CONFIG_DPRINTF_ADDRESS=0x81E1CDB4
CONFIG_FASTBOOT_FAIL_ADDRESS=0x81E19EE8
CONFIG_FASTBOOT_INFO_ADDRESS=0x81E19EA4
CONFIG_FASTBOOT_OKAY_ADDRESS=0x81E1A080
CONFIG_FASTBOOT_PUBLISH_ADDRESS=0x81E19CF0
CONFIG_FASTBOOT_REGISTER_ADDRESS=0x81E19CB0
CONFIG_FREE_ADDRESS=0x81E1D0B4
CONFIG_INIT_STORAGE_ADDRESS=0x81E04DD0
CONFIG_INIT_STORAGE_CALLER=0x81E00446
CONFIG_MALLOC_ADDRESS=0x81E1D9C8
CONFIG_MT_PART_GET_DEVICE_ADDRESS=0x81E0322C
CONFIG_MTK_DETECT_KEY_ADDRESS=0x81E0A0D8
CONFIG_PLATFORM_INIT_ADDRESS=0x81E00428
CONFIG_PLATFORM_INIT_CALLER=0x81E1868A
CONFIG_VIDEO_PRINTF_ADDRESS=0x81E1C2CC
CONFIG_MT_PART_GET_PARTITION_ADDRESS=0x81e03060
```

## configs/energy/adad_defconfig
```kconfig
CONFIG_APP_ADDRESS=0x4601E388
CONFIG_BOOTLOADER_BASE=0x46000000
CONFIG_BOOTLOADER_SIZE=0x700A8
CONFIG_BOOTMODE_ADDRESS=0x46086500
CONFIG_FASTBOOT_FAIL_ADDRESS=0x4601E818
CONFIG_FASTBOOT_INFO_ADDRESS=0x4601E7D0
CONFIG_FASTBOOT_OKAY_ADDRESS=0x4601E9E4
CONFIG_FASTBOOT_PUBLISH_ADDRESS=0x4601E62C
CONFIG_FASTBOOT_REGISTER_ADDRESS=0x4601E5F0
CONFIG_LK_LOG_STORE=n
CONFIG_PLATFORM_INIT_ADDRESS=0x460016B8
CONFIG_PLATFORM_INIT_CALLER=0x4601BE9A
CONFIG_VIDEO_PRINTF_ADDRESS=0x46023084
CONFIG_ENERGY_ADAD=y
CONFIG_MEDIATEK_MT6750=y
CONFIG_LEGACY_LK=y
CONFIG_STAGE1_SUPPORT=y
CONFIG_MTK_DETECT_KEY_ADDRESS=0x46003EF0
CONFIG_FREE_ADDRESS=0x4602361C
CONFIG_MALLOC_ADDRESS=0x46023E78
CONFIG_DPRINTF_ADDRESS=0x460232F0
CONFIG_INIT_STORAGE_ADDRESS=0x46005080
CONFIG_INIT_STORAGE_CALLER=0x460016B8
CONFIG_MT_PART_GET_DEVICE_ADDRESS=0x4601AF18
CONFIG_MT_PART_GET_PARTITION_ADDRESS=0x46003AAC
```

## configs/energy/phone_colors_defconfig
```kconfig
CONFIG_STAGE1_SUPPORT=y
CONFIG_LEGACY_LK=y
CONFIG_USE_PMT_PARTITION=y
CONFIG_BOOTLOADER_BASE=0x80020000
CONFIG_BOOTLOADER_SIZE=0x453CC
CONFIG_BOOTLOADER_PARTITION_NAME="UBOOT"
CONFIG_MEDIATEK_MT6572=y
CONFIG_ENERGY_PHONE_COLORS=y
CONFIG_LK_LOG_STORE=n
CONFIG_APP_ADDRESS=0x8002DB08
CONFIG_BOOTMODE_ADDRESS=0x80068418
CONFIG_DPRINTF_ADDRESS=0x80030C8C
CONFIG_FASTBOOT_FAIL_ADDRESS=0x8002DE14
CONFIG_FASTBOOT_INFO_ADDRESS=0x8002DDD0
CONFIG_FASTBOOT_OKAY_ADDRESS=0x8002DFAC
CONFIG_FASTBOOT_PUBLISH_ADDRESS=0x8002DC1C
CONFIG_FASTBOOT_REGISTER_ADDRESS=0x8002DBDC
CONFIG_FREE_ADDRESS=0x80030990
CONFIG_INIT_STORAGE_ADDRESS=0x80023278
CONFIG_INIT_STORAGE_CALLER=0x800206A6
CONFIG_MALLOC_ADDRESS=0x800312A4
CONFIG_MT_PART_GET_DEVICE_ADDRESS=0x80022EF0
CONFIG_MT_PART_GET_PARTITION_ADDRESS=0x80022DC0
CONFIG_MTK_DETECT_KEY_ADDRESS=0x80029EF0
CONFIG_PLATFORM_INIT_ADDRESS=0x8002068C
CONFIG_PLATFORM_INIT_CALLER=0x8002C71E
CONFIG_VIDEO_PRINTF_ADDRESS=0x80030444
```

## configs/fogorow_defconfig
```kconfig
CONFIG_APP_ADDRESS=0x4C42A0DC
CONFIG_APP_CALLER=0x4C42794C
CONFIG_BOOTLOADER_BASE=0x4C400000
CONFIG_BOOTLOADER_SIZE=0x121314
CONFIG_FASTBOOT_FAIL_ADDRESS=0x4C42AB7C
CONFIG_FASTBOOT_INFO_ADDRESS=0x4C42AAFC
CONFIG_FASTBOOT_OKAY_ADDRESS=0x4C42AD48
CONFIG_FASTBOOT_PUBLISH_ADDRESS=0x4C42A788
CONFIG_FASTBOOT_REGISTER_ADDRESS=0x4C42A74C
CONFIG_MEDIATEK_MT6768=y
CONFIG_MOTOROLA_FOGOROW=y
CONFIG_PLATFORM_INIT_ADDRESS=0x4C4039B4
CONFIG_PLATFORM_INIT_CALLER=0x4C4262A8
CONFIG_VIDEO_PRINTF_ADDRESS=0x4C43BF60
```

## configs/fplus/t1100_defconfig
```kconfig
CONFIG_APP_ADDRESS=0x56024ED0
CONFIG_APP_CALLER=0x56022898
CONFIG_BOOTLOADER_BASE=0x56000000
CONFIG_BOOTLOADER_SIZE=0xB0658
CONFIG_BOOTMODE_ADDRESS=0x560B352C
CONFIG_FASTBOOT_FAIL_ADDRESS=0x56025870
CONFIG_FASTBOOT_INFO_ADDRESS=0x560257F0
CONFIG_FASTBOOT_OKAY_ADDRESS=0x56025A3C
CONFIG_FASTBOOT_PUBLISH_ADDRESS=0x5602547C
CONFIG_FASTBOOT_REGISTER_ADDRESS=0x56025440
CONFIG_LK_LOG_STORE_ADDRESS=0x5603FDF8
CONFIG_FPLUS_T1100=y
CONFIG_MEDIATEK_MT6771=y
CONFIG_MTK_DETECT_KEY_ADDRESS=0x56004588
CONFIG_PLATFORM_INIT_ADDRESS=0x56002D10
CONFIG_PLATFORM_INIT_CALLER=0x560211F4
CONFIG_VIDEO_PRINTF_ADDRESS=0x560302B4
```

## configs/honor/cartier5g_defconfig
```kconfig
CONFIG_APP_ADDRESS=0x4824B49C
CONFIG_BOOTMODE_ADDRESS=0x4840C30C
CONFIG_BOOTLOADER_BASE=0x48200000
CONFIG_BOOTLOADER_SIZE=0x208C9C
CONFIG_FASTBOOT_FAIL_ADDRESS=0x4824BE8C
CONFIG_FASTBOOT_INFO_ADDRESS=0x4824BE0C
CONFIG_FASTBOOT_OKAY_ADDRESS=0x4824C008
CONFIG_FASTBOOT_PUBLISH_ADDRESS=0x4824BA24
CONFIG_FASTBOOT_REGISTER_ADDRESS=0x4824B9E8
CONFIG_LK_LOG_STORE_ADDRESS=0x4827CB04
CONFIG_VIDEO_PRINTF_ADDRESS=0x48260434
CONFIG_HONOR_CARTIER5G=y
CONFIG_MEDIATEK_MT6833=y
CONFIG_MTK_DETECT_KEY_ADDRESS=0x48215C60
CONFIG_PLATFORM_INIT_ADDRESS=0x482140A4
CONFIG_PLATFORM_INIT_CALLER=0x4824087A
```

## configs/honor/gina_defconfig
```kconfig
CONFIG_APP_ADDRESS=0x4824C4FC
CONFIG_BOOTLOADER_BASE=0x48200000
CONFIG_BOOTLOADER_SIZE=0x244CA0
CONFIG_BOOTMODE_ADDRESS=0x48448330
CONFIG_DPRINTF_ADDRESS=0x48260928
CONFIG_FASTBOOT_FAIL_ADDRESS=0x4824CE30
CONFIG_FASTBOOT_INFO_ADDRESS=0x4824CDB0
CONFIG_FASTBOOT_OKAY_ADDRESS=0x4824CFA8
CONFIG_FASTBOOT_PUBLISH_ADDRESS=0x4824C9C8
CONFIG_FASTBOOT_REGISTER_ADDRESS=0x4824C98C
CONFIG_FREE_ADDRESS=0x48261DF8
CONFIG_HONOR_GINA=y
CONFIG_INIT_STORAGE_ADDRESS=0x48214704
CONFIG_INIT_STORAGE_CALLER=0x4821481C
CONFIG_LK_LOG_STORE_ADDRESS=0x4827B6A8
CONFIG_MALLOC_ADDRESS=0x482627F0
CONFIG_MEDIATEK_MT6877=y
CONFIG_MTK_DETECT_KEY_ADDRESS=0x48216334
CONFIG_PARTITION_GET_SIZE_BY_NAME_ADDRESS=0x48283FC4
CONFIG_PARTITION_READ_ADDRESS=0x48285A58
CONFIG_PLATFORM_INIT_ADDRESS=0x482147E8
CONFIG_PLATFORM_INIT_CALLER=0x482416D6
CONFIG_STAGE1_SUPPORT=y
CONFIG_VIDEO_PRINTF_ADDRESS=0x4825FE94
```

## configs/honor/kingkong_defconfig
```kconfig
CONFIG_APP_ADDRESS=0x4824A188
CONFIG_BOOTMODE_ADDRESS=0x4843A320
CONFIG_BOOTLOADER_BASE=0x48200000
CONFIG_BOOTLOADER_SIZE=0x236D84
CONFIG_FASTBOOT_FAIL_ADDRESS=0x4824AAB0
CONFIG_FASTBOOT_INFO_ADDRESS=0x4824AA30
CONFIG_FASTBOOT_OKAY_ADDRESS=0x4824AC28
CONFIG_FASTBOOT_PUBLISH_ADDRESS=0x4824A6BC
CONFIG_FASTBOOT_REGISTER_ADDRESS=0x4824A680
CONFIG_LK_LOG_STORE_ADDRESS=0x48292344
CONFIG_VIDEO_PRINTF_ADDRESS=0x482788B0
CONFIG_HONOR_KINGKONG=y
CONFIG_MTK_DETECT_KEY_ADDRESS=0x48216C10
CONFIG_MEDIATEK_MT6877=y
CONFIG_PLATFORM_INIT_ADDRESS=0x48214EB4
CONFIG_PLATFORM_INIT_CALLER=0x4823F5E6
```
