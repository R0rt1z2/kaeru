## board/Kconfig
```kconfig
menu "Device Support"

source "board/amazon/Kconfig"
source "board/bq/Kconfig"
source "board/digit/Kconfig"
source "board/energy/Kconfig"
source "board/honor/Kconfig"
source "board/huawei/Kconfig"
source "board/infinix/Kconfig"
source "board/lenovo/Kconfig"
source "board/lg/Kconfig"
source "board/meizu/Kconfig"
source "board/motorola/Kconfig"
source "board/nokia/Kconfig"
source "board/nuu/Kconfig"
source "board/oppo/Kconfig"
source "board/oukitel/Kconfig"
source "board/realme/Kconfig"
source "board/samsung/Kconfig"
source "board/sony/Kconfig"
source "board/tdtech/Kconfig"
source "board/tecno/Kconfig"
source "board/vivo/Kconfig"
source "board/xiaomi/Kconfig"

endmenu
```

## board/acer/Kconfig
```kconfig
config ACER_T482L
    bool "Support Acer One 8 T4-82L"
    default n
    help
      Say Y if you want to include support for Acer One 8 T4-82L
```

## board/amazon/Kconfig
```kconfig
config AMAZON_MT8163_COMMON
    bool
    help
      Select this if you need to include common board code
      for Amazon MT8163 devices.

config AMAZON_MT8163_AB
    bool
    select AMAZON_MT8163_COMMON
    select AMZN_BCB_SUPPORT
    help
      Select this if you need to include slot handling for
      A/B Amazon MT8163 devices.

config AMAZON_BISCUIT
    bool "Support Echo Dot 2nd Gen (2016)"
    select AMAZON_MT8163_AB
    default n
    help
      Say Y if you want to include support for Echo Dot 2nd Gen (2016)

config AMAZON_RADAR
    bool "Support Echo 2nd Gen (2017)"
    select AMAZON_MT8163_AB
    default n
    help
      Say Y if you want to include support for Echo 2nd Gen (2017)

config AMAZON_CROWN
    bool "Support Echo Show 8 1st Gen (2019)"
    select AMAZON_MT8163_COMMON
    default n
    help
      Say Y if you want to include support for Echo Show 8 1st Gen (2019)

config AMAZON_CHECKERS
    bool "Support Echo Show 5 1st Gen (2019)"
    select AMAZON_MT8163_COMMON
    default n
    help
      Say Y if you want to include support for Echo Show 5 1st Gen (2019)

config AMAZON_CRONOS
    bool "Support Echo Show 5 2nd Gen (2021)"
    select AMAZON_MT8163_COMMON
    default n
    help
      Say Y if you want to include support for Echo Show 5 2nd Gen (2021)

config AMAZON_MT8516_COMMON
    bool
    select AMZN_BCB_SUPPORT
    help
      Select this if you need to include common board code
      for Amazon MT8516 devices.

config AMAZON_CUPCAKE
    bool "Support Echo Input"
    select AMAZON_MT8516_COMMON
    default n
    help
      Say Y if you want to include support for Echo Input

config AMAZON_MAVERICK
    bool "Support Fire HD 10 (2019)"
    default n
    help
      Say Y if you want to include support for Fire HD 10 (2019)

config AMAZON_DONUT
    bool "Support Echo Dot 3rd Generation"
    select AMAZON_MT8516_COMMON
    default n
    help
      Say Y if you want to include support for Echo Dot 3rd Generation

config AMAZON_DOUGLAS
    bool "Support Fire HD 8 (2017)"
    default n
    help
      Say Y if you want to include support for Fire HD 8 (2017)

config AMAZON_ROOK
    bool "Support Echo Spot 1st Gen (2017)"
    default n
    help
      Say Y if you want to include support for Echo Spot 1st Gen (2017)

config AMAZON_KARAT
    bool "Support Fire TV Stick 4K / 4K Max / 4K Plus (2nd Gen)"
    default n
    help
      Say Y if you want to include support for Fire TV Stick 4K / 4K Max / 4K Plus (2nd Gen)

config AMAZON_SUNSTONE
    bool "Support Fire Max 11 (2023)"
    default n
    help
      Say Y if you want to include support for Fire Max 11 (2023)

config AMAZON_MT8127_COMMON
    bool
    help
      Select this if you need to include common board code
      for Amazon MT8127 devices.

config AMAZON_AUSTIN
    bool "Support Fire 7 (7th Gen)"
    select AMAZON_MT8127_COMMON
    default n
    help
      Say Y if you want to include support for Fire 7 (2017)

config AMAZON_FORD
    bool "Support Fire (ford)"
    select AMAZON_MT8127_COMMON
    default n
    help
      Say Y if you want to include support for Fire (2015)
```

## board/bq/Kconfig
```kconfig
config BQ_AQUARIS_M8
    bool "Support BQ Aquaris M8"
    default n
    help
      Say Y if you want to include support for BQ Aquaris M8

config BQ_KAITO
    bool "Support BQ Aquaris E10 3G"
    default n
    help
      Say Y if you want to include support for BQ Aquaris E10 3G
```

## board/cubot/Kconfig
```kconfig
config CUBOT_MARLON
    bool "Support CUBOT Marlon (P50 EEA)"
    default n
    help
      Say Y if you want to include support for CUBOT Marlon / P50 EEA (board: v956, MT6765)
```

## board/digit/Kconfig
```kconfig
config DIGIT_NEXT_ULTRA
    bool "Support Digit Next Ultra"
    default n
    help
      Say Y if you want to include support for Digit Next Ultra
```

## board/energy/Kconfig
```kconfig
config ENERGY_PHONE_COLORS
    bool "Support Energy Phone Colors"
    default n
    help
      Say Y if you want to include support for Energy Phone Colors

config ENERGY_ADAD
    bool "Support Energy Phone Pro 3"
    default n
    help
      Say Y if you want to include support for Energy Phone Pro 3
```

## board/honor/Kconfig
```kconfig
config HONOR_GINA
    bool "Support Honor 60 SE"
    default n
    help
      Say Y if you want to include support for Honor 60 SE
```

## board/huawei/Kconfig
```kconfig
config HUAWEI_DURA
    bool "Support Huawei Y5 Prime 2018"
    default n
    help
      Say Y if you want to include support for Huawei Y5 Prime 2018

config HUAWEI_MAYA
    bool "Support Huawei Y5/Y6 2017"
    default n
    help
      Say Y if you want to include support for Huawei Y5/Y6 2017

config HUAWEI_DURA2
    bool "Support Huawei Y5p"
    default n
    help
      Say Y if you want to include support for Huawei Y5p
```

## board/infinix/Kconfig
```kconfig
config INFINIX_X670
    bool "Support NOTE 12"
    default n
    help
      Say Y if you want to include support for NOTE 12
```

## board/lenovo/Kconfig
```kconfig
config LENOVO_AMAR_ROW_LTE
    bool "Support Lenovo Tab M10HD (2nd Gen) LTE"
    default n
    help
      Say Y if you want to include support for Lenovo Tab M10HD (2nd Gen) LTE
```

## board/lg/Kconfig
```kconfig
config LG_MCAYMANLM
    bool "Support LG Velvet 5G"
    default n
    help
      Say Y if you want to include support for LG Velvet 5G
```

## board/lge/Kconfig
```kconfig
config LGE_W7
    bool "Support K40s"
    default n
    help
      Say Y if you want to include support for K40s
```

## board/meizu/Kconfig
```kconfig
config MEIZU_M711H
    bool "Support Meizu M6"
    default n
    help
      Say Y if you want to include support for Meizu M6

config MEIZU_MX6
    bool "Support Meizu MX6"
    default n
    help
      Say Y if you want to include support for Meizu MX6
```

## board/motorola/Kconfig
```kconfig
config MOTOROLA_PENANGF
    bool "Support Motorola G13 / G23"
    default n
    help
      Say Y if you want to include support for Motorola G13 / G23

config MOTOROLA_FOGOROW
    bool "Support Motorola G24"
    default n
    help
      Say Y if you want to include support for Motorola G24

config MOTOROLA_LAMU
    bool "Support Motorola G15 / G05"
    default n
    help
      Say Y if you want to include support for Motorola G15 / G05

config MOTOROLA_LAMULG
    bool "Support Motorola E15"
    default n
    help
      Say Y if you want to include support for Motorola E15

config MOTOROLA_BORAGO
    bool "Support Motorola E22i"
    default n
    help
      Say Y if you want to include support for Motorola E22i

config MOTOROLA_LAGOS
    bool "Support Motorola G06"
    default n
    help
      Say Y if you want to include support for Motorola G06

config MOTOROLA_LAMUC
    bool "Support Motorola G17 / G17 Power"
    default n
    help
      Say Y if you want to include support for Motorola G17 / G17 Power

config MOTOROLA_HAWAIIP
    bool "Support Motorola G22"
    default n
    help
      Say Y if you want to include support for Motorola G22

config MOTOROLA_ELLIS
    bool "Support Motorola Moto G Pure 2021"
    select MEDIATEK_MT6765
    default n
    help
      Say Y if you want to include support for Motorola Moto G Pure 2021
```

## board/nokia/Kconfig
```kconfig
config NOKIA_WASP
    bool "Support Nokia 2.2"
    default n
    help
      Say Y if you want to include support for Nokia 2.2
```

## board/nuu/Kconfig
```kconfig
config NUU_NUU_A1
    bool "Support NUU A1"
    default n
    help
      Say Y if you want to include support for NUU A1

config NUU_N5004LA
    bool "Support OmniPod 5 PDM"
    default n
    help
      Say Y if you want to include support for OmniPod 5 PDM
```

## board/oppo/Kconfig
```kconfig
config OPPO_LEADE
    bool "Support Oppo A5s"
    default n
    help
      Say Y if you want to include support for Oppo A5s

config OPPO_CPH2015
    bool "Support OPPO A31"
    default n
    help
      Say Y if you want to include support for oppo A31

config OPPO_CPH2185
    bool "Support OPPO A15/A15s"
    default n
    help
      Say Y if you want to include support for oppo A15/A15s
```

## board/oukitel/Kconfig
```kconfig
config OUKITEL_WP56
    bool "Support Oukitel WP56"
    default n
    help
      Say Y if you want to include support for Oukitel WP56
```

## board/realme/Kconfig
```kconfig
config REALME_RMX2156
    bool "Support Realme Narzo 30 4G"
    default n
    help
      Say Y if you want to include support for Realme Narzo 30 4G

config REALME_EVEN
    bool "Support realme C25/s/Narzo 50A"
    default n
    help
      Say Y if you want to include support for realme C25/s/Narzo 50A
```

## board/samsung/Kconfig
```kconfig
config SAMSUNG_GTA7LITE
    bool "Support Galaxy Tab A7 Lite"
    default n
    help
      Say Y if you want to include support for Galaxy Tab A7 Lite
```

## board/sony/Kconfig
```kconfig
config SONY_CANOPY
    bool "Support Sony Xperia XA1 / Ultra / Plus"
    default n
    help
      Say Y if you want to include support for Sony Xperia XA1 / Ultra / Plus
```

## board/tdtech/Kconfig
```kconfig
config TDTECH_OCEANT
    bool "Support TD Tech M40"
    default n
    help
      Say Y if you want to include support for TD Tech M40
```

## board/tecno/Kconfig
```kconfig
config TECNO_LH8N
    bool "Support Tecno Pova 5 Pro 5G"
    default n
    help
      Say Y if you want to include support for Tecno Pova 5 Pro 5G
```

## board/vivo/Kconfig
```kconfig
config VIVO_Y7S
    bool "Support Vivo Y7s"
    default n
    help
      Say Y if you want to include support for Vivo Y7s
```
