## configs/amazon/raspite_defconfig
```kconfig
CONFIG_MEDIATEK_MT8169=y
CONFIG_AMAZON_RASPITE=y
CONFIG_BOOTLOADER_BASE=0x4C400000
CONFIG_BOOTLOADER_SIZE=0xEB368
CONFIG_LK_SIGNATURE_SIZE=0x118
CONFIG_BOOTMODE_ADDRESS=0x4C4F54B0
CONFIG_PLATFORM_INIT_ADDRESS=0x4C4105C0
CONFIG_PLATFORM_INIT_CALLER=0x4C426FCE
CONFIG_APP_ADDRESS=0x4C429F64
CONFIG_MTK_DETECT_KEY_ADDRESS=0x4C411BF8
CONFIG_VIDEO_PRINTF_ADDRESS=0x4C432B34
CONFIG_FASTBOOT_FAIL_ADDRESS=0x4C42A6B4
CONFIG_FASTBOOT_INFO_ADDRESS=0x4C42A640
CONFIG_FASTBOOT_OKAY_ADDRESS=0x4C42A83C
CONFIG_FASTBOOT_PUBLISH_ADDRESS=0x4C42A364
CONFIG_FASTBOOT_REGISTER_ADDRESS=0x4C42A328
CONFIG_FASTBOOT_CMDLIST_ADDRESS=0x4C5AA01C
CONFIG_FASTBOOT_FETCH_COMMAND=y
CONFIG_FASTBOOT_USB_WRITE_ADDRESS=0x4C42A4D8
CONFIG_FASTBOOT_GETVAR_ADDRESS=0x4C42BA6C
CONFIG_LK_LOG_STORE=y
CONFIG_LK_LOG_STORE_ADDRESS=0x4C441D88
CONFIG_BOOTLOADER_PARTITION_NAME="lk"
CONFIG_INIT_STORAGE_ADDRESS=0x4C4102F8
CONFIG_INIT_STORAGE_CALLER=0x4C4105EC
CONFIG_MALLOC_ADDRESS=0x4C435118
CONFIG_FREE_ADDRESS=0x4C435146
CONFIG_DPRINTF_ADDRESS=0x4C432E50
CONFIG_PARTITION_READ_ADDRESS=0x4C446630
CONFIG_PARTITION_GET_SIZE_BY_NAME_ADDRESS=0x4C445084
CONFIG_MT_PART_GET_DEVICE_ADDRESS=0x4C452800
CONFIG_STORAGE_SUPPORT=y
CONFIG_IDMELIB_SUPPORT=y
CONFIG_BOOTLOADER_MESSAGE_SUPPORT=y
CONFIG_MISC_PARTITION_NAME="misc"
```

## configs/amazon/rook_defconfig
```kconfig
CONFIG_MEDIATEK_MT8163=y
CONFIG_AMAZON_ROOK=y
CONFIG_THREAD_SUPPORT=y
CONFIG_THREAD_CREATE_ADDRESS=0x4BD37C08
CONFIG_THREAD_RESUME_ADDRESS=0x4BD37DA8
CONFIG_FASTBOOT_FAIL_ADDRESS=0x4BD3A14C
CONFIG_FASTBOOT_INFO_ADDRESS=0x4BD3A104
CONFIG_FASTBOOT_OKAY_ADDRESS=0x4BD3A2FC
CONFIG_FASTBOOT_PUBLISH_ADDRESS=0x4BD39F68
CONFIG_FASTBOOT_REGISTER_ADDRESS=0x4BD39ED4
CONFIG_STORAGE_SUPPORT=y
CONFIG_MT_PART_GET_DEVICE_ADDRESS=0x4BD30888
CONFIG_MT_PART_GET_PARTITION_ADDRESS=0x4BD30720
CONFIG_BOOTLOADER_BASE=0x4BD00000
CONFIG_BOOTLOADER_SIZE=0x708E0
CONFIG_BOOTMODE_ADDRESS=0x4BD78378
CONFIG_PLATFORM_INIT_CALLER=0x4BD379C6
CONFIG_PLATFORM_INIT_ADDRESS=0x4BD20C40
CONFIG_APP_ADDRESS=0x4BD3995C
CONFIG_MTK_DETECT_KEY_ADDRESS=0x4BD23390
CONFIG_VIDEO_PRINTF_ADDRESS=0x4BD3E494
# CONFIG_LK_LOG_STORE is not set
CONFIG_BOOTLOADER_MESSAGE_SUPPORT=y
CONFIG_MISC_PARTITION_NAME="MISC"
CONFIG_LK_SIGNATURE_SIZE=0x104
CONFIG_STAGE1_SUPPORT=y
CONFIG_LEGACY_LK=y
CONFIG_BOOTLOADER_PARTITION_NAME="expdb"
CONFIG_INIT_STORAGE_CALLER=0x4BD20C62
CONFIG_INIT_STORAGE_ADDRESS=0x4BD35A48
CONFIG_MALLOC_ADDRESS=0x4BD3F584
CONFIG_DPRINTF_ADDRESS=0x4BD3E8D0
CONFIG_FREE_ADDRESS=0x4BD3EBD0
```

## configs/amazon/sunstone_defconfig
```kconfig
CONFIG_AMAZON_SUNSTONE=y
CONFIG_MEDIATEK_MT8188=y
CONFIG_BOOTLOADER_BASE=0x56000000
CONFIG_BOOTLOADER_SIZE=0x1C5450
CONFIG_LK_SIGNATURE_SIZE=0x114
CONFIG_APP_ADDRESS=0x56029A74
CONFIG_PLATFORM_INIT_ADDRESS=0x56011724
CONFIG_BOOTMODE_ADDRESS=0x561CF538
CONFIG_MTK_DETECT_KEY_ADDRESS=0x560131B8
CONFIG_PLATFORM_INIT_CALLER=0x56026ADA
CONFIG_VIDEO_PRINTF_ADDRESS=0x560350D4
CONFIG_FASTBOOT_FAIL_ADDRESS=0x5602A1DC
CONFIG_FASTBOOT_INFO_ADDRESS=0x5602a168
CONFIG_FASTBOOT_OKAY_ADDRESS=0x5602A344
CONFIG_FASTBOOT_PUBLISH_ADDRESS=0x56029E8C
CONFIG_FASTBOOT_REGISTER_ADDRESS=0x56029E50
CONFIG_FASTBOOT_CMDLIST_ADDRESS=0x562C001C
CONFIG_LK_LOG_STORE=y
CONFIG_LK_LOG_STORE_ADDRESS=0x560427C8
CONFIG_STAGE1_SUPPORT=y
CONFIG_BOOTLOADER_PARTITION_NAME="lk"
CONFIG_INIT_STORAGE_ADDRESS=0x56011640
CONFIG_INIT_STORAGE_CALLER=0x5601174A
CONFIG_MALLOC_ADDRESS=0x56035EC8
CONFIG_FREE_ADDRESS=0x560357A4
CONFIG_DPRINTF_ADDRESS=0x560353BC
CONFIG_PARTITION_READ_ADDRESS=0x56046FB0
CONFIG_STORAGE_SUPPORT=y
CONFIG_MT_PART_GET_DEVICE_ADDRESS=0x56051F30
CONFIG_IDMELIB_SUPPORT=y
CONFIG_BOOTLOADER_MESSAGE_SUPPORT=y
CONFIG_MISC_PARTITION_NAME="misc"
CONFIG_PARTITION_GET_SIZE_BY_NAME_ADDRESS=0x56045a58
# CONFIG_FORCE_INJECT_ADDR=0x560CE010
```

## configs/amazon/trona_defconfig
```kconfig
CONFIG_MEDIATEK_MT8183=y
CONFIG_AMAZON_TRONA=y
CONFIG_FASTBOOT_CMDLIST_ADDRESS=0x5610A090
CONFIG_FASTBOOT_FAIL_ADDRESS=0x56032B48
CONFIG_FASTBOOT_INFO_ADDRESS=0x56032AF4
CONFIG_FASTBOOT_OKAY_ADDRESS=0x56032CB0
CONFIG_FASTBOOT_PUBLISH_ADDRESS=0x5603288C
CONFIG_FASTBOOT_REGISTER_ADDRESS=0x56032850
CONFIG_FASTBOOT_FETCH_COMMAND=y
CONFIG_FASTBOOT_USB_WRITE_ADDRESS=0x56032970
CONFIG_FASTBOOT_GETVAR_ADDRESS=0x56033B3C
CONFIG_BOOTLOADER_BASE=0x56000000
CONFIG_BOOTLOADER_SIZE=0x96910
CONFIG_BOOTMODE_ADDRESS=0x560A0994
CONFIG_PLATFORM_INIT_CALLER=0x5602E83E
CONFIG_PLATFORM_INIT_ADDRESS=0x56012300
CONFIG_APP_ADDRESS=0x56031EB4
CONFIG_MTK_DETECT_KEY_ADDRESS=0x56014DFC
CONFIG_VIDEO_PRINTF_ADDRESS=0x56038EBC
# CONFIG_LK_LOG_STORE is not set
CONFIG_LK_SIGNATURE_SIZE=0x114
CONFIG_INIT_STORAGE_CALLER=0x5601232C
CONFIG_INIT_STORAGE_ADDRESS=0x56012108
CONFIG_MALLOC_ADDRESS=0x56039C24
CONFIG_DPRINTF_ADDRESS=0x56039170
CONFIG_FREE_ADDRESS=0x560394F0
CONFIG_PARTITION_READ_ADDRESS=0x560444CC
CONFIG_PARTITION_GET_SIZE_BY_NAME_ADDRESS=0x56043060
CONFIG_MT_PART_GET_DEVICE_ADDRESS=0x56047B7C
CONFIG_STORAGE_SUPPORT=y
CONFIG_IDMELIB_SUPPORT=y
CONFIG_BOOTLOADER_MESSAGE_SUPPORT=y
```

## configs/amazon/tungsten_defconfig
```kconfig
CONFIG_MEDIATEK_MT8169=y
CONFIG_AMAZON_TUNGSTEN=y
CONFIG_BOOTLOADER_BASE=0x4C400000
CONFIG_BOOTLOADER_SIZE=0x173900
CONFIG_LK_SIGNATURE_SIZE=0x110
CONFIG_BOOTMODE_ADDRESS=0x4C57D4A4
CONFIG_PLATFORM_INIT_ADDRESS=0x4C4100EC
CONFIG_PLATFORM_INIT_CALLER=0x4C427076
CONFIG_APP_ADDRESS=0x4C429FAC
CONFIG_MTK_DETECT_KEY_ADDRESS=0x4C411784
CONFIG_VIDEO_PRINTF_ADDRESS=0x4C432E10
CONFIG_FASTBOOT_FAIL_ADDRESS=0x4C42A6FC
CONFIG_FASTBOOT_INFO_ADDRESS=0x4C42A688
CONFIG_FASTBOOT_OKAY_ADDRESS=0x4C42A864
CONFIG_FASTBOOT_PUBLISH_ADDRESS=0x4C42A3AC
CONFIG_FASTBOOT_REGISTER_ADDRESS=0x4C42A370
CONFIG_FASTBOOT_CMDLIST_ADDRESS=0x4C66801C
CONFIG_FASTBOOT_FETCH_COMMAND=y
CONFIG_FASTBOOT_USB_WRITE_ADDRESS=0x4C42A520
CONFIG_FASTBOOT_GETVAR_ADDRESS=0x4C42BBA0
CONFIG_LK_LOG_STORE=y
CONFIG_LK_LOG_STORE_ADDRESS=0x4C440464
CONFIG_BOOTLOADER_PARTITION_NAME="lk"
CONFIG_INIT_STORAGE_ADDRESS=0x4C40FE24
CONFIG_INIT_STORAGE_CALLER=0x4C410118
CONFIG_MALLOC_ADDRESS=0x4C433C24
CONFIG_FREE_ADDRESS=0x4C433C52
CONFIG_DPRINTF_ADDRESS=0x4C433118
CONFIG_PARTITION_READ_ADDRESS=0x4C444D00
CONFIG_PARTITION_GET_SIZE_BY_NAME_ADDRESS=0x4C443760
CONFIG_MT_PART_GET_DEVICE_ADDRESS=0x4C450DD0
CONFIG_STORAGE_SUPPORT=y
CONFIG_IDMELIB_SUPPORT=y
CONFIG_BOOTLOADER_MESSAGE_SUPPORT=y
CONFIG_MISC_PARTITION_NAME="misc"
```

## configs/cubot/marlon_defconfig
```kconfig
CONFIG_APP_ADDRESS=0x480222E0
CONFIG_BOOTLOADER_BASE=0x48000000
CONFIG_BOOTLOADER_SIZE=0xB9E08
CONFIG_BOOTMODE_ADDRESS=0x480BC0F0
CONFIG_CUBOT_MARLON=y
CONFIG_DPRINTF_ADDRESS=0x4802D0D4
CONFIG_ENVIRONMENT_SUPPORT=y
CONFIG_FASTBOOT_CMDLIST_ADDRESS=0x4815E090
CONFIG_FASTBOOT_FAIL_ADDRESS=0x48022DCC
CONFIG_FASTBOOT_INFO_ADDRESS=0x48022D4C
CONFIG_FASTBOOT_OKAY_ADDRESS=0x48022F98
CONFIG_FASTBOOT_PUBLISH_ADDRESS=0x480229D8
CONFIG_FASTBOOT_REGISTER_ADDRESS=0x4802299C
CONFIG_FRAMEBUFFER_ALIGNMENT=128
CONFIG_FRAMEBUFFER_BPP=32
CONFIG_FRAMEBUFFER_HEIGHT=2400
CONFIG_FRAMEBUFFER_SUPPORT=y
CONFIG_FRAMEBUFFER_WIDTH=1080
CONFIG_FREE_ADDRESS=0x4802D504
CONFIG_GET_ENV_ADDRESS=0x48045ABC
CONFIG_INIT_STORAGE_ADDRESS=0x48002698
CONFIG_INIT_STORAGE_CALLER=0x480028B4
CONFIG_LEGACY_LK=n
CONFIG_LK_LOG_STORE_ADDRESS=0x4803F1DC
CONFIG_MALLOC_ADDRESS=0x4802DD4C
CONFIG_MEDIATEK_MT6765=y
CONFIG_MTK_DETECT_KEY_ADDRESS=0x480047C4
CONFIG_PARTITION_GET_SIZE_BY_NAME_ADDRESS=0x480452E4
CONFIG_PARTITION_READ_ADDRESS=0x48046938
CONFIG_PLATFORM_INIT_ADDRESS=0x48002884
CONFIG_PLATFORM_INIT_CALLER=0x4801E4C4
CONFIG_RECOVERY_CMDLINE1_ADDRESS=0x480BE454
CONFIG_RECOVERY_CMDLINE2_ADDRESS=0x0
CONFIG_RECOVERY_CMDLINE_PATCH=y
CONFIG_SET_ENV_ADDRESS=0x48045CD4
CONFIG_SPOOF_SUPPORT=y
CONFIG_STAGE1_SUPPORT=y
CONFIG_THREAD_CREATE_ADDRESS=0x4801EC80
CONFIG_THREAD_RESUME_ADDRESS=0x4801EE94
CONFIG_THREAD_SUPPORT=y
CONFIG_VIDEO_PRINTF_ADDRESS=0x4802CDE4
```

## configs/digit/next_ultra_defconfig
```kconfig
CONFIG_APP_ADDRESS=0x4801D550
CONFIG_BOOTLOADER_BASE=0x48000000
CONFIG_BOOTLOADER_SIZE=0xBFC64
CONFIG_BOOTMODE_ADDRESS=0x480C25D0
CONFIG_DIGIT_NEXT_ULTRA=y
CONFIG_DPRINTF_ADDRESS=0x4802AB18
CONFIG_FASTBOOT_FAIL_ADDRESS=0x4801E094
CONFIG_FASTBOOT_INFO_ADDRESS=0x4801E014
CONFIG_FASTBOOT_OKAY_ADDRESS=0x4801E260
CONFIG_FASTBOOT_PUBLISH_ADDRESS=0x4801DCA0
CONFIG_FASTBOOT_REGISTER_ADDRESS=0x4801DC64
CONFIG_FREE_ADDRESS=0x4802AF48
CONFIG_INIT_STORAGE_ADDRESS=0x480029A0
CONFIG_INIT_STORAGE_CALLER=0x48002BBE
CONFIG_LEGACY_LK=n
CONFIG_LK_LOG_STORE_ADDRESS=0x4803EE48
CONFIG_MALLOC_ADDRESS=0x4802B790
CONFIG_MEDIATEK_MT6762=y
CONFIG_MTK_DETECT_KEY_ADDRESS=0x48004A78
CONFIG_PARTITION_GET_SIZE_BY_NAME_ADDRESS=0x480459DC
CONFIG_PARTITION_READ_ADDRESS=0x48046A04
CONFIG_PLATFORM_INIT_ADDRESS=0x48002B88
CONFIG_PLATFORM_INIT_CALLER=0x48019504
CONFIG_STAGE1_SUPPORT=y
CONFIG_THREAD_CREATE_ADDRESS=0x48019CC0
CONFIG_THREAD_RESUME_ADDRESS=0x48019ED4
CONFIG_VIDEO_PRINTF_ADDRESS=0x4802A828
```

## configs/huawei/dura_defconfig
```kconfig
CONFIG_APP_ADDRESS=0x6002C9E4
CONFIG_BOOTLOADER_BASE=0x60000000
CONFIG_BOOTLOADER_MESSAGE_SUPPORT=y
CONFIG_BOOTLOADER_SIZE=0xB704C
CONFIG_BOOTMODE_ADDRESS=0x600BE144
CONFIG_CERT_BYPASS=y
CONFIG_CERT_BYPASS_MODE="wrap"
CONFIG_DPRINTF_ADDRESS=0x60044870
CONFIG_FASTBOOT_CMDLIST_ADDRESS=0x600D301C
CONFIG_FASTBOOT_FAIL_ADDRESS=0x6002DAC4
CONFIG_FASTBOOT_INFO_ADDRESS=0x6002DA7C
CONFIG_FASTBOOT_OKAY_ADDRESS=0x6002DC3C
CONFIG_FASTBOOT_PUBLISH_ADDRESS=0x6002D87C
CONFIG_FASTBOOT_REGISTER_ADDRESS=0x6002D840
CONFIG_FREE_ADDRESS=0x60044C28
CONFIG_HUAWEI_DURA=y
CONFIG_INIT_STORAGE_ADDRESS=0x60006FA0
CONFIG_INIT_STORAGE_CALLER=0x60002C6C
CONFIG_LK_LOG_STORE_ADDRESS=0x6000135C
CONFIG_MALLOC_ADDRESS=0x600454B8
CONFIG_MEDIATEK_MT6739=y
CONFIG_MISC_PARTITION_NAME="para"
CONFIG_MT_PART_GET_DEVICE_ADDRESS=0x60055530
CONFIG_MT_PART_GET_PARTITION_ADDRESS=0x6002102C
CONFIG_PLATFORM_INIT_ADDRESS=0x60002BF8
CONFIG_PLATFORM_INIT_CALLER=0x60025C60
CONFIG_STORAGE_SUPPORT=y
CONFIG_THREAD_CREATE_ADDRESS=0x60026278
CONFIG_THREAD_RESUME_ADDRESS=0x6002648C
CONFIG_USE_MT_PART_API=y
CONFIG_VIDEO_PRINTF_ADDRESS=0x60044570
```

## configs/lg/mcaymanlm_defconfig
```kconfig
CONFIG_APP_ADDRESS=0x4C433BC0
CONFIG_BOOTLOADER_BASE=0x4C400000
CONFIG_BOOTLOADER_SIZE=0x129010
CONFIG_BOOTMODE_ADDRESS=0x4C52C624
CONFIG_CERT_BYPASS=y
CONFIG_CERT_BYPASS_MODE="wrap"
CONFIG_DPRINTF_ADDRESS=0x4C444928
CONFIG_FASTBOOT_FAIL_ADDRESS=0x4C434AD0
CONFIG_FASTBOOT_INFO_ADDRESS=0x4C434A50
CONFIG_FASTBOOT_OKAY_ADDRESS=0x4C434CC0
CONFIG_FASTBOOT_PUBLISH_ADDRESS=0x4C4345FC
CONFIG_FASTBOOT_REGISTER_ADDRESS=0x4C434584
CONFIG_FREE_ADDRESS=0x4C444D5C
CONFIG_INIT_STORAGE_ADDRESS=0x4C403568
CONFIG_INIT_STORAGE_CALLER=0x4C4036A6
CONFIG_LG_MCAYMANLM=y
CONFIG_LK_LOG_STORE_ADDRESS=0x4C457368
CONFIG_MALLOC_ADDRESS=0x4C44578C
CONFIG_MEDIATEK_MT6885=y
CONFIG_MTK_DETECT_KEY_ADDRESS=0x4C405D18
CONFIG_PARTITION_GET_SIZE_BY_NAME_ADDRESS=0x4C45E3DC
CONFIG_PARTITION_READ_ADDRESS=0x4C45F728
CONFIG_PLATFORM_INIT_ADDRESS=0x4C403670
CONFIG_PLATFORM_INIT_CALLER=0x4C4271C4
CONFIG_STAGE1_SUPPORT=y
CONFIG_THREAD_CREATE_ADDRESS=0x4C427980
CONFIG_THREAD_RESUME_ADDRESS=0x4C427B94
CONFIG_VIDEO_PRINTF_ADDRESS=0x4C4440B4
```

## configs/lge/w7_defconfig
```kconfig
CONFIG_APP_ADDRESS=0x4802F354
CONFIG_BOOTLOADER_BASE=0x48000000
CONFIG_BOOTLOADER_SIZE=0xF1234
CONFIG_BOOTMODE_ADDRESS=0x480F467C
CONFIG_CERT_BYPASS=y
CONFIG_CERT_BYPASS_MODE="wrap"
CONFIG_DPRINTF_ADDRESS=0x4803B02C
CONFIG_FASTBOOT_CMDLIST_ADDRESS=0x48199084
CONFIG_FASTBOOT_CONTINUE_ADDRESS=0x48031830
CONFIG_FASTBOOT_FAIL_ADDRESS=0x480306BC
CONFIG_FASTBOOT_INFO_ADDRESS=0x48030660
CONFIG_FASTBOOT_OKAY_ADDRESS=0x48030888
CONFIG_FASTBOOT_PUBLISH_ADDRESS=0x4803036C
CONFIG_FASTBOOT_REGISTER_ADDRESS=0x480302F4
CONFIG_FREE_ADDRESS=0x4803B3F4
CONFIG_INIT_STORAGE_ADDRESS=0x480027DC
CONFIG_INIT_STORAGE_CALLER=0x48002A02
CONFIG_LG_W7=y
CONFIG_LK_LOG_STORE_ADDRESS=0x48003568
CONFIG_MALLOC_ADDRESS=0x4803BC94
CONFIG_MEDIATEK_MT6765=y
CONFIG_MTK_DETECT_KEY_ADDRESS=0x4800543C
CONFIG_PARTITION_GET_SIZE_BY_NAME_ADDRESS=0x480528E8
CONFIG_PARTITION_READ_ADDRESS=0x48053B08
CONFIG_PLATFORM_INIT_ADDRESS=0x480029CC
CONFIG_PLATFORM_INIT_CALLER=0x4801A0C0
CONFIG_THREAD_CREATE_ADDRESS=0x4801A880
CONFIG_THREAD_RESUME_ADDRESS=0x4801AA94
CONFIG_VIDEO_PRINTF_ADDRESS=0x4803A994
```

## configs/motorola/fogorow_defconfig
```kconfig
CONFIG_APP_ADDRESS=0x4C42A0DC
CONFIG_BOOTLOADER_BASE=0x4C400000
CONFIG_BOOTLOADER_SIZE=0x121314
CONFIG_BOOTMODE_ADDRESS=0x4C524594
CONFIG_CERT_BYPASS=n
CONFIG_DPRINTF_ADDRESS=0x4C43C47C
CONFIG_ENVIRONMENT_SUPPORT=y
CONFIG_FASTBOOT_CMDLIST_ADDRESS=0x4C5CF020
CONFIG_FASTBOOT_FAIL_ADDRESS=0x4C42AB7C
CONFIG_FASTBOOT_HELP_COMMAND=y
CONFIG_FASTBOOT_INFO_ADDRESS=0x4C42AAFC
CONFIG_FASTBOOT_OKAY_ADDRESS=0x4C42AD48
CONFIG_FASTBOOT_PUBLISH_ADDRESS=0x4C42A788
CONFIG_FASTBOOT_REGISTER_ADDRESS=0x4C42A74C
CONFIG_FREE_ADDRESS=0x4C43C8AC
CONFIG_GET_ENV_ADDRESS=0x4C458638
CONFIG_INIT_STORAGE_ADDRESS=0x4C4037C4
CONFIG_INIT_STORAGE_CALLER=0x4C4039E4
CONFIG_LEGACY_LK=n
CONFIG_LK_LOG_STORE_ADDRESS=0x4C451740
CONFIG_MALLOC_ADDRESS=0x4C43D1B8
CONFIG_MEDIATEK_MT6768=y
CONFIG_MOTOROLA_FOGOROW=y
CONFIG_MTK_DETECT_KEY_ADDRESS=0x4C405548
CONFIG_MT_PART_GET_DEVICE_ADDRESS=0X4C475FD8
CONFIG_PARTITION_GET_SIZE_BY_NAME_ADDRESS=0X4C458314
CONFIG_PARTITION_READ_ADDRESS=0x4C4595B0
CONFIG_PLATFORM_INIT_ADDRESS=0x4C4039B4
CONFIG_PLATFORM_INIT_CALLER=0x4C4262A8
CONFIG_RECOVERY_CMDLINE1_ADDRESS=0x4C527008
CONFIG_RECOVERY_CMDLINE2_ADDRESS=0x4C52740C
CONFIG_RECOVERY_CMDLINE_PATCH=y
CONFIG_SET_ENV_ADDRESS=0x4C458850
CONFIG_SPOOF_SUPPORT=y
CONFIG_STAGE1_SUPPORT=y
CONFIG_STORAGE_SUPPORT=y
CONFIG_VIDEO_PRINTF_ADDRESS=0x4C43BF60
```
