## board/xiaomi/Kconfig
```kconfig
config XIAOMI_NIKEL
    bool "Support Redmi Note 4"
    default n
    help
      Say Y if you want to include support for Redmi Note 4

config XIAOMI_ROSEMARY
    bool "Support Redmi 10S / POCO M5s"
    default n
    help
      Say Y if you want to include support for Redmi 10S / POCO M5s

config XIAOMI_EARTH
    bool "Support Redmi 12C / POCO C55"
    default n
    help
      Say Y if you want to include support for Redmi 12C / POCO C55

config XIAOMI_FLEUR
    bool "Support Redmi Note 11S 4G"
    default n
    help
      Say Y if you want to include support for Redmi Note 11S 4G

config XIAOMI_RUBY
    bool "Support Redmi Note 12 Pro/Pro+/Discovery 5G/Pro+ 5G"
    default n
    help
      Say Y if you want to include support for Redmi Note 12 Pro/Pro+/Discovery 5G/Pro+ 5G

config XIAOMI_FIRE
    bool "Support Redmi 12 4G"
    default n
    help
      Say Y if you want to include support for Redmi 12 4G

config XIAOMI_LANCELOT
    bool "Support Redmi 9/Redmi 9 Prime"
    default n
    help
      Say Y if you want to include support for Redmi 9/Redmi 9 Prime

config XIAOMI_MERLIN
    bool "Support Redmi 10X 4G/Redmi Note 9"
    default n
    help
      Say Y if you want to include support for Redmi 10X 4G/Redmi Note 9

config XIAOMI_BEGONIA
    bool "Support Redmi Note 8 Pro"
    default n
    help
      Say Y if you want to include support for Redmi Note 8 Pro

config XIAOMI_PISSARRO
    bool "Support Redmi Note 11 Pro+ 5G"
    default n
    help
      Say Y if you want to include support for Redmi Note 11 Pro+ 5G

config XIAOMI_LIGHT
    bool "Support POCO M4 5G / Redmi 10 5G / Redmi 11 Prime 5G / Redmi Note 11E/11R"
    default n
    help
      Say Y if you want to include support for POCO M4 5G / Redmi 10 5G / Redmi 11 Prime 5G / Redmi Note 11E/11R
```

## configs/acer/t482l_defconfig
```kconfig
CONFIG_ACER_T482L=y
CONFIG_BOOTLOADER_BASE=0x48000000
CONFIG_BOOTLOADER_SIZE=0xBC578
CONFIG_APP_ADDRESS=0x480222E0
CONFIG_BOOTMODE_ADDRESS=0x480BF5DC
CONFIG_DPRINTF_ADDRESS=0x4802CCC4
CONFIG_FASTBOOT_FAIL_ADDRESS=0x48022B5C
CONFIG_FASTBOOT_INFO_ADDRESS=0x48022B00
CONFIG_FASTBOOT_OKAY_ADDRESS=0x48022D28
CONFIG_FASTBOOT_PUBLISH_ADDRESS=0x4802280C
CONFIG_FASTBOOT_REGISTER_ADDRESS=0x480227D0
CONFIG_FREE_ADDRESS=0x4802D084
CONFIG_INIT_STORAGE_CALLER=0x48002AC0
CONFIG_INIT_STORAGE_ADDRESS=0x480028B0
CONFIG_LK_LOG_STORE_ADDRESS=0x4803DFDC
CONFIG_MALLOC_ADDRESS=0x4802D8C8
CONFIG_MEDIATEK_MT6761=y
CONFIG_MTK_DETECT_KEY_ADDRESS=0x480046C8
CONFIG_USE_LEGACY_PARTITION_API=y
CONFIG_PARTITION_GET_INDEX_ADDRESS=0x48044918
CONFIG_PARTITION_GET_OFFSET_ADDRESS=0x48044A04
CONFIG_PARTITION_GET_SIZE_ADDRESS=0x48044A60
CONFIG_PLATFORM_INIT_ADDRESS=0x48002A90
CONFIG_PLATFORM_INIT_CALLER=0x4801E920
CONFIG_THREAD_CREATE_ADDRESS=0x4801F0DC
CONFIG_THREAD_RESUME_ADDRESS=0x4801F2F0
CONFIG_VIDEO_PRINTF_ADDRESS=0x4802C9D4
CONFIG_MT_PART_GET_DEVICE_ADDRESS=0x480517C8
```

## configs/amazon/athena_defconfig
```kconfig
CONFIG_MEDIATEK_MT8183=y
CONFIG_AMAZON_ATHENA=y
CONFIG_FASTBOOT_CMDLIST_ADDRESS=0x560C7088
CONFIG_FASTBOOT_FAIL_ADDRESS=0x5603260C
CONFIG_FASTBOOT_INFO_ADDRESS=0x560325FC
CONFIG_FASTBOOT_OKAY_ADDRESS=0x5603289C
CONFIG_FASTBOOT_PUBLISH_ADDRESS=0x56032330
CONFIG_FASTBOOT_REGISTER_ADDRESS=0x560322F4
CONFIG_FASTBOOT_FETCH_COMMAND=y
CONFIG_FASTBOOT_USB_WRITE_ADDRESS=0x56032438
CONFIG_FASTBOOT_GETVAR_ADDRESS=0x56033758
CONFIG_BOOTLOADER_BASE=0x56000000
CONFIG_BOOTLOADER_SIZE=0xA3760
CONFIG_BOOTMODE_ADDRESS=0x560ABFDC
CONFIG_PLATFORM_INIT_CALLER=0x5602E0DA
CONFIG_PLATFORM_INIT_ADDRESS=0x560125D8
CONFIG_APP_ADDRESS=0x560316BC
CONFIG_VIDEO_PRINTF_ADDRESS=0x560419D8
# CONFIG_LK_LOG_STORE is not set
CONFIG_LK_SIGNATURE_SIZE=0x114
CONFIG_INIT_STORAGE_CALLER=0x56012606
CONFIG_INIT_STORAGE_ADDRESS=0x5601244C
CONFIG_MALLOC_ADDRESS=0x560428D8
CONFIG_DPRINTF_ADDRESS=0x56041E24
CONFIG_FREE_ADDRESS=0x560421A4
CONFIG_PARTITION_READ_ADDRESS=0x5604DA24
CONFIG_PARTITION_GET_SIZE_BY_NAME_ADDRESS=0x5604C7A4
CONFIG_MT_PART_GET_DEVICE_ADDRESS=0x5604ECFC
CONFIG_STORAGE_SUPPORT=y
CONFIG_IDMELIB_SUPPORT=y
CONFIG_BOOTLOADER_MESSAGE_SUPPORT=y
```

## configs/amazon/austin_defconfig
```kconfig
CONFIG_MEDIATEK_MT8127=y
CONFIG_AMAZON_AUSTIN=y
CONFIG_FASTBOOT_FAIL_ADDRESS=0x81E3ED84
CONFIG_FASTBOOT_INFO_ADDRESS=0x81E3ED3C
CONFIG_FASTBOOT_OKAY_ADDRESS=0x81E3EEFC
CONFIG_FASTBOOT_PUBLISH_ADDRESS=0x81E3EB7C
CONFIG_FASTBOOT_REGISTER_ADDRESS=0x81E3EB3C
CONFIG_STORAGE_SUPPORT=y
CONFIG_BLKDEV_HAS_BROKEN_UNALIGNED_ACCESS=y
CONFIG_MT_PART_GET_DEVICE_ADDRESS=0x81E35C24
CONFIG_BOOTLOADER_BASE=0x81E00000
CONFIG_BOOTLOADER_SIZE=0x79734
CONFIG_BOOTMODE_ADDRESS=0x81E81374
CONFIG_PLATFORM_INIT_CALLER=0x81E3D28E
CONFIG_PLATFORM_INIT_ADDRESS=0x81E216F8
CONFIG_APP_ADDRESS=0x81E3EA54
CONFIG_MTK_DETECT_KEY_ADDRESS=0x81E282EC
CONFIG_VIDEO_PRINTF_ADDRESS=0x81E47018
# CONFIG_LK_LOG_STORE is not set
CONFIG_BOOTLOADER_MESSAGE_SUPPORT=y
CONFIG_MISC_PARTITION_NAME="MISC"
CONFIG_LK_SIGNATURE_SIZE=0x104
CONFIG_LK_PART_HDR_NAME="LK"
CONFIG_STAGE1_SUPPORT=y
CONFIG_USE_LEGACY_PARTITION_API=y
CONFIG_PARTITION_GET_INDEX_ADDRESS=0x81E3B6FC
CONFIG_PARTITION_GET_OFFSET_ADDRESS=0x81E3B7C4
CONFIG_PARTITION_GET_SIZE_ADDRESS=0x81E3B780
CONFIG_BOOTLOADER_PARTITION_NAME="UBOOT"
CONFIG_INIT_STORAGE_CALLER=0x81E21712
CONFIG_INIT_STORAGE_ADDRESS=0x81E3AE50
CONFIG_MALLOC_ADDRESS=0x81E47FEC
CONFIG_DPRINTF_ADDRESS=0x81E479DC
CONFIG_FREE_ADDRESS=0x81E47638
```

## configs/amazon/biscuit_defconfig
```kconfig
CONFIG_AMAZON_BISCUIT=y
CONFIG_APP_ADDRESS=0x4BD211A4
CONFIG_BOOTLOADER_BASE=0x4BD00000
CONFIG_BOOTLOADER_MESSAGE_SUPPORT=y
CONFIG_BOOTLOADER_PARTITION_NAME="expdb"
CONFIG_BOOTLOADER_SIZE=0x3AE74
CONFIG_BOOTMODE_ADDRESS=0x4BD4126C
CONFIG_DPRINTF_ADDRESS=0x4BD25E50
CONFIG_FASTBOOT_FAIL_ADDRESS=0x4BD2181C
CONFIG_FASTBOOT_INFO_ADDRESS=0x4BD217E0
CONFIG_FASTBOOT_OKAY_ADDRESS=0x4BD219EC
CONFIG_FASTBOOT_PUBLISH_ADDRESS=0x4BD21678
CONFIG_FASTBOOT_REGISTER_ADDRESS=0x4BD215F0
CONFIG_FREE_ADDRESS=0x4BD26108
CONFIG_IDMELIB_SUPPORT=y
CONFIG_INIT_STORAGE_ADDRESS=0x4BD1DC94
CONFIG_INIT_STORAGE_CALLER=0x4BD0F9A0
CONFIG_USE_MT_PART_API=y
CONFIG_LK_LOG_STORE=n
CONFIG_LK_SIGNATURE_SIZE=0x104
CONFIG_MALLOC_ADDRESS=0x4BD269E0
CONFIG_MEDIATEK_MT8163=y
CONFIG_MISC_PARTITION_NAME="misc"
CONFIG_MTK_DETECT_KEY_ADDRESS=0x4BD11160
CONFIG_MT_PART_GET_DEVICE_ADDRESS=0x4BD190EC
CONFIG_MT_PART_GET_PARTITION_ADDRESS=0x4BD1902C
CONFIG_PLATFORM_INIT_ADDRESS=0x4BD0F974
CONFIG_PLATFORM_INIT_CALLER=0x4BD1F21A
CONFIG_STAGE1_SUPPORT=y
CONFIG_STORAGE_SUPPORT=y
CONFIG_THREAD_CREATE_ADDRESS=0x4BD1F448
CONFIG_THREAD_RESUME_ADDRESS=0x4BD1F5CC
CONFIG_THREAD_SUPPORT=y
CONFIG_VIDEO_PRINTF_ADDRESS=0x4BD25DF6
```

## configs/amazon/cupcake_defconfig
```kconfig
CONFIG_AMAZON_CUPCAKE=y
CONFIG_APP_ADDRESS=0x41E1C5A0
CONFIG_BOOTLOADER_BASE=0x41E00000
CONFIG_BOOTLOADER_PARTITION_NAME="swdl"
CONFIG_BOOTLOADER_SIZE=0x338C4
CONFIG_BOOTMODE_ADDRESS=0x41E3926C
CONFIG_DPRINTF_ADDRESS=0x41E1E650
CONFIG_FASTBOOT_FAIL_ADDRESS=0x41E1CC34
CONFIG_FASTBOOT_INFO_ADDRESS=0x41E1CBF8
CONFIG_FASTBOOT_OKAY_ADDRESS=0x41E1CDD0
CONFIG_FASTBOOT_PUBLISH_ADDRESS=0x41E1CA90
CONFIG_FASTBOOT_REGISTER_ADDRESS=0x41E1CA00
CONFIG_FREE_ADDRESS=0x41E1E920
CONFIG_INIT_STORAGE_ADDRESS=0x41E17B1C
CONFIG_INIT_STORAGE_CALLER=0x41E0F940
CONFIG_LEGACY_LK=y
CONFIG_LK_LOG_STORE=n
CONFIG_LK_SIGNATURE_SIZE=0x104
CONFIG_MALLOC_ADDRESS=0x41E1F03C
CONFIG_MEDIATEK_MT8516=y
CONFIG_MTK_DETECT_KEY_ADDRESS=0x41E11734
CONFIG_MT_PART_GET_DEVICE_ADDRESS=0x41E18E84
CONFIG_MT_PART_GET_PARTITION_ADDRESS=0x41E138C8
CONFIG_PLATFORM_INIT_ADDRESS=0x41E0F908
CONFIG_PLATFORM_INIT_CALLER=0x41E19EDE
CONFIG_STAGE1_SUPPORT=y
CONFIG_THREAD_CREATE_ADDRESS=0x41E1A0BC
CONFIG_THREAD_RESUME_ADDRESS=0x41E1A240
CONFIG_THREAD_SUPPORT=y
CONFIG_VIDEO_PRINTF_ADDRESS=0x41E1EC4C
```

## configs/amazon/donut_defconfig
```kconfig
CONFIG_MEDIATEK_MT8516=y
CONFIG_AMAZON_DONUT=y
CONFIG_THREAD_SUPPORT=y
CONFIG_THREAD_CREATE_ADDRESS=0x41E1A13C
CONFIG_THREAD_RESUME_ADDRESS=0x41E1A2C0
CONFIG_FASTBOOT_FAIL_ADDRESS=0x41E1CE68
CONFIG_FASTBOOT_INFO_ADDRESS=0x41E1CE2C
CONFIG_FASTBOOT_OKAY_ADDRESS=0x41E1D014
CONFIG_FASTBOOT_PUBLISH_ADDRESS=0x41E1CCC4
CONFIG_FASTBOOT_REGISTER_ADDRESS=0x41E1CC34
CONFIG_BOOTLOADER_BASE=0x41E00000
CONFIG_BOOTLOADER_SIZE=0x33D34
CONFIG_BOOTMODE_ADDRESS=0x41E3926C
CONFIG_PLATFORM_INIT_CALLER=0x41E19F5E
CONFIG_PLATFORM_INIT_ADDRESS=0x41E0F984
CONFIG_APP_ADDRESS=0x41E1C7D4
CONFIG_MTK_DETECT_KEY_ADDRESS=0x41E117B0
CONFIG_VIDEO_PRINTF_ADDRESS=0x41E1EE94
# CONFIG_LK_LOG_STORE is not set
CONFIG_LK_SIGNATURE_SIZE=0x104
CONFIG_STAGE1_SUPPORT=y
CONFIG_LEGACY_LK=y
CONFIG_BOOTLOADER_PARTITION_NAME="expdb"
CONFIG_INIT_STORAGE_CALLER=0x41E0F9BC
CONFIG_INIT_STORAGE_ADDRESS=0x41E17B9C
CONFIG_MALLOC_ADDRESS=0x41E1F284
CONFIG_DPRINTF_ADDRESS=0x41E1E898
CONFIG_FREE_ADDRESS=0x41E1EB68
CONFIG_MT_PART_GET_DEVICE_ADDRESS=0x41E18F04
CONFIG_MT_PART_GET_PARTITION_ADDRESS=0x41E13944
```

## configs/amazon/douglas_defconfig
```kconfig
CONFIG_MEDIATEK_MT8163=y
CONFIG_AMAZON_DOUGLAS=y
CONFIG_THREAD_SUPPORT=y
CONFIG_THREAD_CREATE_ADDRESS=0x4BD3D130
CONFIG_THREAD_RESUME_ADDRESS=0x4BD3D2D0
CONFIG_FASTBOOT_FAIL_ADDRESS=0x4BD3F6CC
CONFIG_FASTBOOT_INFO_ADDRESS=0x4BD3F684
CONFIG_FASTBOOT_OKAY_ADDRESS=0x4BD3F87C
CONFIG_FASTBOOT_PUBLISH_ADDRESS=0x4BD3F4E8
CONFIG_FASTBOOT_REGISTER_ADDRESS=0x4BD3F454
CONFIG_STORAGE_SUPPORT=y
CONFIG_MT_PART_GET_DEVICE_ADDRESS=0x4BD35DA8
CONFIG_MT_PART_GET_PARTITION_ADDRESS=0x4BD35C40
CONFIG_BOOTLOADER_BASE=0x4BD00000
CONFIG_BOOTLOADER_SIZE=0x766B0
CONFIG_BOOTMODE_ADDRESS=0x4BD7C3A0
CONFIG_PLATFORM_INIT_CALLER=0x4BD3CEE6
CONFIG_PLATFORM_INIT_ADDRESS=0x4BD23950
CONFIG_APP_ADDRESS=0x4BD3EFF4
CONFIG_MTK_DETECT_KEY_ADDRESS=0x4BD25F00
CONFIG_VIDEO_PRINTF_ADDRESS=0x4BD44990
# CONFIG_LK_LOG_STORE is not set
CONFIG_BOOTLOADER_MESSAGE_SUPPORT=y
CONFIG_MISC_PARTITION_NAME="MISC"
CONFIG_LK_SIGNATURE_SIZE=0x104
CONFIG_STAGE1_SUPPORT=y
CONFIG_LEGACY_LK=y
CONFIG_BOOTLOADER_PARTITION_NAME="lk2"
CONFIG_INIT_STORAGE_CALLER=0x4BD23972
CONFIG_INIT_STORAGE_ADDRESS=0x4BD3AF68
CONFIG_MALLOC_ADDRESS=0x4BD45A04
CONFIG_DPRINTF_ADDRESS=0x4BD44D50
CONFIG_FREE_ADDRESS=0x4BD45050
```

## configs/amazon/ford_defconfig
```kconfig
CONFIG_MEDIATEK_MT8127=y
CONFIG_AMAZON_FORD=y
CONFIG_FASTBOOT_FAIL_ADDRESS=0x81E3E054
CONFIG_FASTBOOT_INFO_ADDRESS=0x81E3E00C
CONFIG_FASTBOOT_OKAY_ADDRESS=0x81E3E1CC
CONFIG_FASTBOOT_PUBLISH_ADDRESS=0x81E3DE4C
CONFIG_FASTBOOT_REGISTER_ADDRESS=0x81E3DE0C
CONFIG_STORAGE_SUPPORT=y
CONFIG_BLKDEV_HAS_BROKEN_UNALIGNED_ACCESS=y
CONFIG_MT_PART_GET_DEVICE_ADDRESS=0x81E354F0
CONFIG_BOOTLOADER_BASE=0x81E00000
CONFIG_BOOTLOADER_SIZE=0x64A18
CONFIG_BOOTMODE_ADDRESS=0x81E6D370
CONFIG_PLATFORM_INIT_CALLER=0x81E3C4BA
CONFIG_PLATFORM_INIT_ADDRESS=0x81E213BC
CONFIG_APP_ADDRESS=0x81E3DD24
CONFIG_MTK_DETECT_KEY_ADDRESS=0x81E28024
CONFIG_VIDEO_PRINTF_ADDRESS=0x81E42288
# CONFIG_LK_LOG_STORE is not set
CONFIG_BOOTLOADER_MESSAGE_SUPPORT=y
CONFIG_MISC_PARTITION_NAME="MISC"
CONFIG_LK_SIGNATURE_SIZE=0x104
CONFIG_LK_PART_HDR_NAME="LK"
CONFIG_STAGE1_SUPPORT=y
CONFIG_USE_LEGACY_PARTITION_API=y
CONFIG_PARTITION_GET_INDEX_ADDRESS=0x81E3AFC8
CONFIG_PARTITION_GET_OFFSET_ADDRESS=0x81E3B090
CONFIG_PARTITION_GET_SIZE_ADDRESS=0x81E3B04C
CONFIG_BOOTLOADER_PARTITION_NAME="UBOOT"
CONFIG_INIT_STORAGE_CALLER=0x81E213D6
CONFIG_INIT_STORAGE_ADDRESS=0x81E3A71C
CONFIG_MALLOC_ADDRESS=0x81E4325C
CONFIG_DPRINTF_ADDRESS=0x81E42C4C
CONFIG_FREE_ADDRESS=0x81E428A8
```

## configs/amazon/karat_defconfig
```kconfig
CONFIG_BOOTLOADER_BASE=0x4CE00000
CONFIG_BOOTLOADER_SIZE=0x9DD88
CONFIG_FASTBOOT_INFO_ADDRESS=0x4ce27244
CONFIG_FASTBOOT_FAIL_ADDRESS=0x4ce27294
CONFIG_FASTBOOT_OKAY_ADDRESS=0x4ce27400
CONFIG_THREAD_CREATE_ADDRESS=0x4CE25424
CONFIG_AMAZON_KARAT=y
CONFIG_MEDIATEK_MT8696=y
CONFIG_PLATFORM_INIT_ADDRESS=0x4ce0e778
CONFIG_PLATFORM_INIT_CALLER=0x4ce25212
CONFIG_INIT_STORAGE_ADDRESS=0x4ce22278
CONFIG_INIT_STORAGE_CALLER=0x4ce0e79c
CONFIG_APP_ADDRESS=0x4ce26bcc
CONFIG_FASTBOOT_PUBLISH_ADDRESS=0x4ce270a0
CONFIG_FASTBOOT_REGISTER_ADDRESS=0x4ce27064
CONFIG_DPRINTF_ADDRESS=0x4ce2b768
CONFIG_BOOTMODE_ADDRESS=0x4cea57e8
CONFIG_FREE_ADDRESS=0x4ce2ba38
CONFIG_MALLOC_ADDRESS=0x4ce2c070
CONFIG_LEGACY_LK=y
CONFIG_STAGE1_SUPPORT=y
CONFIG_STORAGE_SUPPORT=y
CONFIG_BOOTLOADER_MESSAGE_SUPPORT=y
CONFIG_MISC_PARTITION_NAME="misc"
CONFIG_MT_PART_GET_DEVICE_ADDRESS=0x4ce244fc
CONFIG_LK_SIGNATURE_SIZE=0x104
CONFIG_MT_PART_GET_PARTITION_ADDRESS=0x4ce1e0b4
CONFIG_MTK_DETECT_KEY_ADDRESS=0x0
CONFIG_VIDEO_PRINTF_ADDRESS=0x4ce2b51e
CONFIG_LK_LOG_STORE=y
CONFIG_LK_LOG_STORE_ADDRESS=0x4CE33900
CONFIG_IDMELIB_SUPPORT=y
```

## configs/amazon/maverick_defconfig
```kconfig
CONFIG_MEDIATEK_MT8183=y
CONFIG_AMAZON_MAVERICK=y
CONFIG_FASTBOOT_FAIL_ADDRESS=0x5602F618
CONFIG_FASTBOOT_INFO_ADDRESS=0x5602F5C4
CONFIG_FASTBOOT_OKAY_ADDRESS=0x5602F780
CONFIG_FASTBOOT_PUBLISH_ADDRESS=0x5602F3B4
CONFIG_FASTBOOT_REGISTER_ADDRESS=0x5602F378
CONFIG_BOOTLOADER_BASE=0x56000000
CONFIG_BOOTLOADER_SIZE=0x85AC0
CONFIG_BOOTMODE_ADDRESS=0x5608D574
CONFIG_PLATFORM_INIT_CALLER=0x5602BD1E
CONFIG_PLATFORM_INIT_ADDRESS=0x56011ADC
CONFIG_APP_ADDRESS=0x5602EA30
CONFIG_MTK_DETECT_KEY_ADDRESS=0x56014484
CONFIG_VIDEO_PRINTF_ADDRESS=0x560347A8
# CONFIG_LK_LOG_STORE is not set
CONFIG_LK_SIGNATURE_SIZE=0x10C
CONFIG_STAGE1_SUPPORT=y
CONFIG_INIT_STORAGE_CALLER=0x56011B08
CONFIG_INIT_STORAGE_ADDRESS=0x56011928
CONFIG_MALLOC_ADDRESS=0x56035504
CONFIG_DPRINTF_ADDRESS=0x56034A5C
CONFIG_FREE_ADDRESS=0x56034DDC
CONFIG_PARTITION_READ_ADDRESS=0x5603FBE4
CONFIG_PARTITION_GET_SIZE_BY_NAME_ADDRESS=0x5603E778
```

## configs/amazon/onyx_defconfig
```kconfig
CONFIG_MEDIATEK_MT8168=y
CONFIG_AMAZON_ONYX=y
CONFIG_FASTBOOT_CMDLIST_ADDRESS=0x560C2090
CONFIG_FASTBOOT_FAIL_ADDRESS=0x560312C0
CONFIG_FASTBOOT_INFO_ADDRESS=0x56031244
CONFIG_FASTBOOT_OKAY_ADDRESS=0x56031428
CONFIG_FASTBOOT_PUBLISH_ADDRESS=0x5603100C
CONFIG_FASTBOOT_REGISTER_ADDRESS=0x56030FD0
CONFIG_FASTBOOT_FETCH_COMMAND=y
CONFIG_FASTBOOT_USB_WRITE_ADDRESS=0x560310D8
CONFIG_FASTBOOT_GETVAR_ADDRESS=0x5603226C
CONFIG_BOOTLOADER_BASE=0x56000000
CONFIG_BOOTLOADER_SIZE=0x8E790
CONFIG_BOOTMODE_ADDRESS=0x5609853C
CONFIG_PLATFORM_INIT_CALLER=0x5602D656
CONFIG_PLATFORM_INIT_ADDRESS=0x56011870
CONFIG_APP_ADDRESS=0x56030574
CONFIG_MTK_DETECT_KEY_ADDRESS=0x560137C8
CONFIG_VIDEO_PRINTF_ADDRESS=0x56041324
CONFIG_LK_LOG_STORE=y
CONFIG_LK_LOG_STORE_ADDRESS=0x5604AE6C
CONFIG_LK_SIGNATURE_SIZE=0x114
CONFIG_INIT_STORAGE_CALLER=0x56011890
CONFIG_INIT_STORAGE_ADDRESS=0x5602931C
CONFIG_MALLOC_ADDRESS=0x560420F8
CONFIG_DPRINTF_ADDRESS=0x560415D8
CONFIG_FREE_ADDRESS=0x56041998
CONFIG_PARTITION_READ_ADDRESS=0x5604B030
CONFIG_PARTITION_GET_SIZE_BY_NAME_ADDRESS=0x5604B014
CONFIG_MT_PART_GET_DEVICE_ADDRESS=0x5604DD50
CONFIG_STORAGE_SUPPORT=y
CONFIG_IDMELIB_SUPPORT=y
CONFIG_BOOTLOADER_MESSAGE_SUPPORT=y
```

## configs/amazon/radar_defconfig
```kconfig
CONFIG_AMAZON_RADAR=y
CONFIG_APP_ADDRESS=0x4BD20F60
CONFIG_BOOTLOADER_BASE=0x4BD00000
CONFIG_BOOTLOADER_MESSAGE_SUPPORT=y
CONFIG_BOOTLOADER_PARTITION_NAME="expdb"
CONFIG_BOOTLOADER_SIZE=0x3A644
CONFIG_BOOTMODE_ADDRESS=0x4BD4126C
CONFIG_DPRINTF_ADDRESS=0x4BD25C0C
CONFIG_FASTBOOT_FAIL_ADDRESS=0x4BD215D8
CONFIG_FASTBOOT_INFO_ADDRESS=0x4BD2159C
CONFIG_FASTBOOT_OKAY_ADDRESS=0x4BD217A8
CONFIG_FASTBOOT_PUBLISH_ADDRESS=0x4BD21434
CONFIG_FASTBOOT_REGISTER_ADDRESS=0x4BD213AC
CONFIG_FREE_ADDRESS=0x4BD25EC4
CONFIG_IDMELIB_SUPPORT=y
CONFIG_INIT_STORAGE_ADDRESS=0x4BD1DD34
CONFIG_INIT_STORAGE_CALLER=0x4BD0FA40
CONFIG_USE_MT_PART_API=y
CONFIG_LK_LOG_STORE=n
CONFIG_LK_SIGNATURE_SIZE=0x104
CONFIG_MALLOC_ADDRESS=0x4BD265D0
CONFIG_MEDIATEK_MT8163=y
CONFIG_MISC_PARTITION_NAME="misc"
CONFIG_MTK_DETECT_KEY_ADDRESS=0x4BD11200
CONFIG_MT_PART_GET_DEVICE_ADDRESS=0x4BD1918C
CONFIG_MT_PART_GET_PARTITION_ADDRESS=0x4BD190CC
CONFIG_PLATFORM_INIT_ADDRESS=0x4BD0FA14
CONFIG_PLATFORM_INIT_CALLER=0x4BD1F2BA
CONFIG_STORAGE_SUPPORT=y
CONFIG_THREAD_CREATE_ADDRESS=0x4BD1F4E8
CONFIG_THREAD_RESUME_ADDRESS=0x4BD1F66C
CONFIG_THREAD_SUPPORT=y
CONFIG_VIDEO_PRINTF_ADDRESS=0x4BD25BB2
```
