## configs/xiaomi/nikel_defconfig
```kconfig
CONFIG_APP_ADDRESS=0x46028544
CONFIG_BOOTLOADER_BASE=0x46000000
CONFIG_BOOTLOADER_SIZE=0x816A8
CONFIG_BOOTMODE_ADDRESS=0x46084518
CONFIG_DPRINTF_ADDRESS=0x4602DAAC
CONFIG_FASTBOOT_FAIL_ADDRESS=0x46028A10
CONFIG_FASTBOOT_INFO_ADDRESS=0x460289C8
CONFIG_FASTBOOT_OKAY_ADDRESS=0x46028BB8
CONFIG_FASTBOOT_PUBLISH_ADDRESS=0x460287FC
CONFIG_FASTBOOT_REGISTER_ADDRESS=0x460287C8
CONFIG_FREE_ADDRESS=0x4602DDD0
CONFIG_INIT_STORAGE_ADDRESS=0x4600A19C
CONFIG_INIT_STORAGE_CALLER=0x460057B0
CONFIG_LEGACY_LK=y
CONFIG_LK_LOG_STORE=n
CONFIG_MALLOC_ADDRESS=0x4602E69C
CONFIG_MEDIATEK_MT6797=y
CONFIG_MT_PART_GET_DEVICE_ADDRESS=0x46007D30
CONFIG_MT_PART_GET_PARTITION_ADDRESS=0x46007B44
CONFIG_MTK_DETECT_KEY_ADDRESS=0x460080AC
CONFIG_PLATFORM_INIT_ADDRESS=0x4600579C
CONFIG_PLATFORM_INIT_CALLER=0x46025FD2
CONFIG_STAGE1_SUPPORT=y
CONFIG_VIDEO_PRINTF_ADDRESS=0x4602D848
CONFIG_XIAOMI_NIKEL=y
```

## configs/xiaomi/rosemary_defconfig
```kconfig
CONFIG_APP_ADDRESS=0x4C42CF94
CONFIG_BOOTLOADER_BASE=0x4C400000
CONFIG_BOOTLOADER_SIZE=0x189680
CONFIG_BOOTMODE_ADDRESS=0x4C599634
CONFIG_DPRINTF_ADDRESS=0x4C441B40
CONFIG_ENVIRONMENT_SUPPORT=y
CONFIG_FASTBOOT_FAIL_ADDRESS=0x4C42DD34
CONFIG_FASTBOOT_INFO_ADDRESS=0x4C42DB94
CONFIG_FASTBOOT_OKAY_ADDRESS=0x4C42DFF0
CONFIG_FASTBOOT_PUBLISH_ADDRESS=0x4C42D740
CONFIG_FASTBOOT_REGISTER_ADDRESS=0x4C42D704
CONFIG_FREE_ADDRESS=0x4C441F70
CONFIG_GET_ENV_ADDRESS=0x4C45E460
CONFIG_INIT_STORAGE_ADDRESS=0x4C404264
CONFIG_INIT_STORAGE_CALLER=0x4C4046AC
CONFIG_LK_LOG_STORE_ADDRESS=0x4C45659C
CONFIG_MALLOC_ADDRESS=0x4C442848
CONFIG_MEDIATEK_MT6785=y
CONFIG_MTK_DETECT_KEY_ADDRESS=0x4C4062F0
CONFIG_PARTITION_GET_SIZE_BY_NAME_ADDRESS=0x4C45E13C
CONFIG_PARTITION_READ_ADDRESS=0x4C45F3B4
CONFIG_PLATFORM_INIT_ADDRESS=0x4C40467C
CONFIG_PLATFORM_INIT_CALLER=0x4C427F70
CONFIG_SET_ENV_ADDRESS=0x4C45E678
CONFIG_SPOOF_SUPPORT=y
CONFIG_STAGE1_SUPPORT=y
CONFIG_VIDEO_PRINTF_ADDRESS=0x4C42F37C
CONFIG_XIAOMI_ROSEMARY=y
```

## configs/xiaomi/ruby_defconfig
```kconfig
CONFIG_APP_ADDRESS=0x4822BC80
CONFIG_BOOTLOADER_BASE=0x48200000
CONFIG_BOOTLOADER_SIZE=0x1BF668
CONFIG_BOOTMODE_ADDRESS=0x483C25DC
CONFIG_DPRINTF_ADDRESS=0x48241BE0
CONFIG_ENVIRONMENT_SUPPORT=y
CONFIG_FASTBOOT_FAIL_ADDRESS=0x4822C930
CONFIG_FASTBOOT_INFO_ADDRESS=0x4822C8B0
CONFIG_FASTBOOT_OKAY_ADDRESS=0x4822CB1C
CONFIG_FASTBOOT_PUBLISH_ADDRESS=0x4822C3CC
CONFIG_FASTBOOT_REGISTER_ADDRESS=0x4822C390
CONFIG_FREE_ADDRESS=0x48242014
CONFIG_GET_ENV_ADDRESS=0x4825E530
CONFIG_INIT_STORAGE_ADDRESS=0x48203864
CONFIG_INIT_STORAGE_CALLER=0x48203A58
CONFIG_LK_LOG_STORE_ADDRESS=0x48256DDC
CONFIG_MALLOC_ADDRESS=0x482429D8
CONFIG_MEDIATEK_MT6877=y
CONFIG_MTK_DETECT_KEY_ADDRESS=0x48205804
CONFIG_PARTITION_GET_SIZE_BY_NAME_ADDRESS=0x4825E20C
CONFIG_PARTITION_READ_ADDRESS=0x4825F48C
CONFIG_PLATFORM_INIT_ADDRESS=0x48203A20
CONFIG_PLATFORM_INIT_CALLER=0x482278B2
CONFIG_XIAOMI_RUBY=y
CONFIG_SET_ENV_ADDRESS=0x4825E748
CONFIG_SPOOF_SUPPORT=y
CONFIG_STAGE1_SUPPORT=y
CONFIG_THREAD_CREATE_ADDRESS=0x48228074
CONFIG_VIDEO_PRINTF_ADDRESS=0x4822DAEC
```

## configs/zte/p662f02_defconfig
```kconfig
CONFIG_APP_ADDRESS=0x48025154
CONFIG_BOOTLOADER_BASE=0x48000000
CONFIG_BOOTLOADER_SIZE=0xBDB5C
CONFIG_BOOTMODE_ADDRESS=0x480C05D8
CONFIG_FASTBOOT_FAIL_ADDRESS=0x48026208
CONFIG_FASTBOOT_INFO_ADDRESS=0x480261AC
CONFIG_FASTBOOT_OKAY_ADDRESS=0x480263D4
CONFIG_FASTBOOT_PUBLISH_ADDRESS=0x48025EB8
CONFIG_FASTBOOT_REGISTER_ADDRESS=0x48025E7C
CONFIG_LK_LOG_STORE_ADDRESS=0x48040078
CONFIG_MTK_DETECT_KEY_ADDRESS=0x48004624
CONFIG_PLATFORM_INIT_ADDRESS=0x480027A0
CONFIG_PLATFORM_INIT_CALLER=0x48020824
CONFIG_VIDEO_PRINTF_ADDRESS=0x4802FF2C
CONFIG_ZTE_P662F02=y
CONFIG_MEDIATEK_MT6762=y
```

## lib/Kconfig
```kconfig
menu "Library Options"

menu "Framebuffer Support"
	config FRAMEBUFFER_SUPPORT
		bool "Enable framebuffer library support"
		default n
		help
		  Enable the framebuffer library for drawing graphics and text.
		  This adds support for basic shapes, text rendering, and UI elements.

		  Say Y unless you want to minimize binary size and don't need graphics.

	if FRAMEBUFFER_SUPPORT

	menu "Hardware Configuration"
		config FRAMEBUFFER_ADDRESS
			hex "Framebuffer base address"
			default 0x7F528000
			help
			  Base address of the framebuffer in memory.
			  This should be a valid memory address where the display
			  controller expects to find the pixel data.

		config FRAMEBUFFER_ALIGNMENT
			int "Framebuffer row alignment (bytes)"
			default 32
			help
			  Row alignment requirement for framebuffer.
			  Common values: 32, 64, 128, 256
			  64 bytes works for most MediaTek devices.
	endmenu

	menu "Display Properties"
		config FRAMEBUFFER_WIDTH
			int "Screen width in pixels"
			default 800
			help
			  Width of the display in pixels.

		config FRAMEBUFFER_HEIGHT
			int "Screen height in pixels"
			default 1280
			help
			  Height of the display in pixels.

		config FRAMEBUFFER_BPP
			int "Bits per pixel"
			default 32
			range 16 32
			help
			  Number of bits per pixel. Common values:
			  16 - RGB565 format
			  24 - RGB888 format
			  32 - ARGB8888 format (recommended)

		config FRAMEBUFFER_BYTES_PER_PIXEL
			int
			default 2 if FRAMEBUFFER_BPP = 16
			default 3 if FRAMEBUFFER_BPP = 24
			default 4 if FRAMEBUFFER_BPP = 32
			help
			  Calculated bytes per pixel based on BPP setting.
			  This is used internally for buffer calculations.
	endmenu

	choice
		prompt "Font selection"
		default FONT_8X8_BASIC
		help
		  Select the font to use for text rendering.

	config FONT_8X8_BASIC
		bool "8x8 Basic Font (IBM PC Compatible)"
		help
		  Standard 8x8 pixel font with full ASCII support.
		  Compatible with IBM PC character set.
		  Size: ~1KB

	config FONT_8X8_CALSTONE
		bool "8x8 Calstone Font"
		help
		  Stylized 8x8 pixel font with better visual appeal.
		  Good for retro/gaming aesthetic.
		  Size: ~1KB

	config FONT_8X8_COMIC_FANS
		bool "8x8 Comic Fans Font"
		help
		  Comic-style 8x8 pixel font with playful appearance.
		  Good for casual/fun interfaces.
		  Size: ~1KB

	endchoice

	endif
endmenu

endmenu

menu "Thread Support"
    config THREAD_SUPPORT
        bool "Create your own threads"
        default n
        help
          Say Y if you want to create your own threads

    config THREAD_CREATE_ADDRESS
        hex "Thread create address"
        depends on THREAD_SUPPORT
        help
          Address for thread creation function

    config THREAD_RESUME_ADDRESS
        hex "Thread resume address"
        depends on THREAD_SUPPORT
        help
          Address for thread resume function
endmenu

menu "Fastboot Support"
    menu "Fastboot Function Addresses"
        config FASTBOOT_FAIL_ADDRESS
            hex "Fastboot fail address"
            help
              Address of the fastboot_fail() function in the bootloader

        config FASTBOOT_INFO_ADDRESS
            hex "Fastboot info address"
            help
              Address of the fastboot_info() function in the bootloader

        config FASTBOOT_OKAY_ADDRESS
            hex "Fastboot okay address"
            help
              Address of the fastboot_okay() function in the bootloader

        config FASTBOOT_PUBLISH_ADDRESS
            hex "Fastboot publish address"
            help
              Address of the fastboot_publish() function in the bootloader

        config FASTBOOT_REGISTER_ADDRESS
            hex "Fastboot register address"
            help
              Address of the fastboot_register() function in the bootloader

        config USE_FASTBOOT_ACK
            bool "Use unified fastboot_ack() function"
            default n
            help
              Enable this for devices that use a single fastboot_ack()
              function instead of separate fastboot_okay(), fastboot_fail(),
              and fastboot_info() functions. The unified function takes two
              parameters: fastboot_ack(const char* type, const char* reason)
              where type is "OKAY", "FAIL", or "INFO".

        config FASTBOOT_ACK_ADDRESS
            hex "Fastboot ack address"
            depends on USE_FASTBOOT_ACK
            help
              Address of the fastboot_ack() function in the bootloader.
              Only needed when USE_FASTBOOT_ACK is enabled.
    endmenu
endmenu

menu "Memory and Address Mapping"
    menu "Bootloader Configuration"
        config BOOTLOADER_BASE
            hex "LK load address"
            help
              Base address where the LK bootloader is loaded in memory

        config BOOTLOADER_SIZE
            hex "LK size"
            help
              Size of the LK bootloader in memory

        config BOOTMODE_ADDRESS
            hex "Bootmode address"
            help
              Address where boot mode information is stored
    endmenu

    menu "Platform Function Addresses"
        config PLATFORM_INIT_CALLER
            hex "platform_init()'s caller address"
            help
              Address of the function that calls platform_init()

        config PLATFORM_INIT_ADDRESS
            hex "platform_init() address"
            help
              Address of the platform_init() function

        config APP_CALLER
            hex "app()'s caller address"
            help
              Address of the function that calls app()

        config APP_ADDRESS
            hex "app() address"
            help
              Address of the app() function

        config MTK_DETECT_KEY_ADDRESS
            hex "mtk_detect_key() address"
            help
              Address of the mtk_detect_key() function for key detection

        config VIDEO_PRINTF_ADDRESS
            hex "video_printf() address"
            help
              Address of the video_printf() function for display output
    endmenu
endmenu

menu "Logging Options"
    config LK_LOG_STORE
        bool "Enable LK Log Store"
        default y
        help
          Say Y to enable additional log storage mechanism.
          This allows accessing bootloader logs from the running system.

    config LK_LOG_STORE_ADDRESS
        hex "LK Log Store Address"
        depends on LK_LOG_STORE
        help
          Address of the lk_log_store() function in the bootloader
endmenu

menu "Third party libraries"
    config LIBSEJ_SUPPORT
        bool "Enable libsej support"
        default n
        help
          Say Y to enable libsej support, allowing to interact with
          the device crypto engine.
endmenu
```

## soc/Kconfig
```kconfig
menu "SoC Support"

choice
    prompt "MediaTek SoC"
    help
        Select the MediaTek SoC used in your device.

config MEDIATEK_MT6572
    bool "MediaTek MT6572 SoC"

config MEDIATEK_MT6737
    bool "MediaTek MT6737 SoC"

config MEDIATEK_MT6739
    bool "MediaTek MT6739 SoC"

config MEDIATEK_MT6750
    bool "MediaTek MT6750 SoC"

config MEDIATEK_MT6757
    bool "MediaTek MT6757 SoC"

config MEDIATEK_MT6761
    bool "MediaTek MT6761 SoC"
    
config MEDIATEK_MT6762
    bool "MediaTek MT6762 SoC"

config MEDIATEK_MT6765
    bool "MediaTek MT6765 SoC"

config MEDIATEK_MT6768
    bool "MediaTek MT6768 SoC"

config MEDIATEK_MT6771
    bool "MediaTek MT6771 SoC"

config MEDIATEK_MT6781
    bool "MediaTek MT6781 SoC"

config MEDIATEK_MT6785
    bool "MediaTek MT6785 SoC"

config MEDIATEK_MT6797
    bool "MediaTek MT6797 SoC"

config MEDIATEK_MT8127
    bool "MediaTek MT8127 SoC"

config MEDIATEK_MT8163
    bool "MediaTek MT8163 SoC"

config MEDIATEK_MT8168
    bool "MediaTek MT8168 SoC"

config MEDIATEK_MT8516
    bool "MediaTek MT8516 SoC"

config MEDIATEK_MT6833
    bool "MediaTek MT6833 SoC"

config MEDIATEK_MT6877
    bool "MediaTek MT6877 SoC"

endchoice

config UART_BASE
    hex "UART base address"
    default 0x11005000 if MEDIATEK_MT6572
    default 0x11002000 if MEDIATEK_MT6750
    default 0x11002000 if MEDIATEK_MT6757
    default 0x11002000 if MEDIATEK_MT6761
    default 0x11002000 if MEDIATEK_MT6762
    default 0x11002000 if MEDIATEK_MT6765
    default 0x11002000 if MEDIATEK_MT6768
    default 0x11002000 if MEDIATEK_MT6737
    default 0x11002000 if MEDIATEK_MT6739
    default 0x11002000 if MEDIATEK_MT6781
    default 0x11002000 if MEDIATEK_MT6785
    default 0x11002000 if MEDIATEK_MT6771
    default 0x11002000 if MEDIATEK_MT6797
    default 0x11002000 if MEDIATEK_MT8127
    default 0x11002000 if MEDIATEK_MT8163
    default 0x11005000 if MEDIATEK_MT8516
    default 0x11002000 if MEDIATEK_MT6833
    default 0x11002000 if MEDIATEK_MT6877
    default 0x11002000 if MEDIATEK_MT8168

config WDT_BASE
    hex "Watchdog timer base address"
    default 0x10007000 if MEDIATEK_MT6572
    default 0x10212000 if MEDIATEK_MT6737
    default 0x10007000 if MEDIATEK_MT6739
    default 0x10007000 if MEDIATEK_MT6750
    default 0x10007000 if MEDIATEK_MT6757
    default 0x10007000 if MEDIATEK_MT6761
    default 0x10007000 if MEDIATEK_MT6762
    default 0x10007000 if MEDIATEK_MT6765
    default 0x10007000 if MEDIATEK_MT6768
    default 0x10007000 if MEDIATEK_MT6771
    default 0x10007000 if MEDIATEK_MT6781
    default 0x10007000 if MEDIATEK_MT6785
    default 0x10007000 if MEDIATEK_MT6797
    default 0x10007000 if MEDIATEK_MT8127
    default 0x10007000 if MEDIATEK_MT8163
    default 0x10007000 if MEDIATEK_MT8168
    default 0x10007000 if MEDIATEK_MT8516
    default 0x10007000 if MEDIATEK_MT6833
    default 0x10007000 if MEDIATEK_MT6877

endmenu
```
