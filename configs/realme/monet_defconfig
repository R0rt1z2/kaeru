## configs/realme/monet_defconfig
```kconfig
CONFIG_APP_ADDRESS=0x4C4247B0
CONFIG_BOOTLOADER_BASE=0x4C400000
CONFIG_BOOTLOADER_SIZE=0x103934
CONFIG_BOOTMODE_ADDRESS=0x4C506528
CONFIG_FASTBOOT_FAIL_ADDRESS=0x4C4252A0
CONFIG_FASTBOOT_INFO_ADDRESS=0x4C425220
CONFIG_FASTBOOT_OKAY_ADDRESS=0x4C42546C
CONFIG_FASTBOOT_PUBLISH_ADDRESS=0x4C424EAC
CONFIG_FASTBOOT_REGISTER_ADDRESS=0x4C424E70
CONFIG_LK_LOG_STORE_ADDRESS=0x4C44370C
CONFIG_MTK_DETECT_KEY_ADDRESS=0x4C40462C
CONFIG_PLATFORM_INIT_ADDRESS=0x4C4027D0
CONFIG_PLATFORM_INIT_CALLER=0x4C4201E0
CONFIG_VIDEO_PRINTF_ADDRESS=0x4C430C58
CONFIG_REALME_MONET=y
CONFIG_MEDIATEK_MT6768=y
```

## configs/realme/nemo_defconfig
```kconfig
CONFIG_APP_ADDRESS=0x4C42581C
CONFIG_BOOTLOADER_BASE=0x4C400000
CONFIG_BOOTLOADER_SIZE=0x1169B0
CONFIG_BOOTMODE_ADDRESS=0x4C5195BC
CONFIG_FASTBOOT_FAIL_ADDRESS=0x4C42630C
CONFIG_FASTBOOT_INFO_ADDRESS=0x4C42628C
CONFIG_FASTBOOT_OKAY_ADDRESS=0x4C4264D8
CONFIG_FASTBOOT_PUBLISH_ADDRESS=0x4C425F18
CONFIG_FASTBOOT_REGISTER_ADDRESS=0x4C425EDC
CONFIG_MEDIATEK_MT6785=y
CONFIG_MTK_DETECT_KEY_ADDRESS=0x4C4050F0
CONFIG_PLATFORM_INIT_ADDRESS=0x4C4032D8
CONFIG_PLATFORM_INIT_CALLER=0x4C421274
CONFIG_REALME_NEMO=y
CONFIG_VIDEO_PRINTF_ADDRESS=0x4C431F68
```

## configs/realme/rmx2180_defconfig
```kconfig
CONFIG_APP_CALLER=0x48022780
CONFIG_BOOTLOADER_BASE=0x48000000
CONFIG_BOOTLOADER_SIZE=0x27BBC8
CONFIG_FASTBOOT_FAIL_ADDRESS=0x480264C0
CONFIG_FASTBOOT_INFO_ADDRESS=0x48026464
CONFIG_FASTBOOT_OKAY_ADDRESS=0x4802668C
CONFIG_FASTBOOT_PUBLISH_ADDRESS=0x48026170
CONFIG_FASTBOOT_REGISTER_ADDRESS=0x48026134
CONFIG_LK_LOG_STORE_ADDRESS=0x48042F60
CONFIG_PLATFORM_INIT_ADDRESS=0x48002C80
CONFIG_THREAD_CREATE_ADDRESS=0x48021818
CONFIG_THREAD_RESUME_ADDRESS=0x48021A2C
CONFIG_VIDEO_PRINTF_ADDRESS=0x48031FC8
CONFIG_MTK_DETECT_KEY_ADDRESS=0x48004f4c
CONFIG_APP_ADDRESS=0x48025bec
CONFIG_PLATFORM_INIT_CALLER=0x4802105c
CONFIG_BOOTMODE_ADDRESS=0x4827e9e8
CONFIG_REALME_RMX2180=y
CONFIG_MEDIATEK_MT6765=y
CONFIG_THREAD_SUPPORT=y
CONFIG_STAGE1_SUPPORT=y
CONFIG_LEGACY_LK=n
CONFIG_FREE_ADDRESS=0x48032678
CONFIG_MALLOC_ADDRESS=0x48032ebc
CONFIG_PARTITION_READ_ADDRESS=0x4804b9f0
CONFIG_PARTITION_GET_SIZE_BY_NAME_ADDRESS=0x4804a840
CONFIG_DPRINTF_ADDRESS=0x480322b8
CONFIG_INIT_STORAGE_CALLER=0x48002cb0
CONFIG_INIT_STORAGE_ADDRESS=0x480028e4

CONFIG_FRAMEBUFFER_SUPPORT=y
CONFIG_FRAMEBUFFER_ADDRESS=0x7b890000
CONFIG_FRAMEBUFFER_WIDTH=720
CONFIG_FRAMEBUFFER_HEIGHT=1600
CONFIG_FRAMEBUFFER_BPP=32
CONFIG_FRAMEBUFFER_ALIGNMENT=128
```

## configs/realme/spaced_defconfig
```kconfig
CONFIG_APP_ADDRESS=0x4C42B634
CONFIG_BOOTLOADER_BASE=0x4C400000
CONFIG_BOOTLOADER_SIZE=0x135668
CONFIG_DPRINTF_ADDRESS=0x4C43E5BC
CONFIG_FASTBOOT_FAIL_ADDRESS=0x4C42C208
CONFIG_FASTBOOT_INFO_ADDRESS=0x4C42C188
CONFIG_FASTBOOT_OKAY_ADDRESS=0x4C42C3D4
CONFIG_FASTBOOT_PUBLISH_ADDRESS=0x4C42BD34
CONFIG_FASTBOOT_REGISTER_ADDRESS=0x4C42BCF8
CONFIG_FREE_ADDRESS=0x4C43E9EC
CONFIG_INIT_STORAGE_CALLER=0x4C402BB2
CONFIG_LK_LOG_STORE_ADDRESS=0x4C452920
CONFIG_MALLOC_ADDRESS=0x4C43F2C4
CONFIG_MTK_DETECT_KEY_ADDRESS=0x4C4049CC
CONFIG_PARTITION_READ_ADDRESS=0x4C45A494
CONFIG_PLATFORM_INIT_ADDRESS=0x4C402B84
CONFIG_THREAD_CREATE_ADDRESS=0x4C427294
CONFIG_THREAD_RESUME_ADDRESS=0x4C4274A8
CONFIG_THREAD_SUPPORT=y
CONFIG_VIDEO_PRINTF_ADDRESS=0x4C43DF54
CONFIG_REALME_SPACED=y
CONFIG_MEDIATEK_MT6781=y
CONFIG_BOOTMODE_ADDRESS=0x4C5385A0
CONFIG_PLATFORM_INIT_CALLER=0x4C426AD8
CONFIG_ENVIRONMENT_SUPPORT=y
CONFIG_SPOOF_SUPPORT=y
CONFIG_GET_ENV_ADDRESS=0x4C459598
CONFIG_SET_ENV_ADDRESS=0x4C4597B0
CONFIG_STAGE1_SUPPORT=y
CONFIG_LEGACY_LK=n
CONFIG_INIT_STORAGE_ADDRESS=0x4c402878
CONFIG_PARTITION_GET_SIZE_BY_NAME_ADDRESS=0x4c458db0
```

## configs/rosemary_defconfig
```kconfig
CONFIG_APP_CALLER=0x4C4224F4
CONFIG_APP_ADDRESS=0x4C425EA4
CONFIG_BOOTLOADER_BASE=0x4C400000
CONFIG_BOOTLOADER_SIZE=0x189680
CONFIG_BOOTMODE_ADDRESS=0x4C58C61C
CONFIG_FASTBOOT_INFO_ADDRESS=0x4C426A9C
CONFIG_FASTBOOT_FAIL_ADDRESS=0x4C426C3C
CONFIG_FASTBOOT_OKAY_ADDRESS=0x4C426EF8
CONFIG_FASTBOOT_PUBLISH_ADDRESS=0x4C426648
CONFIG_FASTBOOT_REGISTER_ADDRESS=0x4C42660C
CONFIG_LK_LOG_STORE_ADDRESS=0x4C44E104
CONFIG_MTK_DETECT_KEY_ADDRESS=0x4C405440
CONFIG_PLATFORM_INIT_ADDRESS=0x4C4038C0
CONFIG_PLATFORM_INIT_CALLER=0x4C420E50
CONFIG_VIDEO_PRINTF_ADDRESS=0x4C42827C
CONFIG_XIAOMI_ROSEMARY=y
CONFIG_MEDIATEK_MT6785=y
```

## configs/samsung/gta7lite_defconfig
```kconfig
CONFIG_APP_ADDRESS=0x480380CC
CONFIG_BOOTLOADER_BASE=0x48000000
CONFIG_BOOTLOADER_SIZE=0x14E12C
CONFIG_BOOTMODE_ADDRESS=0x481515E4
CONFIG_CERT_BYPASS=y
CONFIG_DPRINTF_ADDRESS=0x48042480
CONFIG_FASTBOOT_FAIL_ADDRESS=0x4802DB90
CONFIG_FASTBOOT_INFO_ADDRESS=0x4802DB10
CONFIG_FASTBOOT_OKAY_ADDRESS=0x4802DD5C
CONFIG_FASTBOOT_PUBLISH_ADDRESS=0x4802D8F4
CONFIG_FASTBOOT_REGISTER_ADDRESS=0x4802D8B8
CONFIG_FREE_ADDRESS=0x480428D8
CONFIG_INIT_STORAGE_ADDRESS=0x48002A7C
CONFIG_INIT_STORAGE_CALLER=0x48002CC0
CONFIG_LK_LOG_STORE_ADDRESS=0x48068FD4
CONFIG_MALLOC_ADDRESS=0x48058814
CONFIG_MEDIATEK_MT6765=y
CONFIG_MTK_DETECT_KEY_ADDRESS=0x480050FC
CONFIG_PARTITION_GET_SIZE_BY_NAME_ADDRESS=0x4806F7C4
CONFIG_PARTITION_READ_ADDRESS=0x48070A60
CONFIG_PLATFORM_INIT_ADDRESS=0x48002C70
CONFIG_PLATFORM_INIT_CALLER=0x4802C714
CONFIG_SAMSUNG_GTA7LITE=y
CONFIG_STAGE1_SUPPORT=y
CONFIG_THREAD_CREATE_ADDRESS=0x4802CA98
CONFIG_THREAD_RESUME_ADDRESS=0x4802CC2C
CONFIG_VIDEO_PRINTF_ADDRESS=0x48042028
```

## configs/sony/canopy_defconfig
```kconfig
CONFIG_APP_ADDRESS=0x4602E264
CONFIG_BOOTLOADER_BASE=0x46000000
CONFIG_BOOTLOADER_SIZE=0xB1700
CONFIG_BOOTMODE_ADDRESS=0x460B4110
CONFIG_DPRINTF_ADDRESS=0x46034A7C
CONFIG_FASTBOOT_FAIL_ADDRESS=0x4602ECE8
CONFIG_FASTBOOT_INFO_ADDRESS=0x4602EC84
CONFIG_FASTBOOT_OKAY_ADDRESS=0x4602EE44
CONFIG_FASTBOOT_PUBLISH_ADDRESS=0x4602EA94
CONFIG_FASTBOOT_REGISTER_ADDRESS=0x4602EA58
CONFIG_FREE_ADDRESS=0x46034E78
CONFIG_INIT_STORAGE_ADDRESS=0x46005B64
CONFIG_INIT_STORAGE_CALLER=0x4600203C
CONFIG_LEGACY_LK=y
CONFIG_LK_LOG_STORE_ADDRESS=0x4600098C
CONFIG_MALLOC_ADDRESS=0x46035774
CONFIG_MEDIATEK_MT6757=y
CONFIG_MT_PART_GET_DEVICE_ADDRESS=0x460265D8
CONFIG_MT_PART_GET_PARTITION_ADDRESS=0x4600423C
CONFIG_MTK_DETECT_KEY_ADDRESS=0x460048BC
CONFIG_PLATFORM_INIT_ADDRESS=0x46002000
CONFIG_PLATFORM_INIT_CALLER=0x460279CC
CONFIG_SONY_CANOPY=y
CONFIG_STAGE1_SUPPORT=y
CONFIG_VIDEO_PRINTF_ADDRESS=0x460347BC
```

## configs/tdtech/oceant_defconfig
```kconfig
CONFIG_APP_ADDRESS=0x4824A250
CONFIG_BOOTLOADER_BASE=0x48200000
CONFIG_BOOTLOADER_SIZE=0x19DF38
CONFIG_BOOTMODE_ADDRESS=0x483A1168
CONFIG_DPRINTF_ADDRESS=0x48279478
CONFIG_FASTBOOT_FAIL_ADDRESS=0x4824ABC0
CONFIG_FASTBOOT_INFO_ADDRESS=0x4824AB64
CONFIG_FASTBOOT_OKAY_ADDRESS=0x4824AD38
CONFIG_FASTBOOT_PUBLISH_ADDRESS=0x4824A8C0
CONFIG_FASTBOOT_REGISTER_ADDRESS=0x4824A884
CONFIG_FREE_ADDRESS=0x4827A8DC
CONFIG_INIT_STORAGE_ADDRESS=0x482113A0
CONFIG_INIT_STORAGE_CALLER=0x482114A4
CONFIG_LK_LOG_STORE_ADDRESS=0x48291AD4
CONFIG_MALLOC_ADDRESS=0x4827B2C0
CONFIG_MEDIATEK_MT6889=y
CONFIG_MTK_DETECT_KEY_ADDRESS=0x482131C4
CONFIG_PARTITION_GET_SIZE_BY_NAME_ADDRESS=0x4829BE7C
CONFIG_PARTITION_READ_ADDRESS=0x4829D7D0
CONFIG_PLATFORM_INIT_ADDRESS=0x48211470
CONFIG_PLATFORM_INIT_CALLER=0x4823F014
CONFIG_STAGE1_SUPPORT=y
CONFIG_TDTECH_OCEANT=y
CONFIG_THREAD_CREATE_ADDRESS=0x4823F39C
CONFIG_THREAD_RESUME_ADDRESS=0x4823F530
CONFIG_VIDEO_PRINTF_ADDRESS=0x48278DA0
```

## configs/vivo/y7s_defconfig
```kconfig
CONFIG_APP_ADDRESS=0x4C4247E0
CONFIG_BOOTLOADER_BASE=0x4C400000
CONFIG_BOOTLOADER_SIZE=0x42954C
CONFIG_BOOTMODE_ADDRESS=0x4C82C534
CONFIG_DPRINTF_ADDRESS=0x4C42EC74
CONFIG_FASTBOOT_FAIL_ADDRESS=0x4C425910
CONFIG_FASTBOOT_INFO_ADDRESS=0x4C4258B4
CONFIG_FASTBOOT_OKAY_ADDRESS=0x4C425ADC
CONFIG_FASTBOOT_PUBLISH_ADDRESS=0x4C4255C0
CONFIG_FASTBOOT_REGISTER_ADDRESS=0x4C425584
CONFIG_FREE_ADDRESS=0x4C42F034
CONFIG_INIT_STORAGE_ADDRESS=0x4C402524
CONFIG_INIT_STORAGE_CALLER=0x4C402742
CONFIG_LK_LOG_STORE_ADDRESS=0x4C43F624
CONFIG_MALLOC_ADDRESS=0x4C419384
CONFIG_MEDIATEK_MT6768=y
CONFIG_MTK_DETECT_KEY_ADDRESS=0x4C4043B8
CONFIG_PARTITION_GET_SIZE_BY_NAME_ADDRESS=0x4C445E10
CONFIG_PARTITION_READ_ADDRESS=0x4C446E0C
CONFIG_PLATFORM_INIT_ADDRESS=0x4C402714
CONFIG_PLATFORM_INIT_CALLER=0x4C42098C
CONFIG_STAGE1_SUPPORT=y
CONFIG_THREAD_CREATE_ADDRESS=0x4C421148
CONFIG_THREAD_RESUME_ADDRESS=0x4C42135C
CONFIG_VIDEO_PRINTF_ADDRESS=0x4C42E984
CONFIG_VIVO_Y7S=y
```

## configs/volla/mimameid_defconfig
```kconfig
CONFIG_APP_ADDRESS=0x4C4523B4
CONFIG_APP_CALLER=0x4C44D804
CONFIG_BOOTLOADER_BASE=0x4C400000
CONFIG_BOOTLOADER_SIZE=0x17DBCC
CONFIG_BOOTMODE_ADDRESS=0x4c6807f0
CONFIG_FASTBOOT_FAIL_ADDRESS=0x4C453130
CONFIG_FASTBOOT_INFO_ADDRESS=0x4C4530B0
CONFIG_FASTBOOT_OKAY_ADDRESS=0x4C453300
CONFIG_FASTBOOT_PUBLISH_ADDRESS=0x4C452D3C
CONFIG_FASTBOOT_REGISTER_ADDRESS=0x4C452D00
CONFIG_LK_LOG_STORE_ADDRESS=0x4C473D8C
CONFIG_MTK_DETECT_KEY_ADDRESS=0x4C42BE5C
CONFIG_PLATFORM_INIT_ADDRESS=0x4C42A5C4
CONFIG_PLATFORM_INIT_CALLER=0x4c44c160
CONFIG_VIDEO_PRINTF_ADDRESS=0x4C45F094
CONFIG_VOLLA_MIMAMEID=y
CONFIG_MEDIATEK_MT6768=y
```

## configs/xiaomi/begonia_defconfig
```kconfig
CONFIG_APP_ADDRESS=0x4C423858
CONFIG_BOOTLOADER_BASE=0x4C400000
CONFIG_BOOTLOADER_SIZE=0x172A28
CONFIG_BOOTMODE_ADDRESS=0x4C5755BC
CONFIG_CERT_BYPASS=y
CONFIG_CERT_BYPASS_MODE="wrap"
CONFIG_DPRINTF_ADDRESS=0x4C436D94
CONFIG_ENVIRONMENT_SUPPORT=y
CONFIG_FASTBOOT_FAIL_ADDRESS=0x4C4244A8
CONFIG_FASTBOOT_INFO_ADDRESS=0x4C424428
CONFIG_FASTBOOT_OKAY_ADDRESS=0x4C4246AC
CONFIG_FASTBOOT_PUBLISH_ADDRESS=0x4C423F44
CONFIG_FASTBOOT_REGISTER_ADDRESS=0x4C423F08
CONFIG_FREE_ADDRESS=0x4C437A9C
CONFIG_GET_ENV_ADDRESS=0x4C450A54
CONFIG_INIT_STORAGE_ADDRESS=0x4C402D04
CONFIG_INIT_STORAGE_CALLER=0x4C402F8E
CONFIG_LK_LOG_STORE_ADDRESS=0x4C4497EC
CONFIG_MALLOC_ADDRESS=0x4C437A9C
CONFIG_MEDIATEK_MT6785=y
CONFIG_MTK_DETECT_KEY_ADDRESS=0x4C404D34
CONFIG_PARTITION_GET_SIZE_BY_NAME_ADDRESS=0x4C4507C0
CONFIG_PARTITION_READ_ADDRESS=0x4C452000
CONFIG_PLATFORM_INIT_ADDRESS=0x4C402F58
CONFIG_PLATFORM_INIT_CALLER=0x4C41F8FC
CONFIG_SET_ENV_ADDRESS=0x4C450CD8
CONFIG_SPOOF_SUPPORT=y
CONFIG_STAGE1_SUPPORT=y
CONFIG_VIDEO_PRINTF_ADDRESS=0x4C436758
CONFIG_XIAOMI_BEGONIA=y
```

## configs/xiaomi/dandelion_defconfig
```kconfig
CONFIG_APP_ADDRESS=0x48024374
CONFIG_APP_CALLER=0x48020F28
CONFIG_BOOTLOADER_BASE=0x48000000
CONFIG_BOOTLOADER_SIZE=0x132CE0
CONFIG_BOOTMODE_ADDRESS=0x481355E4
CONFIG_FASTBOOT_FAIL_ADDRESS=0x48024ED8
CONFIG_FASTBOOT_INFO_ADDRESS=0x48024D5C
CONFIG_FASTBOOT_OKAY_ADDRESS=0x480250B8
CONFIG_FASTBOOT_PUBLISH_ADDRESS=0x48024A68
CONFIG_FASTBOOT_REGISTER_ADDRESS=0x48024A2C
CONFIG_LK_LOG_STORE_ADDRESS=0x4804484C
CONFIG_MTK_DETECT_KEY_ADDRESS=0x48004A84
CONFIG_PLATFORM_INIT_ADDRESS=0x480029AC
CONFIG_PLATFORM_INIT_CALLER=0x4801F804
CONFIG_VIDEO_PRINTF_ADDRESS=0x48026A18
CONFIG_XIAOMI_DANDELION=y
CONFIG_MEDIATEK_MT6765=y
```

## configs/xiaomi/earth_defconfig
```kconfig
CONFIG_APP_ADDRESS=0x4C429C3C
CONFIG_BOOTLOADER_BASE=0x4C400000
CONFIG_BOOTLOADER_SIZE=0x16AA10
CONFIG_BOOTMODE_ADDRESS=0x4C56D5A0
CONFIG_DPRINTF_ADDRESS=0x4C43ADF4
CONFIG_ENVIRONMENT_SUPPORT=y
CONFIG_FASTBOOT_FAIL_ADDRESS=0x4C42A8C8
CONFIG_FASTBOOT_INFO_ADDRESS=0x4C42A728
CONFIG_FASTBOOT_OKAY_ADDRESS=0x4C42ABA0
CONFIG_FASTBOOT_PUBLISH_ADDRESS=0x4C42A3B4
CONFIG_FASTBOOT_REGISTER_ADDRESS=0x4C42A378
CONFIG_FREE_ADDRESS=0x4C43B224
CONFIG_GET_ENV_ADDRESS=0x4C456C00
CONFIG_INIT_STORAGE_ADDRESS=0x4C403790
CONFIG_INIT_STORAGE_CALLER=0x4C4039AA
CONFIG_LK_LOG_STORE_ADDRESS=0x4C44FDAC
CONFIG_MALLOC_ADDRESS=0x4C43BAF0
CONFIG_MEDIATEK_MT6768=y
CONFIG_MTK_DETECT_KEY_ADDRESS=0x4C4054AC
CONFIG_PARTITION_GET_SIZE_BY_NAME_ADDRESS=0x4C4568DC
CONFIG_PARTITION_READ_ADDRESS=0x4C4583A4
CONFIG_PLATFORM_INIT_ADDRESS=0x4C40397C
CONFIG_PLATFORM_INIT_CALLER=0x4C425A1C
CONFIG_SET_ENV_ADDRESS=0x4C456E18
CONFIG_SPOOF_SUPPORT=y
CONFIG_STAGE1_SUPPORT=y
CONFIG_THREAD_CREATE_ADDRESS=0x4C4261D8
CONFIG_THREAD_RESUME_ADDRESS=0x4C4263EC
CONFIG_VIDEO_PRINTF_ADDRESS=0x4C42CA90
CONFIG_XIAOMI_EARTH=y
```

## configs/xiaomi/fleur_defconfig
```kconfig
CONFIG_APP_ADDRESS=0x4C4295C8
CONFIG_BOOTLOADER_BASE=0x4C400000
CONFIG_BOOTLOADER_SIZE=0x1786A0
CONFIG_BOOTMODE_ADDRESS=0x4C57B5A8
CONFIG_DPRINTF_ADDRESS=0x4C43E998
CONFIG_ENVIRONMENT_SUPPORT=y
CONFIG_FASTBOOT_FAIL_ADDRESS=0x4C42A370
CONFIG_FASTBOOT_INFO_ADDRESS=0x4C42A1D0
CONFIG_FASTBOOT_OKAY_ADDRESS=0x4C42A564
CONFIG_FASTBOOT_PUBLISH_ADDRESS=0x4C429D7C
CONFIG_FASTBOOT_REGISTER_ADDRESS=0x4C429D40
CONFIG_FREE_ADDRESS=0x4C43EDC8
CONFIG_GET_ENV_ADDRESS=0x4C45A750
CONFIG_INIT_STORAGE_ADDRESS=0x4C402680
CONFIG_INIT_STORAGE_CALLER=0x4C4029D8
CONFIG_LK_LOG_STORE_ADDRESS=0x4C4532D4
CONFIG_MALLOC_ADDRESS=0x4C43F6A0
CONFIG_MEDIATEK_MT6781=y
CONFIG_MTK_DETECT_KEY_ADDRESS=0x4C4044B4
CONFIG_PARTITION_GET_SIZE_BY_NAME_ADDRESS=0x4C45A42C
CONFIG_PARTITION_READ_ADDRESS=0x4C45BDD0
CONFIG_PLATFORM_INIT_ADDRESS=0x4C4029A8
CONFIG_PLATFORM_INIT_CALLER=0x4C424824
CONFIG_SET_ENV_ADDRESS=0x4C45A968
CONFIG_SPOOF_SUPPORT=y
CONFIG_STAGE1_SUPPORT=y
CONFIG_THREAD_CREATE_ADDRESS=0x4C424FE0
CONFIG_THREAD_RESUME_ADDRESS=0x4C4251F4
CONFIG_VIDEO_PRINTF_ADDRESS=0x4C42BAA0
CONFIG_XIAOMI_FLEUR=y
```

## configs/xiaomi/lancelot_defconfig
```kconfig
CONFIG_APP_ADDRESS=0x4C429A78
CONFIG_BOOTLOADER_BASE=0x4C400000
CONFIG_BOOTLOADER_SIZE=0xFD884
CONFIG_BOOTMODE_ADDRESS=0x4C5005B0
CONFIG_CERT_BYPASS=y
CONFIG_CERT_BYPASS_MODE="wrap"
CONFIG_DPRINTF_ADDRESS=0x4C43E1F8
CONFIG_ENVIRONMENT_SUPPORT=y
CONFIG_FASTBOOT_FAIL_ADDRESS=0x4C42A798
CONFIG_FASTBOOT_INFO_ADDRESS=0x4C42A718
CONFIG_FASTBOOT_OKAY_ADDRESS=0x4C42AA40
CONFIG_FASTBOOT_PUBLISH_ADDRESS=0x4C42A2C4
CONFIG_FASTBOOT_REGISTER_ADDRESS=0x4C42A288
CONFIG_FREE_ADDRESS=0x4C43E628
CONFIG_GET_ENV_ADDRESS=0x4C457E28
CONFIG_INIT_STORAGE_ADDRESS=0x4C4038B8
CONFIG_INIT_STORAGE_CALLER=0x4C403D88
CONFIG_LK_LOG_STORE_ADDRESS=0x4C451230
CONFIG_MALLOC_ADDRESS=0x4C43EEF4
CONFIG_MEDIATEK_MT6768=y
CONFIG_MTK_DETECT_KEY_ADDRESS=0x4C405A24
CONFIG_PARTITION_GET_SIZE_BY_NAME_ADDRESS=0x4C457B04
CONFIG_PARTITION_READ_ADDRESS=0x4C4594CC
CONFIG_PLATFORM_INIT_ADDRESS=0x4C403D58
CONFIG_PLATFORM_INIT_CALLER=0x4C425AB8
CONFIG_SET_ENV_ADDRESS=0x4C458040
CONFIG_SPOOF_SUPPORT=y
CONFIG_STAGE1_SUPPORT=y
CONFIG_THREAD_CREATE_ADDRESS=0x4C426274
CONFIG_THREAD_RESUME_ADDRESS=0x4C426488
CONFIG_VIDEO_PRINTF_ADDRESS=0x4C43DC80
CONFIG_XIAOMI_LANCELOT=y
```

## configs/xiaomi/merlin_defconfig
```kconfig
CONFIG_APP_ADDRESS=0x4C429C64
CONFIG_BOOTLOADER_BASE=0x4C400000
CONFIG_BOOTLOADER_SIZE=0xFD884
CONFIG_BOOTMODE_ADDRESS=0x4C5005B0
CONFIG_CERT_BYPASS=y
CONFIG_CERT_BYPASS_MODE="wrap"
CONFIG_DPRINTF_ADDRESS=0x4C43E0BC
CONFIG_ENVIRONMENT_SUPPORT=y
CONFIG_FASTBOOT_FAIL_ADDRESS=0x4C42A904
CONFIG_FASTBOOT_INFO_ADDRESS=0x4C42A884
CONFIG_FASTBOOT_OKAY_ADDRESS=0x4C42ABAC
CONFIG_FASTBOOT_PUBLISH_ADDRESS=0x4C42A430
CONFIG_FASTBOOT_REGISTER_ADDRESS=0x4C42A3F4
CONFIG_FREE_ADDRESS=0x4C43E4EC
CONFIG_GET_ENV_ADDRESS=0x4C457CEC
CONFIG_INIT_STORAGE_ADDRESS=0x4C4038B8
CONFIG_INIT_STORAGE_CALLER=0x4C403AE8
CONFIG_LK_LOG_STORE_ADDRESS=0x4C4510F4
CONFIG_MALLOC_ADDRESS=0x4C43EDB8
CONFIG_MEDIATEK_MT6768=y
CONFIG_MTK_DETECT_KEY_ADDRESS=0x4C4056AC
CONFIG_PARTITION_GET_SIZE_BY_NAME_ADDRESS=0x4C4579C8
CONFIG_PARTITION_READ_ADDRESS=0x4C45938C
CONFIG_PLATFORM_INIT_ADDRESS=0x4C403AB8
CONFIG_PLATFORM_INIT_CALLER=0x4C425920
CONFIG_SET_ENV_ADDRESS=0x4C457F04
CONFIG_SPOOF_SUPPORT=y
CONFIG_STAGE1_SUPPORT=y
CONFIG_THREAD_CREATE_ADDRESS=0x4C4260DC
CONFIG_THREAD_RESUME_ADDRESS=0x4C4262F0
CONFIG_VIDEO_PRINTF_ADDRESS=0x4C43DC80
CONFIG_XIAOMI_MERLIN=y
```
