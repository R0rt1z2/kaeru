## configs/oukitel/rt6_defconfig
```kconfig
CONFIG_APP_ADDRESS=0x56025CD0
CONFIG_BOOTLOADER_BASE=0x56000000
CONFIG_BOOTLOADER_SIZE=0xBC70C
CONFIG_BOOTMODE_ADDRESS=0x560BF518
CONFIG_FASTBOOT_FAIL_ADDRESS=0x56026678
CONFIG_FASTBOOT_INFO_ADDRESS=0x560265F8
CONFIG_FASTBOOT_OKAY_ADDRESS=0x56026844
CONFIG_FASTBOOT_PUBLISH_ADDRESS=0x56026284
CONFIG_FASTBOOT_REGISTER_ADDRESS=0x56026248
CONFIG_LK_LOG_STORE_ADDRESS=0x56042EB4
CONFIG_MTK_DETECT_KEY_ADDRESS=0x56004568
CONFIG_PLATFORM_INIT_ADDRESS=0x56002B7C
CONFIG_PLATFORM_INIT_CALLER=0x56021E5C
CONFIG_VIDEO_PRINTF_ADDRESS=0x56032224
CONFIG_OUKITEL_RT6=y
CONFIG_MEDIATEK_MT6771=y
```

## configs/oukitel/wp56_defconfig
```kconfig
CONFIG_APP_ADDRESS=0x4822AB8C
CONFIG_BOOTLOADER_BASE=0x48200000
CONFIG_BOOTLOADER_SIZE=0x15F288
CONFIG_BOOTMODE_ADDRESS=0x483625D4
CONFIG_DPRINTF_ADDRESS=0x4823D8C4
CONFIG_ENVIRONMENT_SUPPORT=y
CONFIG_FASTBOOT_FAIL_ADDRESS=0x4822B66C
CONFIG_FASTBOOT_INFO_ADDRESS=0x4822B5EC
CONFIG_FASTBOOT_OKAY_ADDRESS=0x4822B838
CONFIG_FASTBOOT_PUBLISH_ADDRESS=0x4822B198
CONFIG_FASTBOOT_REGISTER_ADDRESS=0x4822B15C
CONFIG_FREE_ADDRESS=0x4823DCF8
CONFIG_GET_ENV_ADDRESS=0x4825AEBC
CONFIG_INIT_STORAGE_ADDRESS=0x48203710
CONFIG_INIT_STORAGE_CALLER=0x48203868
CONFIG_LK_LOG_STORE_ADDRESS=0x48253560
CONFIG_MALLOC_ADDRESS=0x4823E6BC
CONFIG_MEDIATEK_MT6877=y
CONFIG_MTK_DETECT_KEY_ADDRESS=0x48205670
CONFIG_OUKITEL_WP56=y
CONFIG_PARTITION_GET_SIZE_BY_NAME_ADDRESS=0x4825AB98
CONFIG_PARTITION_READ_ADDRESS=0x4825BD1C
CONFIG_PLATFORM_INIT_ADDRESS=0x48203834
CONFIG_PLATFORM_INIT_CALLER=0x48226C76
CONFIG_SET_ENV_ADDRESS=0x4825B0D4
CONFIG_SPOOF_SUPPORT=y
CONFIG_STAGE1_SUPPORT=y
CONFIG_THREAD_CREATE_ADDRESS=0x48227438
CONFIG_VIDEO_PRINTF_ADDRESS=0x4823D348
```

## configs/penangf_defconfig
```kconfig
CONFIG_APP_ADDRESS=0x4C42B790
CONFIG_APP_CALLER=0x4C428B6C
CONFIG_BOOTLOADER_BASE=0x4C400000
CONFIG_BOOTLOADER_SIZE=0x105EE0
CONFIG_BOOTMODE_ADDRESS=0x4C5085C4
CONFIG_BOOTSTRAP2_ADDRESS=0x4C427601
CONFIG_FASTBOOT_FAIL_ADDRESS=0x4C42C1F8
CONFIG_FASTBOOT_INFO_ADDRESS=0x4C42C178
CONFIG_FASTBOOT_OKAY_ADDRESS=0x4C42C3C4
CONFIG_FASTBOOT_PUBLISH_ADDRESS=0x4C42BE04
CONFIG_FASTBOOT_REGISTER_ADDRESS=0x4C42BDC8
CONFIG_LK_LOG_STORE_ADDRESS=0x4C4507C0
CONFIG_MEDIATEK_MT6768=y
CONFIG_MOTOROLA_PENANGF=y
CONFIG_MTK_DETECT_KEY_ADDRESS=0x4C4064A4
CONFIG_PLATFORM_INIT_ADDRESS=0x4C404864
CONFIG_PLATFORM_INIT_CALLER=0x4C427638
CONFIG_VIDEO_PRINTF_ADDRESS=0x4C43A440
```

## configs/phone_colors_defconfig
```kconfig
CONFIG_APP_ADDRESS=0x8002DB08
CONFIG_APP_CALLER=0x8002D36C
CONFIG_BOOTLOADER_BASE=0x80020000
CONFIG_BOOTLOADER_SIZE=0x453CC
CONFIG_BOOTMODE_ADDRESS=0x80068418
CONFIG_FASTBOOT_FAIL_ADDRESS=0x8002DE14
CONFIG_FASTBOOT_INFO_ADDRESS=0x8002DDD0
CONFIG_FASTBOOT_OKAY_ADDRESS=0x8002DFAC
CONFIG_FASTBOOT_PUBLISH_ADDRESS=0x8002DC1C
CONFIG_FASTBOOT_REGISTER_ADDRESS=0x8002DBDC
CONFIG_LK_LOG_STORE=n
CONFIG_ENERGY_PHONE_COLORS=y
CONFIG_MEDIATEK_MT6572=y
CONFIG_MTK_DETECT_KEY_ADDRESS=0x80029EF0
CONFIG_PLATFORM_INIT_ADDRESS=0x8002068C
CONFIG_PLATFORM_INIT_CALLER=0x8002C71E
CONFIG_VIDEO_PRINTF_ADDRESS=0x80030444
```

## configs/rabbit/r1_defconfig
```kconfig
CONFIG_APP_ADDRESS=0x4801DA8C
CONFIG_BOOTLOADER_BASE=0x48000000
CONFIG_BOOTLOADER_SIZE=0xB78A4
CONFIG_BOOTMODE_ADDRESS=0x480BA5D0
CONFIG_FASTBOOT_FAIL_ADDRESS=0x4801E4FC
CONFIG_FASTBOOT_INFO_ADDRESS=0x4801E47C
CONFIG_FASTBOOT_OKAY_ADDRESS=0x4801E6C8
CONFIG_FASTBOOT_PUBLISH_ADDRESS=0x4801E108
CONFIG_FASTBOOT_REGISTER_ADDRESS=0x4801E0CC
CONFIG_LK_LOG_STORE_ADDRESS=0x4803E528
CONFIG_PLATFORM_INIT_ADDRESS=0x48002B88
CONFIG_PLATFORM_INIT_CALLER=0x480197A8
CONFIG_MTK_DETECT_KEY_ADDRESS=0x48004A60
CONFIG_VIDEO_PRINTF_ADDRESS=0x48029EFC
CONFIG_RABBIT_R1=y
CONFIG_MEDIATEK_MT6765=y
```

## configs/realme/RMX2156_UI2_defconfig
```kconfig
CONFIG_APP_CALLER=0x4C422918
CONFIG_APP_ADDRESS=0x4C425604
CONFIG_BOOTLOADER_BASE=0x4C400000
CONFIG_BOOTLOADER_SIZE=0X116590
CONFIG_BOOTMODE_ADDRESS=0x4C5195BC
CONFIG_FASTBOOT_FAIL_ADDRESS=0x4C4260F4
CONFIG_FASTBOOT_INFO_ADDRESS=0x4C426074
CONFIG_FASTBOOT_OKAY_ADDRESS=0x4C4262C0
CONFIG_FASTBOOT_PUBLISH_ADDRESS=0x4C425D00
CONFIG_FASTBOOT_REGISTER_ADDRESS=0x4C425CC4
CONFIG_LK_LOG_STORE_ADDRESS=0x4C444A60
CONFIG_MTK_DETECT_KEY_ADDRESS=0x4C4050F0
CONFIG_PLATFORM_INIT_ADDRESS=0x4C4032D8
CONFIG_PLATFORM_INIT_CALLER=0x4C421274
CONFIG_VIDEO_PRINTF_ADDRESS=0x4C431D50
CONFIG_THREAD_CREATE_ADDRESS=0x4C421A30
CONFIG_THREAD_RESUME_ADDRESS=0x4C421C44
CONFIG_REALME_RMX2156_UI2=y
CONFIG_MEDIATEK_MT6785=y
CONFIG_THREAD_SUPPORT=y
CONFIG_STAGE1_SUPPORT=y
CONFIG_LEGACY_LK=n
CONFIG_INIT_STORAGE_CALLER=0x4C40330C
CONFIG_INIT_STORAGE_ADDRESS=0x4C403004
CONFIG_FREE_ADDRESS=0x4C432470
CONFIG_DPRINTF_ADDRESS=0x4C432040
CONFIG_MALLOC_ADDRESS=0x4C432D48
CONFIG_PARTITION_GET_SIZE_BY_NAME_ADDRESS=0x4C44B564
CONFIG_PARTITION_READ_ADDRESS=0x4C44CB8C
CONFIG_FRAMEBUFFER_SUPPORT=y
CONFIG_FRAMEBUFFER_ADDRESS=0X78320000
CONFIG_FRAMEBUFFER_WIDTH=1080
CONFIG_FRAMEBUFFER_HEIGHT=2400
CONFIG_FRAMEBUFFER_BPP=32
CONFIG_FRAMEBUFFER_ALIGNMENT=64
```

## configs/realme/RMX2156_defconfig
```kconfig
CONFIG_APP_CALLER=0x4C424C1C
CONFIG_APP_ADDRESS=0x4C42812C
CONFIG_BOOTLOADER_BASE=0x4C400000
CONFIG_BOOTLOADER_SIZE=0x12E3C4
CONFIG_BOOTMODE_ADDRESS=0x4C5315B4
CONFIG_FASTBOOT_FAIL_ADDRESS=0x4C428C18
CONFIG_FASTBOOT_INFO_ADDRESS=0x4C428B98
CONFIG_FASTBOOT_OKAY_ADDRESS=0x4C428DE4
CONFIG_FASTBOOT_PUBLISH_ADDRESS=0x4C428824
CONFIG_FASTBOOT_REGISTER_ADDRESS=0x4C4287E8
CONFIG_LK_LOG_STORE_ADDRESS=0x4C449AC8
CONFIG_MTK_DETECT_KEY_ADDRESS=0x4C4053DC
CONFIG_PLATFORM_INIT_ADDRESS=0x4C4035D4
CONFIG_PLATFORM_INIT_CALLER=0x4C423578
CONFIG_VIDEO_PRINTF_ADDRESS=0x4C436498
CONFIG_THREAD_CREATE_ADDRESS=0x4C423D34
CONFIG_THREAD_RESUME_ADDRESS=0x4C423F48
CONFIG_REALME_RMX2156=y
CONFIG_MEDIATEK_MT6785=y
CONFIG_THREAD_SUPPORT=y
CONFIG_STAGE1_SUPPORT=y
CONFIG_LEGACY_LK=n
CONFIG_INIT_STORAGE_CALLER=0x4C40360E
CONFIG_INIT_STORAGE_ADDRESS=0x4C4032C0
CONFIG_FREE_ADDRESS=0x4C436BB8
CONFIG_DPRINTF_ADDRESS=0x4C436788
CONFIG_MALLOC_ADDRESS=0x4C437484
CONFIG_PARTITION_GET_SIZE_BY_NAME_ADDRESS=0x4C450938
CONFIG_PARTITION_READ_ADDRESS=0x4C45211C
```

## configs/realme/even_defconfig
```kconfig
CONFIG_APP_ADDRESS=0x4C42E0DC
CONFIG_APP_CALLER=0x4C42AC24
CONFIG_BOOTLOADER_BASE=0x4C400000
CONFIG_BOOTLOADER_SIZE=0x15FCDC
CONFIG_BOOTMODE_ADDRESS=0x4C56259C
CONFIG_DPRINTF_ADDRESS=0x4C441E28
CONFIG_FASTBOOT_FAIL_ADDRESS=0x4C42ECB0
CONFIG_FASTBOOT_INFO_ADDRESS=0x4C42EC30
CONFIG_FASTBOOT_OKAY_ADDRESS=0x4C42EE7C
CONFIG_FASTBOOT_PUBLISH_ADDRESS=0x4C42E7DC
CONFIG_FASTBOOT_REGISTER_ADDRESS=0x4C42E7A0
CONFIG_FREE_ADDRESS=0x4C442258
CONFIG_INIT_STORAGE_ADDRESS=0x4C4039EC
CONFIG_INIT_STORAGE_CALLER=0x4C403C8C
CONFIG_LEGACY_LK=n
CONFIG_LK_LOG_STORE_ADDRESS=0x4C456194
CONFIG_MALLOC_ADDRESS=0x4C442B24
CONFIG_MTK_DETECT_KEY_ADDRESS=0x4C405B34
CONFIG_PARTITION_GET_SIZE_BY_NAME_ADDRESS=0x4C45CA64
CONFIG_PARTITION_READ_ADDRESS=0x4C45DDA8
CONFIG_PLATFORM_INIT_ADDRESS=0x4C403C60
CONFIG_PLATFORM_INIT_CALLER=0x4C429580
CONFIG_STAGE1_SUPPORT=y
CONFIG_THREAD_CREATE_ADDRESS=0x4C429D3C
CONFIG_THREAD_RESUME_ADDRESS=0x4C429F50
CONFIG_VIDEO_PRINTF_ADDRESS=0x4C4417C0
CONFIG_REALME_EVEN=y
CONFIG_MEDIATEK_MT6768=y
```
