## configs/motorola/lamu_defconfig
```kconfig
CONFIG_APP_ADDRESS=0x4C42A1C8
CONFIG_APP_CALLER=0x4C4279F8
CONFIG_BOOTLOADER_BASE=0x4C400000
CONFIG_BOOTLOADER_SIZE=0x157AAC
CONFIG_BOOTMODE_ADDRESS=0x4C59C5A0
CONFIG_DPRINTF_ADDRESS=0x4C443FC8
CONFIG_ENVIRONMENT_SUPPORT=y
CONFIG_FASTBOOT_FAIL_ADDRESS=0x4C42ACB0
CONFIG_FASTBOOT_INFO_ADDRESS=0x4C42AC30
CONFIG_FASTBOOT_OKAY_ADDRESS=0x4C42AE7C
CONFIG_FASTBOOT_PUBLISH_ADDRESS=0x4C42A7DC
CONFIG_FASTBOOT_REGISTER_ADDRESS=0x4C42A7A0
CONFIG_FRAMEBUFFER_ADDRESS=0x76F20000
CONFIG_FRAMEBUFFER_ALIGNMENT=64
CONFIG_FRAMEBUFFER_BPP=32
CONFIG_FRAMEBUFFER_HEIGHT=2400
CONFIG_FRAMEBUFFER_SUPPORT=y
CONFIG_FRAMEBUFFER_WIDTH=1080
CONFIG_FREE_ADDRESS=0x4C4443F8
CONFIG_GET_ENV_ADDRESS=0x4C460630
CONFIG_INIT_STORAGE_ADDRESS=0x4C403754
CONFIG_INIT_STORAGE_CALLER=0x4C403974
CONFIG_LEGACY_LK=n
CONFIG_LK_LOG_STORE_ADDRESS=0x4C4596C4
CONFIG_MALLOC_ADDRESS=0x4C444D04
CONFIG_MEDIATEK_MT6768=y
CONFIG_MOTOROLA_LAMU=y
CONFIG_MTK_DETECT_KEY_ADDRESS=0x4C4054FC
CONFIG_PARTITION_GET_SIZE_BY_NAME_ADDRESS=0x4C46030C
CONFIG_PARTITION_READ_ADDRESS=0x4C4615A8
CONFIG_PLATFORM_INIT_ADDRESS=0x4C403944
CONFIG_PLATFORM_INIT_CALLER=0x4C426354
CONFIG_SET_ENV_ADDRESS=0x4C460848
CONFIG_SPOOF_SUPPORT=y
CONFIG_STAGE1_SUPPORT=y
CONFIG_VIDEO_PRINTF_ADDRESS=0x4C443994
```

## configs/motorola/lamuc_defconfig
```kconfig
CONFIG_APP_ADDRESS=0x4C42A1C0
CONFIG_BOOTLOADER_BASE=0x4C400000
CONFIG_BOOTLOADER_SIZE=0x16F23C
CONFIG_BOOTMODE_ADDRESS=0x4C5725A0
CONFIG_DPRINTF_ADDRESS=0x4C4431FC
CONFIG_ENVIRONMENT_SUPPORT=y
CONFIG_FASTBOOT_FAIL_ADDRESS=0x4C42ACA8
CONFIG_FASTBOOT_INFO_ADDRESS=0x4C42AC28
CONFIG_FASTBOOT_OKAY_ADDRESS=0x4C42AE74
CONFIG_FASTBOOT_PUBLISH_ADDRESS=0x4C42A7D4
CONFIG_FASTBOOT_REGISTER_ADDRESS=0x4C42A798
CONFIG_FREE_ADDRESS=0x4C44362C
CONFIG_GET_ENV_ADDRESS=0x4C45F86C
CONFIG_INIT_STORAGE_ADDRESS=0x4C403754
CONFIG_INIT_STORAGE_CALLER=0x4C403974
CONFIG_LK_LOG_STORE_ADDRESS=0x4C458900
CONFIG_MALLOC_ADDRESS=0x4C443F38
CONFIG_MEDIATEK_MT6768=y
CONFIG_MOTOROLA_LAMUC=y
CONFIG_MTK_DETECT_KEY_ADDRESS=0x4C4054FC
CONFIG_PARTITION_GET_SIZE_BY_NAME_ADDRESS=0x4C45F548
CONFIG_PARTITION_READ_ADDRESS=0x4C4607E8
CONFIG_PLATFORM_INIT_ADDRESS=0x4C403944
CONFIG_PLATFORM_INIT_CALLER=0x4C42634C
CONFIG_SET_ENV_ADDRESS=0x4C45FA84
CONFIG_SPOOF_SUPPORT=y
CONFIG_STAGE1_SUPPORT=y
CONFIG_THREAD_CREATE_ADDRESS=0x4C426B08
CONFIG_THREAD_RESUME_ADDRESS=0x4C426D1C
CONFIG_VIDEO_PRINTF_ADDRESS=0x4C442BC8
```

## configs/motorola/lamulg_defconfig
```kconfig
CONFIG_APP_ADDRESS=0x4C42A1C0
CONFIG_APP_CALLER=0x4C4279F8
CONFIG_BOOTLOADER_BASE=0x4C400000
CONFIG_BOOTLOADER_SIZE=0x1303C4
CONFIG_BOOTMODE_ADDRESS=0x4C53359C
CONFIG_DPRINTF_ADDRESS=0x4C43DBE0
CONFIG_ENVIRONMENT_SUPPORT=y
CONFIG_FASTBOOT_FAIL_ADDRESS=0x4C42AC30
CONFIG_FASTBOOT_INFO_ADDRESS=0x4C42ABB0
CONFIG_FASTBOOT_OKAY_ADDRESS=0x4C42ADFC
CONFIG_FASTBOOT_PUBLISH_ADDRESS=0x4C42A83C
CONFIG_FASTBOOT_REGISTER_ADDRESS=0x4C42A800
CONFIG_FREE_ADDRESS=0x4C43E010
CONFIG_GET_ENV_ADDRESS=0x4C459D9C
CONFIG_INIT_STORAGE_ADDRESS=0x4C4037C4
CONFIG_INIT_STORAGE_CALLER=0x4C4039E4
CONFIG_LK_LOG_STORE_ADDRESS=0x4C452EA4
CONFIG_MALLOC_ADDRESS=0x4C43E91C
CONFIG_MEDIATEK_MT6768=y
CONFIG_MOTOROLA_LAMULG=y
CONFIG_MTK_DETECT_KEY_ADDRESS=0x4C405550
CONFIG_PARTITION_GET_SIZE_BY_NAME_ADDRESS=0x4C459A78
CONFIG_PARTITION_READ_ADDRESS=0x4C45AD18
CONFIG_PLATFORM_INIT_ADDRESS=0x4C4039B4
CONFIG_PLATFORM_INIT_CALLER=0x4C426354
CONFIG_SET_ENV_ADDRESS=0x4C459FB4
CONFIG_SPOOF_SUPPORT=y
CONFIG_STAGE1_SUPPORT=y
CONFIG_VIDEO_PRINTF_ADDRESS=0x4C43D6C4
```

## configs/motorola/malta_64_defconfig
```kconfig
CONFIG_APP_ADDRESS=0x4802343C
CONFIG_APP_CALLER=0x48020D40
CONFIG_BOOTLOADER_BASE=0x48000000
CONFIG_BOOTLOADER_SIZE=0xE03F8
CONFIG_BOOTMODE_ADDRESS=0x480E35DC
CONFIG_BOOTSTRAP2_ADDRESS=0x4801F56C
CONFIG_FASTBOOT_FAIL_ADDRESS=0x48023C10
CONFIG_FASTBOOT_INFO_ADDRESS=0x48023BB4
CONFIG_FASTBOOT_OKAY_ADDRESS=0x48023DDC
CONFIG_FASTBOOT_PUBLISH_ADDRESS=0x480238C0
CONFIG_FASTBOOT_REGISTER_ADDRESS=0x48023884
CONFIG_LK_LOG_STORE_ADDRESS=0x48042D40
CONFIG_MEDIATEK_MT6762=y
CONFIG_MOTOROLA_MALTA_64=y
CONFIG_MTK_DETECT_KEY_ADDRESS=0x48004998
CONFIG_PLATFORM_INIT_ADDRESS=0x480029C0
CONFIG_PLATFORM_INIT_CALLER=0x4801F61C
CONFIG_VIDEO_PRINTF_ADDRESS=0x48031704
CONFIG_FORCE_INJECT_ADDR=0x480C2FF0
```

## configs/motorola/malta_defconfig
```kconfig
CONFIG_APP_ADDRESS=0x48023508
CONFIG_APP_CALLER=0x48020DE8
CONFIG_BOOTLOADER_BASE=0x48000000
CONFIG_BOOTLOADER_SIZE=0xE21BC
CONFIG_BOOTMODE_ADDRESS=0x48024E88
CONFIG_BOOTSTRAP2_ADDRESS=0x4801F614
CONFIG_FASTBOOT_FAIL_ADDRESS=0x48023CDC
CONFIG_FASTBOOT_INFO_ADDRESS=0x48023C80
CONFIG_FASTBOOT_OKAY_ADDRESS=0x48023EA8
CONFIG_FASTBOOT_PUBLISH_ADDRESS=0x4802398C
CONFIG_FASTBOOT_REGISTER_ADDRESS=0x48023950
CONFIG_LK_LOG_STORE_ADDRESS=0x48042F1C
CONFIG_MEDIATEK_MT6762=y
CONFIG_MOTOROLA_MALTA=y
CONFIG_MTK_DETECT_KEY_ADDRESS=0x48004998
CONFIG_PLATFORM_INIT_ADDRESS=0x480029C0
CONFIG_PLATFORM_INIT_CALLER=0x4801F6C4
CONFIG_VIDEO_PRINTF_ADDRESS=0x480317F0
CONFIG_FORCE_INJECT_ADDR=0x480C2FF0
```

## configs/motorola/malta_l_64_defconfig
```kconfig
CONFIG_APP_ADDRESS=0x480234AC
CONFIG_APP_CALLER=0x48020D8C
CONFIG_BOOTLOADER_BASE=0x48000000
CONFIG_BOOTLOADER_SIZE=0xE4CF4
CONFIG_BOOTMODE_ADDRESS=0x480E75DC
CONFIG_BOOTSTRAP2_ADDRESS=0x4801F630
CONFIG_FASTBOOT_FAIL_ADDRESS=0x48023C80
CONFIG_FASTBOOT_INFO_ADDRESS=0x48023C24
CONFIG_FASTBOOT_OKAY_ADDRESS=0x48023E4C
CONFIG_FASTBOOT_PUBLISH_ADDRESS=0x48023930
CONFIG_FASTBOOT_REGISTER_ADDRESS=0x480238F4
CONFIG_LK_LOG_STORE_ADDRESS=0x480431A0
CONFIG_MEDIATEK_MT6762=y
CONFIG_MOTOROLA_MALTA_L_64=y
CONFIG_MTK_DETECT_KEY_ADDRESS=0x48004998
CONFIG_PLATFORM_INIT_ADDRESS=0x480029C0
CONFIG_PLATFORM_INIT_CALLER=0x4801F668
CONFIG_VIDEO_PRINTF_ADDRESS=0x48031B90
CONFIG_FORCE_INJECT_ADDR=0x480C2FF0
```

## configs/motorola/malta_l_defconfig
```kconfig
CONFIG_APP_ADDRESS=0x480234B0
CONFIG_APP_CALLER=0x48020D90
CONFIG_BOOTLOADER_BASE=0x48000000
CONFIG_BOOTLOADER_SIZE=0xE4CFC
CONFIG_BOOTMODE_ADDRESS=0x480E75DC
CONFIG_BOOTSTRAP2_ADDRESS=0x4801F634
CONFIG_FASTBOOT_FAIL_ADDRESS=0x48023C84
CONFIG_FASTBOOT_INFO_ADDRESS=0x48023C28
CONFIG_FASTBOOT_OKAY_ADDRESS=0x48023E50
CONFIG_FASTBOOT_PUBLISH_ADDRESS=0x48023934
CONFIG_FASTBOOT_REGISTER_ADDRESS=0x480238F8
CONFIG_LK_LOG_STORE_ADDRESS=0x480431A4
CONFIG_MEDIATEK_MT6762=y
CONFIG_MOTOROLA_MALTA_L=y
CONFIG_MTK_DETECT_KEY_ADDRESS=0x48004998
CONFIG_PLATFORM_INIT_ADDRESS=0x480029C0
CONFIG_PLATFORM_INIT_CALLER=0x4801F66C
CONFIG_VIDEO_PRINTF_ADDRESS=0x48031B94
CONFIG_FORCE_INJECT_ADDR=0x480C2FF0
```

## configs/motorola/penangf_defconfig
```kconfig
CONFIG_APP_ADDRESS=0x4C42B790
CONFIG_APP_CALLER=0x4C428B6C
CONFIG_BOOTLOADER_BASE=0x4C400000
CONFIG_BOOTLOADER_SIZE=0x105EE0
CONFIG_BOOTMODE_ADDRESS=0x4C5085C4
CONFIG_BOOTSTRAP2_ADDRESS=0x4C427601
CONFIG_DPRINTF_ADDRESS=0x4C43A730
CONFIG_ENVIRONMENT_SUPPORT=y
CONFIG_FASTBOOT_FAIL_ADDRESS=0x4C42C1F8
CONFIG_FASTBOOT_INFO_ADDRESS=0x4C42C178
CONFIG_FASTBOOT_OKAY_ADDRESS=0x4C42C3C4
CONFIG_FASTBOOT_PUBLISH_ADDRESS=0x4C42BE04
CONFIG_FASTBOOT_REGISTER_ADDRESS=0x4C42BDC8
CONFIG_FRAMEBUFFER_ADDRESS=0x7BB4C000
CONFIG_FRAMEBUFFER_ALIGNMENT=128
CONFIG_FRAMEBUFFER_BPP=32
CONFIG_FRAMEBUFFER_HEIGHT=1600
CONFIG_FRAMEBUFFER_SUPPORT=y
CONFIG_FRAMEBUFFER_WIDTH=720
CONFIG_FREE_ADDRESS=0x4C43AB60
CONFIG_GET_ENV_ADDRESS=0x4C4576B8
CONFIG_INIT_STORAGE_ADDRESS=0x4C40420C
CONFIG_INIT_STORAGE_CALLER=0x4C404894
CONFIG_LK_LOG_STORE_ADDRESS=0x4C4507C0
CONFIG_MALLOC_ADDRESS=0x4C43B7D0
CONFIG_MEDIATEK_MT6768=y
CONFIG_MOTOROLA_PENANGF=y
CONFIG_MTK_DETECT_KEY_ADDRESS=0x4C4064A4
CONFIG_PARTITION_GET_SIZE_BY_NAME_ADDRESS=0x4C457394
CONFIG_PARTITION_READ_ADDRESS=0x4C458630
CONFIG_PLATFORM_INIT_ADDRESS=0x4C404864
CONFIG_PLATFORM_INIT_CALLER=0x4C427638
CONFIG_SET_ENV_ADDRESS=0x4C4578D0
CONFIG_SPOOF_SUPPORT=y
CONFIG_STAGE1_SUPPORT=y
CONFIG_THREAD_CREATE_ADDRESS=0x4C427C84
CONFIG_THREAD_RESUME_ADDRESS=0x4C427E98
CONFIG_THREAD_SUPPORT=y
CONFIG_VIDEO_PRINTF_ADDRESS=0x4C43A440
```

## configs/nashc_defconfig
```kconfig
CONFIG_APP_ADDRESS=0x4C42F304
CONFIG_APP_CALLER=0x4C42BE54
CONFIG_BOOTLOADER_BASE=0x4C400000
CONFIG_BOOTLOADER_SIZE=0x147A9C
CONFIG_BOOTMODE_ADDRESS=0x4C54A630
CONFIG_FASTBOOT_FAIL_ADDRESS=0x4C42FED8
CONFIG_FASTBOOT_INFO_ADDRESS=0x4C42FE58
CONFIG_FASTBOOT_OKAY_ADDRESS=0x4C4300A4
CONFIG_FASTBOOT_PUBLISH_ADDRESS=0x4C42FA04
CONFIG_FASTBOOT_REGISTER_ADDRESS=0x4C42F9C8
CONFIG_LK_LOG_STORE_ADDRESS=0x4C457CA0
CONFIG_MEDIATEK_MT6785=y
CONFIG_MTK_DETECT_KEY_ADDRESS=0x4C40669C
CONFIG_PLATFORM_INIT_ADDRESS=0x4C404888
CONFIG_PLATFORM_INIT_CALLER=0x4C42A7B0
CONFIG_REALME_NASHC=y
CONFIG_VIDEO_PRINTF_ADDRESS=0x4C442F40
```

## configs/nokia/ironman_defconfig
```kconfig
CONFIG_APP_ADDRESS=0x4801F2BC
CONFIG_APP_CALLER=0x4801C9CC
CONFIG_BOOTLOADER_BASE=0x48000000
CONFIG_BOOTLOADER_SIZE=0xD4FF0
CONFIG_BOOTMODE_ADDRESS=0x480D75E4
CONFIG_FASTBOOT_FAIL_ADDRESS=0x4801FE34
CONFIG_FASTBOOT_INFO_ADDRESS=0x4801FDB4
CONFIG_FASTBOOT_OKAY_ADDRESS=0x480200B0
CONFIG_FASTBOOT_PUBLISH_ADDRESS=0x4801FA90
CONFIG_FASTBOOT_REGISTER_ADDRESS=0x4801FA54
CONFIG_LK_LOG_STORE_ADDRESS=0x48041088
CONFIG_MTK_DETECT_KEY_ADDRESS=0x480045D4
CONFIG_PLATFORM_INIT_ADDRESS=0x480028FC
CONFIG_PLATFORM_INIT_CALLER=0x4801BA98
CONFIG_VIDEO_PRINTF_ADDRESS=0x4802DD2C
CONFIG_NOKIA_IRONMAN=y
CONFIG_MEDIATEK_MT6761=y
```

## configs/nuu/N5004LA_defconfig
```kconfig
CONFIG_APP_ADDRESS=0x48021FB8
CONFIG_BOOTLOADER_BASE=0x48000000
CONFIG_BOOTLOADER_SIZE=0xADAD8
CONFIG_BOOTMODE_ADDRESS=0x480B05DC
CONFIG_DPRINTF_ADDRESS=0x4802C2B4
CONFIG_FASTBOOT_FAIL_ADDRESS=0x48022948
CONFIG_FASTBOOT_INFO_ADDRESS=0x480228EC
CONFIG_FASTBOOT_OKAY_ADDRESS=0x48022B14
CONFIG_FASTBOOT_PUBLISH_ADDRESS=0x480225F8
CONFIG_FASTBOOT_REGISTER_ADDRESS=0x480225BC
CONFIG_FREE_ADDRESS=0x4802C674
CONFIG_INIT_STORAGE_CALLER=0x48002970
CONFIG_LK_LOG_STORE_ADDRESS=0x4803D5B0
CONFIG_MALLOC_ADDRESS=0x48006D04
CONFIG_MTK_DETECT_KEY_ADDRESS=0x480045A0
CONFIG_PARTITION_READ_ADDRESS=0x480455F8
CONFIG_PLATFORM_INIT_ADDRESS=0x48002940
CONFIG_PLATFORM_INIT_CALLER=0x4801E640
CONFIG_THREAD_CREATE_ADDRESS=0x4801EDFC
CONFIG_THREAD_RESUME_ADDRESS=0x4801F010
CONFIG_VIDEO_PRINTF_ADDRESS=0x4802BFC4
CONFIG_NUU_N5004LA=y
CONFIG_MEDIATEK_MT6765=y
```

## configs/nuu/NUU_A1_defconfig
```kconfig
CONFIG_APP_ADDRESS=0x81E17290
CONFIG_BOOTLOADER_BASE=0x81E00000
CONFIG_BOOTLOADER_SIZE=0x3EFC4
CONFIG_BOOTMODE_ADDRESS=0x81E404DC
CONFIG_BOOTSTRAP2_ADDRESS=0x81E15464
CONFIG_FASTBOOT_FAIL_ADDRESS=0x81E177DC
CONFIG_FASTBOOT_INFO_ADDRESS=0x81E17798
CONFIG_FASTBOOT_OKAY_ADDRESS=0x81E17960
CONFIG_FASTBOOT_REGISTER_ADDRESS=0x81E17568
CONFIG_FASTBOOT_PUBLISH_ADDRESS=0x81E175A8
CONFIG_LK_LOG_STORE=n
CONFIG_NUU_NUU_A1=y
CONFIG_MEDIATEK_MT6580=y
CONFIG_MTK_DETECT_KEY_ADDRESS=0x81E03970
CONFIG_PLATFORM_INIT_CALLER=0x81E1546A
CONFIG_PLATFORM_INIT_ADDRESS=0x81E01438
CONFIG_VIDEO_PRINTF_ADDRESS=0x81E1B860
CONFIG_LEGACY_LK=y
CONFIG_STAGE1_SUPPORT=y
CONFIG_INIT_STORAGE_ADDRESS=0x81E049E4
CONFIG_INIT_STORAGE_CALLER=0x81E0149A
CONFIG_MALLOC_ADDRESS=0x81E1C5FC
CONFIG_FREE_ADDRESS=0x81E1BDBC
CONFIG_DPRINTF_ADDRESS=0x81E1BABC
CONFIG_MT_PART_GET_DEVICE_ADDRESS=0x81E14258
CONFIG_MT_PART_GET_PARTITION_ADDRESS=0x81E140D0
```

## configs/op4bfb_defconfig
```kconfig
CONFIG_APP_CALLER=0x48024338
CONFIG_APP_ADDRESS=0x48026F0C
CONFIG_BOOTLOADER_BASE=0x48000000
CONFIG_BOOTLOADER_SIZE=0x26F008
CONFIG_BOOTMODE_ADDRESS=0x482729E8
CONFIG_FASTBOOT_FAIL_ADDRESS=0x4802832C
CONFIG_FASTBOOT_INFO_ADDRESS=0x480282D0
CONFIG_FASTBOOT_OKAY_ADDRESS=0x480284F8
CONFIG_FASTBOOT_PUBLISH_ADDRESS=0x48027FDC
CONFIG_FASTBOOT_REGISTER_ADDRESS=0x48027FA0
CONFIG_MEDIATEK_MT6765=y
CONFIG_MTK_DETECT_KEY_ADDRESS=0x48004D14
CONFIG_LK_LOG_STORE_ADDRESS=0x48042EC0
CONFIG_OPPO_OP4BFB=y
CONFIG_PLATFORM_INIT_ADDRESS=0x48002A60
CONFIG_PLATFORM_INIT_CALLER=0x48022C14
CONFIG_VIDEO_PRINTF_ADDRESS=0x48032AA8
```

## configs/oppo/CPH2015_defconfig
```kconfig
CONFIG_APP_ADDRESS=0x48026F50
CONFIG_BOOTLOADER_BASE=0x48000000
CONFIG_BOOTLOADER_SIZE=0x13219C
CONFIG_BOOTMODE_ADDRESS=0x481359E8
CONFIG_DPRINTF_ADDRESS=0x48033018
CONFIG_FASTBOOT_FAIL_ADDRESS=0x4802843C
CONFIG_FASTBOOT_INFO_ADDRESS=0x480283E0
CONFIG_FASTBOOT_OKAY_ADDRESS=0x48028608
CONFIG_FASTBOOT_PUBLISH_ADDRESS=0x480280EC
CONFIG_FASTBOOT_REGISTER_ADDRESS=0x480280B0
CONFIG_FRAMEBUFFER_ADDRESS=0x7B2B0000
CONFIG_FRAMEBUFFER_ALIGNMENT=128
CONFIG_FRAMEBUFFER_BPP=32
CONFIG_FRAMEBUFFER_HEIGHT=1600
CONFIG_FRAMEBUFFER_SUPPORT=y
CONFIG_FRAMEBUFFER_WIDTH=720
CONFIG_FREE_ADDRESS=0x480333D8
CONFIG_INIT_STORAGE_ADDRESS=0x480028E4
CONFIG_INIT_STORAGE_CALLER=0x48002A8E
CONFIG_LEGACY_LK=n
CONFIG_LK_LOG_STORE_ADDRESS=0x48043140
CONFIG_MALLOC_ADDRESS=0x48033CA0
CONFIG_MEDIATEK_MT6765=y
CONFIG_MTK_DETECT_KEY_ADDRESS=0x48004CE4
CONFIG_OPPO_CPH2015=y
CONFIG_PARTITION_GET_SIZE_BY_NAME_ADDRESS=0x48048328
CONFIG_PARTITION_READ_ADDRESS=0x4804945C
CONFIG_PLATFORM_INIT_ADDRESS=0x48002A60
CONFIG_PLATFORM_INIT_CALLER=0x48022BB8
CONFIG_STAGE1_SUPPORT=y
CONFIG_THREAD_CREATE_ADDRESS=0x48023374
CONFIG_THREAD_RESUME_ADDRESS=0x48023588
CONFIG_THREAD_SUPPORT=y
CONFIG_VIDEO_PRINTF_ADDRESS=0x48032D28
```

## configs/oppo/CPH2185_defconfig
```kconfig
CONFIG_APP_ADDRESS=0x48026544
CONFIG_BOOTLOADER_BASE=0x48000000
CONFIG_BOOTLOADER_SIZE=0x3C57A4
CONFIG_BOOTMODE_ADDRESS=0x483C89E4
CONFIG_DPRINTF_ADDRESS=0x48032B68
CONFIG_ENVIRONMENT_SUPPORT=y
CONFIG_FASTBOOT_FAIL_ADDRESS=0x48026E18
CONFIG_FASTBOOT_INFO_ADDRESS=0x48026DBC
CONFIG_FASTBOOT_OKAY_ADDRESS=0x48026FE4
CONFIG_FASTBOOT_PUBLISH_ADDRESS=0x48026AC8
CONFIG_FASTBOOT_REGISTER_ADDRESS=0x48026A8C
CONFIG_FRAMEBUFFER_ADDRESS=0x7BA10000
CONFIG_FRAMEBUFFER_ALIGNMENT=128
CONFIG_FRAMEBUFFER_BPP=32
CONFIG_FRAMEBUFFER_HEIGHT=1600
CONFIG_FRAMEBUFFER_SUPPORT=y
CONFIG_FRAMEBUFFER_WIDTH=720
CONFIG_FREE_ADDRESS=0x48032F28
CONFIG_GET_ENV_ADDRESS=0x4804B320
CONFIG_INIT_STORAGE_ADDRESS=0x480029EC
CONFIG_INIT_STORAGE_CALLER=0x48002DB8
CONFIG_LEGACY_LK=n
CONFIG_LK_LOG_STORE_ADDRESS=0x48043790
CONFIG_MALLOC_ADDRESS=0x4803376C
CONFIG_MEDIATEK_MT6765=y
CONFIG_MTK_DETECT_KEY_ADDRESS=0x480050EC
CONFIG_OPPO_CPH2185=y
CONFIG_PARTITION_GET_SIZE_BY_NAME_ADDRESS=0x4804B070
CONFIG_PARTITION_READ_ADDRESS=0x4804C220
CONFIG_PLATFORM_INIT_ADDRESS=0x48002D88
CONFIG_PLATFORM_INIT_CALLER=0x48021C00
CONFIG_SET_ENV_ADDRESS=0x4804B5DC
CONFIG_STAGE1_SUPPORT=y
CONFIG_THREAD_CREATE_ADDRESS=0x480223BC
CONFIG_THREAD_RESUME_ADDRESS=0x480225D0
CONFIG_THREAD_SUPPORT=y
CONFIG_VIDEO_PRINTF_ADDRESS=0x48032878
```

## configs/oppo/leade_defconfig
```kconfig
CONFIG_APP_ADDRESS=0x6002BBB0
CONFIG_BOOTLOADER_BASE=0x60000000
CONFIG_BOOTLOADER_SIZE=0x2514A4
CONFIG_BOOTMODE_ADDRESS=0x602545E4
CONFIG_DPRINTF_ADDRESS=0x60034184
CONFIG_ENVIRONMENT_SUPPORT=y
CONFIG_FASTBOOT_FAIL_ADDRESS=0x6002CA24
CONFIG_FASTBOOT_INFO_ADDRESS=0x6002C9D8
CONFIG_FASTBOOT_OKAY_ADDRESS=0x6002CBF0
CONFIG_FASTBOOT_PUBLISH_ADDRESS=0x6002C738
CONFIG_FASTBOOT_REGISTER_ADDRESS=0x6002C6FC
CONFIG_FREE_ADDRESS=0x6003453C
CONFIG_GET_ENV_ADDRESS=0x60006B08
CONFIG_INIT_STORAGE_ADDRESS=0x60002A14
CONFIG_INIT_STORAGE_CALLER=0x60002CBA
CONFIG_LEGACY_LK=n
CONFIG_LK_LOG_STORE_ADDRESS=0x60000AC8
CONFIG_MALLOC_ADDRESS=0x60034D80
CONFIG_MEDIATEK_MT6765=y
CONFIG_MTK_DETECT_KEY_ADDRESS=0x60005C00
CONFIG_OPPO_LEADE=y
CONFIG_PARTITION_GET_SIZE_BY_NAME_ADDRESS=0x60043FB0
CONFIG_PARTITION_READ_ADDRESS=0x60043FDC
CONFIG_PLATFORM_INIT_ADDRESS=0x60002C8C
CONFIG_PLATFORM_INIT_CALLER=0x60027904
CONFIG_SET_ENV_ADDRESS=0x60006DE0
CONFIG_SPOOF_SUPPORT=y
CONFIG_STAGE1_SUPPORT=y
CONFIG_VIDEO_PRINTF_ADDRESS=0x60033EE0
```

## configs/oukitel/lyra_defconfig
```kconfig
CONFIG_APP_ADDRESS=0x4802222C
CONFIG_APP_CALLER=0x4801FABC
CONFIG_BOOTLOADER_BASE=0x48000000
CONFIG_BOOTLOADER_SIZE=0xB9910
CONFIG_FASTBOOT_FAIL_ADDRESS=0x48022D18
CONFIG_FASTBOOT_INFO_ADDRESS=0x48022C98
CONFIG_FASTBOOT_OKAY_ADDRESS=0x48022EE4
CONFIG_FASTBOOT_PUBLISH_ADDRESS=0x48022924
CONFIG_FASTBOOT_REGISTER_ADDRESS=0x480228E8
CONFIG_MEDIATEK_MT6762=y
CONFIG_OUKITEL_LYRA=y
CONFIG_PLATFORM_INIT_ADDRESS=0x48002884
CONFIG_PLATFORM_INIT_CALLER=0x4801E418
CONFIG_VIDEO_PRINTF_ADDRESS=0x4802C950
```
