## configs/motorola/lyriq_defconfig
```kconfig
CONFIG_APP_ADDRESS=0x4826EE30
CONFIG_BOOTLOADER_BASE=0x48200000
CONFIG_BOOTLOADER_SIZE=0x180DF4
CONFIG_BOOTMODE_ADDRESS=0x48383600
CONFIG_CERT_BYPASS=y
CONFIG_DPRINTF_ADDRESS=0x4823ECC8
CONFIG_ENVIRONMENT_SUPPORT=y
CONFIG_FASTBOOT_OEM_CMD_HEAD=0x48380A74
CONFIG_FASTBOOT_OEM_CMD_TAIL=0x4838068C
CONFIG_FASTBOOT_OEM_TABLE=y
CONFIG_FASTBOOT_SEND_INFO_ADDRESS=0x48264B74
CONFIG_FASTBOOT_SEND_RESPONSE_ADDRESS=0x48264620
CONFIG_FASTBOOT_STYLE_COMBINED=y
CONFIG_FREE_ADDRESS=0x4823F100
CONFIG_GET_ENV_ADDRESS=0x4825B9E4
CONFIG_INIT_STORAGE_ADDRESS=0x48203540
CONFIG_INIT_STORAGE_CALLER=0x48203752
CONFIG_LK_LOG_STORE=n
CONFIG_MALLOC_ADDRESS=0x4823FC24
CONFIG_MEDIATEK_MT6893=y
CONFIG_MOTOROLA_LYRIQ=y
CONFIG_MTK_DETECT_KEY_ADDRESS=0x48204C20
CONFIG_PARTITION_GET_SIZE_BY_NAME_ADDRESS=0x4825B72C
CONFIG_PARTITION_READ_ADDRESS=0x4825CB64
CONFIG_PLATFORM_INIT_ADDRESS=0x482036F0
CONFIG_PLATFORM_INIT_CALLER=0x48227592
CONFIG_SET_ENV_ADDRESS=0x4825BC8C
CONFIG_THREAD_CREATE_ADDRESS=0x48227A60
CONFIG_THREAD_RESUME_ADDRESS=0x48227BF4
CONFIG_VIDEO_PRINTF_ADDRESS=0x4823E910
```

## configs/nokia/wasp_defconfig
```kconfig
CONFIG_APP_ADDRESS=0x48022B50
CONFIG_BOOTLOADER_BASE=0x48000000
CONFIG_BOOTLOADER_MESSAGE_SUPPORT=y
CONFIG_BOOTLOADER_SIZE=0xD9A3C
CONFIG_BOOTMODE_ADDRESS=0x480DC5E4
CONFIG_DPRINTF_ADDRESS=0x4802FF60
CONFIG_ENVIRONMENT_SUPPORT=y
CONFIG_FASTBOOT_CMDLIST_ADDRESS=0x4817E048
CONFIG_FASTBOOT_FAIL_ADDRESS=0x4802373C
CONFIG_FASTBOOT_INFO_ADDRESS=0x480236BC
CONFIG_FASTBOOT_OKAY_ADDRESS=0x48023948
CONFIG_FASTBOOT_PUBLISH_ADDRESS=0x48023348
CONFIG_FASTBOOT_REGISTER_ADDRESS=0x4802330C
CONFIG_FREE_ADDRESS=0x48030390
CONFIG_GET_ENV_ADDRESS=0x48049550
CONFIG_INIT_STORAGE_ADDRESS=0x480029E0
CONFIG_INIT_STORAGE_CALLER=0x48002C10
CONFIG_LK_LOG_STORE_ADDRESS=0x48042AF0
CONFIG_MALLOC_ADDRESS=0x48030C18
CONFIG_MEDIATEK_MT6761=y
CONFIG_MISC_PARTITION_NAME="para"
CONFIG_MTK_DETECT_KEY_ADDRESS=0x48004E28
CONFIG_MT_PART_GET_DEVICE_ADDRESS=0x48063524
CONFIG_NOKIA_WASP=y
CONFIG_PARTITION_GET_SIZE_BY_NAME_ADDRESS=0x480492AC
CONFIG_PARTITION_READ_ADDRESS=0x4804A438
CONFIG_PLATFORM_INIT_ADDRESS=0x48002BE0
CONFIG_PLATFORM_INIT_CALLER=0x4801EC7C
CONFIG_RECOVERY_CMDLINE1_ADDRESS=0x480DEF78
CONFIG_RECOVERY_CMDLINE_PATCH=y
CONFIG_SET_ENV_ADDRESS=0x480497D4
CONFIG_SPOOF_SUPPORT=y
CONFIG_STORAGE_SUPPORT=y
CONFIG_VIDEO_PRINTF_ADDRESS=0x4802FC70
```

## configs/tecno/lh8n_defconfig
```kconfig
CONFIG_BOOTLOADER_BASE=0x48200000
CONFIG_BOOTLOADER_SIZE=0x129B58
CONFIG_APP_ADDRESS=0x4822ECB8
CONFIG_APP_CALLER=0x4822C248
CONFIG_FASTBOOT_CONTINUE_ADDRESS=0x48230A2C
CONFIG_FASTBOOT_FAIL_ADDRESS=0x4822F6EC
CONFIG_FASTBOOT_INFO_ADDRESS=0x4822F644
CONFIG_FASTBOOT_OKAY_ADDRESS=0x4822F8C8
CONFIG_FASTBOOT_PUBLISH_ADDRESS=0x4822F2D0
CONFIG_FASTBOOT_REGISTER_ADDRESS=0x4822F294
CONFIG_FREE_ADDRESS=0x4823D250
CONFIG_LK_LOG_STORE_ADDRESS=0x48252EAC
CONFIG_MALLOC_ADDRESS=0x4823DC14
CONFIG_PARTITION_READ_ADDRESS=0x4825AF0C
CONFIG_PLATFORM_INIT_ADDRESS=0x482026EC
CONFIG_THREAD_CREATE_ADDRESS=0x4822B378
CONFIG_VIDEO_PRINTF_ADDRESS=0x4823C9F8
CONFIG_MTK_DETECT_KEY_ADDRESS=0x4820478C
CONFIG_TECNO_LH8N=y
CONFIG_MEDIATEK_MT6833=y
CONFIG_BOOTMODE_ADDRESS=0x4832C598
CONFIG_PLATFORM_INIT_CALLER=0x4822ab32
CONFIG_CERT_BYPASS=y
CONFIG_CERT_BYPASS_MODE="override"
CONFIG_STAGE1_SUPPORT=y
CONFIG_INIT_STORAGE_CALLER=0x4820271a
CONFIG_DPRINTF_ADDRESS=0x4823CE1C
CONFIG_PARTITION_GET_SIZE_BY_NAME_ADDRESS=0x48259C8C
CONFIG_INIT_STORAGE_ADDRESS=0x482025DC
```

## configs/xiaomi/angelican_defconfig
```kconfig
CONFIG_APP_ADDRESS=0x48024768
CONFIG_BOOTLOADER_BASE=0x48000000
CONFIG_BOOTLOADER_SIZE=0xCC7B0
CONFIG_BOOTMODE_ADDRESS=0x480CF5E4
CONFIG_FASTBOOT_FAIL_ADDRESS=0x48025618
CONFIG_FASTBOOT_INFO_ADDRESS=0x4802526C
CONFIG_FASTBOOT_OKAY_ADDRESS=0x48025438
CONFIG_FASTBOOT_PUBLISH_ADDRESS=0x48024EF8
CONFIG_FASTBOOT_REGISTER_ADDRESS=0x48024EBC
CONFIG_LK_LOG_STORE_ADDRESS=0x48045AB0
CONFIG_MEDIATEK_MT6765=y
CONFIG_MTK_DETECT_KEY_ADDRESS=0x48029AC8
CONFIG_PLATFORM_INIT_ADDRESS=0x4800295C
CONFIG_PLATFORM_INIT_CALLER=0x4801FA18
CONFIG_VIDEO_PRINTF_ADDRESS=0x48033650
CONFIG_XIAOMI_ANGELICAN=y
```

## configs/xiaomi/evergo_defconfig
```kconfig
CONFIG_APP_ADDRESS=0x48227cf4
CONFIG_BOOTLOADER_BASE=0x48200000
CONFIG_BOOTLOADER_SIZE=0x158D40
CONFIG_BOOTMODE_ADDRESS=0x4835b5bc
CONFIG_CERT_BYPASS=y
CONFIG_DPRINTF_ADDRESS=0x4823D5F8
CONFIG_ENVIRONMENT_SUPPORT=y
CONFIG_FASTBOOT_FAIL_ADDRESS=0x48228B88
CONFIG_FASTBOOT_INFO_ADDRESS=0x48228B08
CONFIG_FASTBOOT_OKAY_ADDRESS=0x48228E48
CONFIG_FASTBOOT_PUBLISH_ADDRESS=0x48228624
CONFIG_FASTBOOT_REGISTER_ADDRESS=0x482285E8
CONFIG_FREE_ADDRESS=0x4823DA2C
CONFIG_GET_ENV_ADDRESS=0x48257540
CONFIG_INIT_STORAGE_ADDRESS=0x482024bc
CONFIG_INIT_STORAGE_CALLER=0x48202600
CONFIG_LK_LOG_STORE_ADDRESS=0x482512BC
CONFIG_MALLOC_ADDRESS=0x4823E3F0
CONFIG_MEDIATEK_MT6833=y
CONFIG_MTK_DETECT_KEY_ADDRESS=0x48204514
CONFIG_PARTITION_GET_SIZE_BY_NAME_ADDRESS=0x482569dc
CONFIG_PARTITION_READ_ADDRESS=0x48258cb0
CONFIG_PLATFORM_INIT_ADDRESS=0x482025cc
CONFIG_PLATFORM_INIT_CALLER=0x48223a86
CONFIG_RECOVERY_CMDLINE1_ADDRESS=0x4835e558
CONFIG_RECOVERY_CMDLINE2_ADDRESS=0x4835dd54
CONFIG_RECOVERY_CMDLINE_PATCH=y
CONFIG_SET_ENV_ADDRESS=0x48257758
CONFIG_SPOOF_SUPPORT=y
CONFIG_STAGE1_SUPPORT=y
CONFIG_THREAD_CREATE_ADDRESS=0x48224248
CONFIG_VIDEO_PRINTF_ADDRESS=0x48229F0C
CONFIG_XIAOMI_EVERGO=y
```

## configs/xiaomi/fire_defconfig
```kconfig
CONFIG_APP_ADDRESS=0x4C42ABAC
CONFIG_BOOTLOADER_BASE=0x4C400000
CONFIG_BOOTLOADER_SIZE=0x177430
CONFIG_BOOTMODE_ADDRESS=0x4C5775D8
CONFIG_DPRINTF_ADDRESS=0x4C441188
CONFIG_ENVIRONMENT_SUPPORT=y
CONFIG_FASTBOOT_FAIL_ADDRESS=0x4C42BA64
CONFIG_FASTBOOT_INFO_ADDRESS=0x4C42B5F0
CONFIG_FASTBOOT_OKAY_ADDRESS=0x4C42B790
CONFIG_FASTBOOT_PUBLISH_ADDRESS=0x4C42B19C
CONFIG_FASTBOOT_REGISTER_ADDRESS=0x4C42B160
CONFIG_FREE_ADDRESS=0x4C4415B8
CONFIG_GET_ENV_ADDRESS=0x4C45DCB0
CONFIG_INIT_STORAGE_ADDRESS=0x4C403C3C
CONFIG_INIT_STORAGE_CALLER=0x4C403E5C
CONFIG_LK_LOG_STORE_ADDRESS=0x4C456A44
CONFIG_MALLOC_ADDRESS=0x4C441E84
CONFIG_MTK_DETECT_KEY_ADDRESS=0x4C405C1C
CONFIG_PARTITION_GET_SIZE_BY_NAME_ADDRESS=0x4C45D6E4
CONFIG_PARTITION_READ_ADDRESS=0x4C45F454
CONFIG_PLATFORM_INIT_ADDRESS=0x4C403E2C
CONFIG_PLATFORM_INIT_CALLER=0x4C426954
CONFIG_RECOVERY_CMDLINE1_ADDRESS=0x4C579FE0
CONFIG_RECOVERY_CMDLINE2_ADDRESS=0x4C57A7E4
CONFIG_RECOVERY_CMDLINE_PATCH=y
CONFIG_SET_ENV_ADDRESS=0x4C45DEC8
CONFIG_SPOOF_SUPPORT=y
CONFIG_STAGE1_SUPPORT=y
CONFIG_THREAD_CREATE_ADDRESS=0x4C427110
CONFIG_THREAD_RESUME_ADDRESS=0x4C427324
CONFIG_VIDEO_PRINTF_ADDRESS=0x4C42D98C
CONFIG_XIAOMI_FIRE=y
CONFIG_MEDIATEK_MT6768=y
```

## configs/xiaomi/gold_defconfig
```kconfig
CONFIG_APP_ADDRESS=0x4822F768
CONFIG_BOOTLOADER_BASE=0x48200000
CONFIG_BOOTLOADER_SIZE=0x16BEB0
CONFIG_BOOTMODE_ADDRESS=0x4836E668
CONFIG_CERT_BYPASS=y
CONFIG_DPRINTF_ADDRESS=0x48243F90
CONFIG_ENVIRONMENT_SUPPORT=y
CONFIG_FASTBOOT_FAIL_ADDRESS=0x482303B8
CONFIG_FASTBOOT_INFO_ADDRESS=0x48230338
CONFIG_FASTBOOT_OKAY_ADDRESS=0x48230658
CONFIG_FASTBOOT_PUBLISH_ADDRESS=0x4822FEE4
CONFIG_FASTBOOT_REGISTER_ADDRESS=0x4822FEA8
CONFIG_FREE_ADDRESS=0x482443C4
CONFIG_GET_ENV_ADDRESS=0x48261DF0
CONFIG_INIT_STORAGE_ADDRESS=0x48202A38
CONFIG_INIT_STORAGE_CALLER=0x48202B90
CONFIG_LK_LOG_STORE_ADDRESS=0x48259A80
CONFIG_MALLOC_ADDRESS=0x48244D88
CONFIG_MEDIATEK_MT6833=y
CONFIG_MTK_DETECT_KEY_ADDRESS=0x482049D8
CONFIG_PARTITION_GET_SIZE_BY_NAME_ADDRESS=0x48261ACC
CONFIG_PARTITION_READ_ADDRESS=0x48263560
CONFIG_PLATFORM_INIT_ADDRESS=0x48202B5C
CONFIG_PLATFORM_INIT_CALLER=0x4822B3BE
CONFIG_RECOVERY_CMDLINE1_ADDRESS=0x48374F24
CONFIG_RECOVERY_CMDLINE2_ADDRESS=0x48374724
CONFIG_RECOVERY_CMDLINE_PATCH=y
CONFIG_SET_ENV_ADDRESS=0x48262008
CONFIG_SPOOF_SUPPORT=y
CONFIG_THREAD_CREATE_ADDRESS=0x4822BB80
CONFIG_THREAD_RESUME_ADDRESS=0x4822BD98
CONFIG_VIDEO_PRINTF_ADDRESS=0x48232170
CONFIG_XIAOMI_GOLD=y
```

## configs/xiaomi/light_defconfig
```kconfig
CONFIG_APP_ADDRESS=0x48227950
CONFIG_BOOTLOADER_BASE=0x48200000
CONFIG_BOOTLOADER_SIZE=0x152E20
CONFIG_BOOTMODE_ADDRESS=0x483555A4
CONFIG_CERT_BYPASS=y
CONFIG_DPRINTF_ADDRESS=0x482389F8
CONFIG_ENVIRONMENT_SUPPORT=y
CONFIG_FASTBOOT_FAIL_ADDRESS=0x482284D0
CONFIG_FASTBOOT_INFO_ADDRESS=0x48228450
CONFIG_FASTBOOT_OKAY_ADDRESS=0x48228778
CONFIG_FASTBOOT_PUBLISH_ADDRESS=0x482280DC
CONFIG_FASTBOOT_REGISTER_ADDRESS=0x482280A0
CONFIG_FREE_ADDRESS=0x48238E2C
CONFIG_GET_ENV_ADDRESS=0x4825440C
CONFIG_SET_ENV_ADDRESS=0x48254624
CONFIG_INIT_STORAGE_ADDRESS=0x48202574
CONFIG_INIT_STORAGE_CALLER=0x482026BC
CONFIG_LK_LOG_STORE_ADDRESS=0x4824D3AC
CONFIG_MALLOC_ADDRESS=0x482397F0
CONFIG_MTK_DETECT_KEY_ADDRESS=0x4820446C
CONFIG_PARTITION_GET_SIZE_BY_NAME_ADDRESS=0x48253900
CONFIG_PARTITION_READ_ADDRESS=0x4825536C
CONFIG_PLATFORM_INIT_ADDRESS=0x48202688
CONFIG_PLATFORM_INIT_CALLER=0x48223676
CONFIG_RECOVERY_CMDLINE_PATCH=y
CONFIG_RECOVERY_CMDLINE1_ADDRESS=0x48357D9C
CONFIG_RECOVERY_CMDLINE2_ADDRESS=0x483585A0
CONFIG_SPOOF_SUPPORT=y
CONFIG_STAGE1_SUPPORT=y
CONFIG_THREAD_CREATE_ADDRESS=0x48223E38
CONFIG_THREAD_RESUME_ADDRESS=0x48224050
CONFIG_VIDEO_PRINTF_ADDRESS=0x482383C4
CONFIG_XIAOMI_LIGHT=y
CONFIG_MEDIATEK_MT6833=y
```

## configs/xiaomi/pissarro_defconfig
```kconfig
CONFIG_APP_ADDRESS=0x4822B650
CONFIG_BOOTLOADER_BASE=0x48200000
CONFIG_BOOTLOADER_SIZE=0x14A40C
CONFIG_BOOTMODE_ADDRESS=0x4834A22C
CONFIG_CERT_BYPASS=y
CONFIG_DPRINTF_ADDRESS=0x482407D4
CONFIG_ENVIRONMENT_SUPPORT=y
CONFIG_FASTBOOT_FAIL_ADDRESS=0x4822C280
CONFIG_FASTBOOT_INFO_ADDRESS=0x4822C200
CONFIG_FASTBOOT_OKAY_ADDRESS=0x4822C484
CONFIG_FASTBOOT_PUBLISH_ADDRESS=0x4822BD1C
CONFIG_FASTBOOT_REGISTER_ADDRESS=0x4822BCE0
CONFIG_FREE_ADDRESS=0x48240C08
CONFIG_GET_ENV_ADDRESS=0x4825C194
CONFIG_SET_ENV_ADDRESS=0x4825C3AC
CONFIG_INIT_STORAGE_ADDRESS=0x48271A5C
CONFIG_INIT_STORAGE_CALLER=0x482038CA
CONFIG_LK_LOG_STORE_ADDRESS=0x482548C8
CONFIG_MALLOC_ADDRESS=0x482415CC
CONFIG_MTK_DETECT_KEY_ADDRESS=0x48205A8C
CONFIG_PARTITION_GET_SIZE_BY_NAME_ADDRESS=0x4825BE70
CONFIG_PARTITION_READ_ADDRESS=0x4825D0E0
CONFIG_PLATFORM_INIT_ADDRESS=0x48203A6C
CONFIG_PLATFORM_INIT_CALLER=0x4822734A
CONFIG_RECOVERY_CMDLINE_PATCH=y
CONFIG_RECOVERY_CMDLINE1_ADDRESS=0x4835061C
CONFIG_RECOVERY_CMDLINE2_ADDRESS=0x0
CONFIG_SPOOF_SUPPORT=y
CONFIG_STAGE1_SUPPORT=y
CONFIG_THREAD_CREATE_ADDRESS=0x48227B0C
CONFIG_VIDEO_PRINTF_ADDRESS=0x48240258
CONFIG_XIAOMI_PISSARRO=y
CONFIG_MEDIATEK_MT6877=y
```

## configs/xiaomi/selene_defconfig
```kconfig
CONFIG_MEDIATEK_MT6768=y
CONFIG_XIAOMI_SELENE=y
CONFIG_FASTBOOT_FAIL_ADDRESS=0x4C4265F8
CONFIG_FASTBOOT_INFO_ADDRESS=0x4C426578
CONFIG_FASTBOOT_OKAY_ADDRESS=0x4C4268A8
CONFIG_FASTBOOT_PUBLISH_ADDRESS=0x4C426190
CONFIG_FASTBOOT_REGISTER_ADDRESS=0x4C426154
CONFIG_ENVIRONMENT_SUPPORT=y
CONFIG_GET_ENV_ADDRESS=0x4C45553C
CONFIG_SET_ENV_ADDRESS=0x4C455754
CONFIG_SPOOF_SUPPORT=y
CONFIG_BOOTLOADER_BASE=0x4C400000
CONFIG_BOOTLOADER_SIZE=0x160D48
CONFIG_BOOTMODE_ADDRESS=0x4C5635C0
CONFIG_PLATFORM_INIT_CALLER=0x4C422040
CONFIG_PLATFORM_INIT_ADDRESS=0x4C403830
CONFIG_APP_ADDRESS=0x4C425AE8
CONFIG_MTK_DETECT_KEY_ADDRESS=0x4C4052D8
CONFIG_THREAD_CREATE_ADDRESS=0c4C4223C4
CONFIG_THREAD_RESUME_ADDRESS=0x4C422558
CONFIG_VIDEO_PRINTF_ADDRESS=0x4C428594
CONFIG_LK_LOG_STORE_ADDRESS=0x4C44EABC
CONFIG_CERT_BYPASS=y
CONFIG_CERT_BYPASS_MODE="wrap"
CONFIG_STAGE1_SUPPORT=y
CONFIG_INIT_STORAGE_CALLER=0x4C40385E
CONFIG_INIT_STORAGE_ADDRESS=0x4C403688
CONFIG_RECOVERY_CMDLINE1_ADDRESS=0x4C566724
CONFIG_RECOVERY_CMDLINE2_ADDRESS=0x4C565F1E
CONFIG_RECOVERY_CMDLINE_PATCH=y
CONFIG_MALLOC_ADDRESS=0x4C43C098
CONFIG_DPRINTF_ADDRESS=0x4C43B3A8
CONFIG_FREE_ADDRESS=0x4C43B7DC
CONFIG_PARTITION_READ_ADDRESS=0x4C4564B8
CONFIG_PARTITION_GET_SIZE_BY_NAME_ADDRESS=0x4C455218
```

## stage1/Kconfig
```kconfig
menu "Stage 1 Options"
    config USE_MT_PART_API
        bool "Use mt_part_* APIs for storage accesses"
        default n
        help
            Enable this if the devices LK only provides mt_part_* APIs
            for storage accesses. You will need to provide addresses
            for mt_part_get_device and mt_part_get_partition().

    config USE_LEGACY_PARTITION_API
        bool "Use legacy partition_* APIs for storage accesses"
        depends on !USE_MT_PART_API
        default n
        help
            Enable this if the devices LK only provides partition_get_index,
            partition_get_offset and partition_get_size and does not use
            the mt_part_* API for partition accesses. You will need to
            provide addresses for the aformentioned functions.

    config PARTITION_GET_INDEX_ADDRESS
        hex "partition_get_index() address"
        depends on USE_LEGACY_PARTITION_API

    config PARTITION_GET_OFFSET_ADDRESS
        hex "partition_get_offset() address"
        depends on USE_LEGACY_PARTITION_API

    config PARTITION_GET_SIZE_ADDRESS
        hex "partition_get_size() address"
        depends on USE_LEGACY_PARTITION_API

    config BOOTLOADER_PARTITION_NAME
        string "Bootloader partition name"
        default "lk"
        help
            Name of the partition containing the bootloader image.
            On most MediaTek devices this is lk, but some devices may use
            different names like "UBOOT" or "LK".

    config INIT_STORAGE_CALLER
        hex "init_storage() caller address"

    config INIT_STORAGE_ADDRESS
        hex "init_storage() address"

    config MALLOC_ADDRESS
        hex "malloc() address"

    config DPRINTF_ADDRESS
        hex "dprintf() address"

    config FREE_ADDRESS
        hex "free() address"

    config PARTITION_READ_ADDRESS
        hex "partition_read() address"
        depends on !USE_MT_PART_API && !USE_LEGACY_PARTITION_API

    config PARTITION_GET_SIZE_BY_NAME_ADDRESS
        hex "partition_get_size_by_name() address"
        depends on !USE_MT_PART_API && !USE_LEGACY_PARTITION_API

endmenu
```
