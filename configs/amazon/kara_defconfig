## configs/amazon/kara_defconfig
```kconfig
CONFIG_AMAZON_KARA=y
CONFIG_APP_ADDRESS=0x41E2976C
CONFIG_BOOTLOADER_BASE=0x41E00000
CONFIG_BOOTLOADER_MESSAGE_SUPPORT=y
CONFIG_BOOTLOADER_SIZE=0x656CC
CONFIG_BOOTMODE_ADDRESS=0x41E6D7E8
CONFIG_DPRINTF_ADDRESS=0x41E2BEA0
CONFIG_ENVIRONMENT_SUPPORT=y
CONFIG_KAERU_ENV=y
CONFIG_KAERU_ENV_PARTITION="persist"
CONFIG_FASTBOOT_FAIL_ADDRESS=0x41E29C88
CONFIG_FASTBOOT_INFO_ADDRESS=0x41E29C4C
CONFIG_FASTBOOT_OKAY_ADDRESS=0x41E29DF0
CONFIG_FASTBOOT_PUBLISH_ADDRESS=0x41E29A8C
CONFIG_FASTBOOT_REGISTER_ADDRESS=0x41E29A50
CONFIG_FASTBOOT_CMDLIST_ADDRESS=0x41EF9FD0
CONFIG_FASTBOOT_FETCH_COMMAND=y
CONFIG_FASTBOOT_USB_WRITE_ADDRESS=0x41E29B78
CONFIG_FASTBOOT_GETVAR_ADDRESS=0x41E2A3DC
CONFIG_FREE_ADDRESS=0x41E2C7C6
CONFIG_IDMELIB_SUPPORT=y
CONFIG_INIT_STORAGE_ADDRESS=0x41E23EA0
CONFIG_INIT_STORAGE_CALLER=0x41E0FD8C
CONFIG_USE_MT_PART_API=y
CONFIG_LK_LOG_STORE=n
CONFIG_LK_SIGNATURE_SIZE=0x104
CONFIG_MALLOC_ADDRESS=0x41E2C798
CONFIG_MEDIATEK_MT8696=y
CONFIG_MISC_PARTITION_NAME="MISC"
CONFIG_MTK_DETECT_KEY_ADDRESS=0x0
CONFIG_MT_PART_GET_DEVICE_ADDRESS=0x41E26184
CONFIG_MT_PART_GET_PARTITION_ADDRESS=0x41E1F2EC
CONFIG_PLATFORM_INIT_ADDRESS=0x41E0FD68
CONFIG_PLATFORM_INIT_CALLER=0x41E2747E
CONFIG_STORAGE_SUPPORT=y
CONFIG_THREAD_CREATE_ADDRESS=0x41E279FC
CONFIG_VIDEO_PRINTF_ADDRESS=0x41E2BC56
```

## configs/amazon/quartz_defconfig
```kconfig
CONFIG_MEDIATEK_MT8168=y
CONFIG_AMAZON_QUARTZ=y
CONFIG_FASTBOOT_CMDLIST_ADDRESS=0x560BF090
CONFIG_FASTBOOT_FAIL_ADDRESS=0x5602E800
CONFIG_FASTBOOT_INFO_ADDRESS=0x5602E784
CONFIG_FASTBOOT_OKAY_ADDRESS=0x5602E968
CONFIG_FASTBOOT_PUBLISH_ADDRESS=0x5602E54C
CONFIG_FASTBOOT_REGISTER_ADDRESS=0x5602E510
CONFIG_FASTBOOT_FETCH_COMMAND=y
CONFIG_FASTBOOT_USB_WRITE_ADDRESS=0x5602E618
CONFIG_FASTBOOT_GETVAR_ADDRESS=0x5602F930
CONFIG_BOOTLOADER_BASE=0x56000000
CONFIG_BOOTLOADER_SIZE=0x8A330
CONFIG_BOOTMODE_ADDRESS=0x56094498
CONFIG_PLATFORM_INIT_CALLER=0x5602AB9E
CONFIG_PLATFORM_INIT_ADDRESS=0x5600F0A4
CONFIG_APP_ADDRESS=0x5602DA70
CONFIG_MTK_DETECT_KEY_ADDRESS=0x56010360
CONFIG_VIDEO_PRINTF_ADDRESS=0x5603479C
CONFIG_LK_LOG_STORE=y
CONFIG_LK_LOG_STORE_ADDRESS=0x5603E090
CONFIG_LK_SIGNATURE_SIZE=0x118
CONFIG_INIT_STORAGE_CALLER=0x5600F0C4
CONFIG_INIT_STORAGE_ADDRESS=0x5602673C
CONFIG_MALLOC_ADDRESS=0x56035594
CONFIG_DPRINTF_ADDRESS=0x56034A50
CONFIG_FREE_ADDRESS=0x56034E50
CONFIG_PARTITION_READ_ADDRESS=0x5603E254
CONFIG_PARTITION_GET_SIZE_BY_NAME_ADDRESS=0x5603E238
CONFIG_MT_PART_GET_DEVICE_ADDRESS=0x560488E0
CONFIG_STORAGE_SUPPORT=y
CONFIG_IDMELIB_SUPPORT=y
CONFIG_BOOTLOADER_MESSAGE_SUPPORT=y
```

## configs/xiaomi/angelica_defconfig
```kconfig
CONFIG_APP_ADDRESS=0x48024748
CONFIG_BOOTLOADER_BASE=0x48000000
CONFIG_BOOTLOADER_SIZE=0xCC790
CONFIG_DPRINTF_ADDRESS=0x48033920
CONFIG_FASTBOOT_INFO_ADDRESS=0x4802524C
CONFIG_FASTBOOT_OKAY_ADDRESS=0x480255f8
CONFIG_FASTBOOT_PUBLISH_ADDRESS=0x48024ED8
CONFIG_FASTBOOT_REGISTER_ADDRESS=0x48024E9C
CONFIG_FREE_ADDRESS=0x48033D50
CONFIG_INIT_STORAGE_CALLER=0x4800298c
CONFIG_LK_LOG_STORE_ADDRESS=0x48045A90
CONFIG_MALLOC_ADDRESS=0x48034598
CONFIG_PARTITION_READ_ADDRESS=0x4804D220
CONFIG_PLATFORM_INIT_ADDRESS=0x4800295C
CONFIG_THREAD_CREATE_ADDRESS=0x480201D4
CONFIG_THREAD_RESUME_ADDRESS=0x480203E8
CONFIG_VIDEO_PRINTF_ADDRESS=0x48033630
CONFIG_XIAOMI_ANGELICA=y
CONFIG_MEDIATEK_MT6765=y
CONFIG_FASTBOOT_FAIL_ADDRESS=0x48025418
CONFIG_BOOTMODE_ADDRESS=0x480cf5e4
CONFIG_INIT_STORAGE_ADDRESS=0x48002770
CONFIG_PARTITION_GET_SIZE_BY_NAME_ADDRESS=0x4804c094
CONFIG_PLATFORM_INIT_CALLER=0x4801fa18
CONFIG_ENVIRONMENT_SUPPORT=y
CONFIG_SPOOF_SUPPORT=y
CONFIG_GET_ENV_ADDRESS=0x4804c338
CONFIG_SET_ENV_ADDRESS=0x4804c5bc
```
