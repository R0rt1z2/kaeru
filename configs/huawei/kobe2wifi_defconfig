## configs/meizu/m711h_defconfig
```kconfig
CONFIG_APP_CALLER=0x4601D47C
CONFIG_APP_ADDRESS=0x4601edd8
CONFIG_BOOTLOADER_BASE=0x46000000
CONFIG_BOOTLOADER_SIZE=0x63010
CONFIG_FASTBOOT_FAIL_ADDRESS=0x4601f2d0
CONFIG_FASTBOOT_OKAY_ADDRESS=0x4601f490
CONFIG_FASTBOOT_INFO_ADDRESS=0x4601f288
CONFIG_FASTBOOT_PUBLISH_ADDRESS=0x4601F0E4
CONFIG_FASTBOOT_REGISTER_ADDRESS=0x4601F0A8
CONFIG_FREE_ADDRESS=0x46026C1C
CONFIG_LK_LOG_STORE=n
CONFIG_PLATFORM_INIT_ADDRESS=0x46001a38
CONFIG_PLATFORM_INIT_CALLER=0x4601c79e
CONFIG_INIT_STORAGE_ADDRESS=0x460057e0
CONFIG_INIT_STORAGE_CALLER=0x46001aaa
CONFIG_THREAD_CREATE_ADDRESS=0x4601C998
CONFIG_THREAD_RESUME_ADDRESS=0x4601CB2C
CONFIG_VIDEO_PRINTF_ADDRESS=0x46026674
CONFIG_DPRINTF_ADDRESS=0x460268f0
CONFIG_MEIZU_M711H=y
CONFIG_MEDIATEK_MT6755=y
CONFIG_MTK_DETECT_KEY_ADDRESS=0x46004544
CONFIG_MALLOC_ADDRESS=0x46027478
CONFIG_LEGACY_LK=y
CONFIG_STAGE1_SUPPORT=y
CONFIG_MT_PART_GET_DEVICE_ADDRESS=0x4601b81c
CONFIG_MT_PART_GET_PARTITION_ADDRESS=0x46004100
CONFIG_BOOTMODE_ADDRESS=0x46064510
```

## configs/meizu/mx6_defconfig
```kconfig
CONFIG_APP_ADDRESS=0x46020954
CONFIG_BOOTLOADER_BASE=0x46000000
CONFIG_BOOTLOADER_SIZE=0x4E8D4
CONFIG_BOOTMODE_ADDRESS=0x46050518
CONFIG_DPRINTF_ADDRESS=0x460245F8
CONFIG_FASTBOOT_FAIL_ADDRESS=0x46020DFC
CONFIG_FASTBOOT_INFO_ADDRESS=0x46020DB4
CONFIG_FASTBOOT_OKAY_ADDRESS=0x46020FA4
CONFIG_FASTBOOT_PUBLISH_ADDRESS=0x46020C10
CONFIG_FASTBOOT_REGISTER_ADDRESS=0x46020BDC
CONFIG_FREE_ADDRESS=0x4602491C
CONFIG_INIT_STORAGE_ADDRESS=0x46008FBC
CONFIG_INIT_STORAGE_CALLER=0x4600531A
CONFIG_LEGACY_LK=y
CONFIG_LK_LOG_STORE=n
CONFIG_MALLOC_ADDRESS=0x460251F4
CONFIG_MEDIATEK_MT6797=y
CONFIG_MEIZU_MX6=y
CONFIG_MTK_DETECT_KEY_ADDRESS=0x460078D0
CONFIG_MT_PART_GET_DEVICE_ADDRESS=0x4600755C
CONFIG_MT_PART_GET_PARTITION_ADDRESS=0x460073F0
CONFIG_PLATFORM_INIT_ADDRESS=0x46005310
CONFIG_PLATFORM_INIT_CALLER=0x4601EA8A
CONFIG_STAGE1_SUPPORT=y
CONFIG_THREAD_RESUME_ADDRESS=0x4601EE04
CONFIG_VIDEO_PRINTF_ADDRESS=0x46024394
```

## configs/motorola/borag_defconfig
```kconfig
CONFIG_APP_CALLER=0x48022838
CONFIG_APP_ADDRESS=0x480251DC
CONFIG_BOOTLOADER_BASE=0x48000000
CONFIG_BOOTLOADER_SIZE=0xF87E8
CONFIG_BOOTMODE_ADDRESS=0x480FB5D0
CONFIG_FASTBOOT_FAIL_ADDRESS=0x48025B14
CONFIG_FASTBOOT_INFO_ADDRESS=0x48025A94
CONFIG_FASTBOOT_OKAY_ADDRESS=0x48025D48
CONFIG_FASTBOOT_PUBLISH_ADDRESS=0x48025720
CONFIG_FASTBOOT_REGISTER_ADDRESS=0x480256E4
CONFIG_LK_LOG_STORE_ADDRESS=0x48049250
CONFIG_MTK_DETECT_KEY_ADDRESS=0x48004C68
CONFIG_PLATFORM_INIT_ADDRESS=0x48002C88
CONFIG_PLATFORM_INIT_CALLER=0x48021194
CONFIG_VIDEO_PRINTF_ADDRESS=0x48034CDC
CONFIG_MOTOROLA_BORAG=y
CONFIG_MEDIATEK_MT6765=y
```

## configs/motorola/borago_defconfig
```kconfig
CONFIG_APP_ADDRESS=0x480251DC
CONFIG_APP_CALLER=0x48022838
CONFIG_BOOTLOADER_BASE=0x48000000
CONFIG_BOOTLOADER_SIZE=0xF87F0
CONFIG_BOOTMODE_ADDRESS=0x480FB5D0
CONFIG_DPRINTF_ADDRESS=0x48034FD8
CONFIG_FASTBOOT_CONTINUE_ADDRESS=0x48026E0C
CONFIG_FASTBOOT_FAIL_ADDRESS=0x48025B14
CONFIG_FASTBOOT_INFO_ADDRESS=0x48025A94
CONFIG_FASTBOOT_OKAY_ADDRESS=0x48025D48
CONFIG_FASTBOOT_PUBLISH_ADDRESS=0x48025720
CONFIG_FASTBOOT_REGISTER_ADDRESS=0x480256E4
CONFIG_FREE_ADDRESS=0x48035408
CONFIG_INIT_STORAGE_ADDRESS=0x48002AA0
CONFIG_INIT_STORAGE_CALLER=0x48002CBE
CONFIG_LK_LOG_STORE_ADDRESS=0x48049250
CONFIG_MALLOC_ADDRESS=0x48035C90
CONFIG_MEDIATEK_MT6765=y
CONFIG_MOTOROLA_BORAGO=y
CONFIG_MTK_DETECT_KEY_ADDRESS=0x48004C68
CONFIG_PARTITION_GET_SIZE_BY_NAME_ADDRESS=0x4804FD44
CONFIG_PARTITION_READ_ADDRESS=0x48050FE0
CONFIG_PLATFORM_INIT_ADDRESS=0x48002C88
CONFIG_PLATFORM_INIT_CALLER=0x48021194
CONFIG_STAGE1_SUPPORT=y
CONFIG_THREAD_CREATE_ADDRESS=0x48021950
CONFIG_THREAD_RESUME_ADDRESS=0x48021B64
CONFIG_VIDEO_PRINTF_ADDRESS=0x48034CDC
```

## configs/motorola/ellis_defconfig
```kconfig
CONFIG_APP_ADDRESS=0x480639DC
CONFIG_BOOTLOADER_BASE=0x48000000
CONFIG_BOOTLOADER_SIZE=0x143844
CONFIG_BOOTMODE_ADDRESS=0x481465C0
CONFIG_DPRINTF_ADDRESS=0x48036F7C
CONFIG_ENVIRONMENT_SUPPORT=y
CONFIG_FASTBOOT_SEND_INFO_ADDRESS=0x48059800
CONFIG_FASTBOOT_SEND_RESPONSE_ADDRESS=0x4805932C
CONFIG_FASTBOOT_STYLE_COMBINED=y
CONFIG_FREE_ADDRESS=0x480373B8
CONFIG_GET_ENV_ADDRESS=0x480507D8
CONFIG_INIT_STORAGE_ADDRESS=0x48002A14
CONFIG_INIT_STORAGE_CALLER=0x48002D00
CONFIG_LK_LOG_STORE=n
CONFIG_MALLOC_ADDRESS=0x48037EDC
CONFIG_MEDIATEK_MT6762=y
CONFIG_MOTOROLA_ELLIS=y
CONFIG_MTK_DETECT_KEY_ADDRESS=0x48003FB0
CONFIG_PARTITION_GET_SIZE_BY_NAME_ADDRESS=0x48050520
CONFIG_PARTITION_READ_ADDRESS=0x48051848
CONFIG_PLATFORM_INIT_ADDRESS=0x48002CD4
CONFIG_PLATFORM_INIT_CALLER=0x4801FAA6
CONFIG_SET_ENV_ADDRESS=0x48050A80
CONFIG_STAGE1_SUPPORT=y
CONFIG_THREAD_CREATE_ADDRESS=0x4801FF78
CONFIG_THREAD_RESUME_ADDRESS=0x4802010C
CONFIG_VIDEO_PRINTF_ADDRESS=0x48036BC4
```

## configs/motorola/hawaiip_defconfig
```kconfig
CONFIG_APP_ADDRESS=0x48024CD8
CONFIG_BOOTLOADER_BASE=0x48000000
CONFIG_BOOTLOADER_SIZE=0xCC1F8
CONFIG_BOOTMODE_ADDRESS=0x480CF5CC
CONFIG_DPRINTF_ADDRESS=0x48032A88
CONFIG_FASTBOOT_FAIL_ADDRESS=0x48025C50
CONFIG_FASTBOOT_INFO_ADDRESS=0x48025BD0
CONFIG_FASTBOOT_OKAY_ADDRESS=0x48025EF8
CONFIG_FASTBOOT_PUBLISH_ADDRESS=0x4802585C
CONFIG_FASTBOOT_REGISTER_ADDRESS=0x48025820
CONFIG_FREE_ADDRESS=0x48032EB8
CONFIG_INIT_STORAGE_ADDRESS=0x48002A14
CONFIG_INIT_STORAGE_CALLER=0x48002C32
CONFIG_LK_LOG_STORE_ADDRESS=0x48046C48
CONFIG_MALLOC_ADDRESS=0x48033700
CONFIG_MEDIATEK_MT6765=y
CONFIG_MOTOROLA_HAWAIIP=y
CONFIG_MTK_DETECT_KEY_ADDRESS=0x4800502C
CONFIG_PARTITION_GET_SIZE_BY_NAME_ADDRESS=0x4804D720
CONFIG_PARTITION_READ_ADDRESS=0x4804E84C
CONFIG_PLATFORM_INIT_ADDRESS=0x48002BFC
CONFIG_PLATFORM_INIT_CALLER=0x48020B74
CONFIG_STAGE1_SUPPORT=y
CONFIG_VIDEO_PRINTF_ADDRESS=0x480325C0
```

## configs/motorola/lagos_defconfig
```kconfig
CONFIG_APP_ADDRESS=0x4C42D794
CONFIG_APP_CALLER=0x4C427AB4
CONFIG_BOOTLOADER_BASE=0x4C400000
CONFIG_BOOTLOADER_SIZE=0x17B1F4
CONFIG_BOOTMODE_ADDRESS=0x4C57E59C
CONFIG_DPRINTF_ADDRESS=0x4C4433BC
CONFIG_FASTBOOT_FAIL_ADDRESS=0x4C42E348
CONFIG_FASTBOOT_INFO_ADDRESS=0x4C42E2C8
CONFIG_FASTBOOT_OKAY_ADDRESS=0x4C42E514
CONFIG_FASTBOOT_PUBLISH_ADDRESS=0x4C42DD38
CONFIG_FASTBOOT_REGISTER_ADDRESS=0x4C42DCFC
CONFIG_FREE_ADDRESS=0x4C443870
CONFIG_INIT_STORAGE_ADDRESS=0x4C40381C
CONFIG_INIT_STORAGE_CALLER=0x4C403A3C
CONFIG_LK_LOG_STORE_ADDRESS=0x4C4589D0
CONFIG_MALLOC_ADDRESS=0x4C444184
CONFIG_MEDIATEK_MT6768=y
CONFIG_MOTOROLA_LAGOS=y
CONFIG_MTK_DETECT_KEY_ADDRESS=0x4C4055A8
CONFIG_PARTITION_GET_SIZE_BY_NAME_ADDRESS=0x4C45F658
CONFIG_PARTITION_READ_ADDRESS=0x4C4608F8
CONFIG_PLATFORM_INIT_ADDRESS=0x4C403A0C
CONFIG_PLATFORM_INIT_CALLER=0x4C4263EC
CONFIG_STAGE1_SUPPORT=y
CONFIG_THREAD_CREATE_ADDRESS=0x4C426BCC
CONFIG_THREAD_RESUME_ADDRESS=0x4C426DE0
CONFIG_VIDEO_PRINTF_ADDRESS=0x4C442D74
```
