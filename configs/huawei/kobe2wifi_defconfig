## configs/huawei/kobe2wifi_defconfig
```kconfig
CONFIG_APP_ADDRESS=0x48030380
CONFIG_APP_CALLER=0x48028524
CONFIG_BOOTLOADER_BASE=0x48000000
CONFIG_BOOTLOADER_SIZE=0x192424
CONFIG_BOOTMODE_ADDRESS=0x48195D9C
CONFIG_FASTBOOT_FAIL_ADDRESS=0x48030B58
CONFIG_FASTBOOT_INFO_ADDRESS=0x48030AFC
CONFIG_FASTBOOT_OKAY_ADDRESS=0x48030CD0
CONFIG_FASTBOOT_PUBLISH_ADDRESS=0x48030858
CONFIG_FASTBOOT_REGISTER_ADDRESS=0x4803081C
CONFIG_LK_LOG_STORE_ADDRESS=0x48071308
CONFIG_MTK_DETECT_KEY_ADDRESS=0x4800E210
CONFIG_PLATFORM_INIT_ADDRESS=0x4800C2B8
CONFIG_PLATFORM_INIT_CALLER=0x480275E8
CONFIG_VIDEO_PRINTF_ADDRESS=0x4805BB54
CONFIG_HUAWEI_KOBE2WIFI=y
CONFIG_MEDIATEK_MT6765=y
```

## configs/huawei/madrid_defconfig
```kconfig
CONFIG_APP_ADDRESS=0x48028C78
CONFIG_BOOTLOADER_BASE=0x48000000
CONFIG_BOOTLOADER_SIZE=0x16FA94
CONFIG_BOOTMODE_ADDRESS=0x48172BBC
CONFIG_FASTBOOT_FAIL_ADDRESS=0x48029C58
CONFIG_FASTBOOT_INFO_ADDRESS=0x48029BFC
CONFIG_FASTBOOT_OKAY_ADDRESS=0x48029DD0
CONFIG_FASTBOOT_PUBLISH_ADDRESS=0x48029958
CONFIG_FASTBOOT_REGISTER_ADDRESS=0x4802991C
CONFIG_LK_LOG_STORE_ADDRESS=0x480470C0
CONFIG_HUAWEI_MADRID=y
CONFIG_MEDIATEK_MT6761=y
CONFIG_MTK_DETECT_KEY_ADDRESS=0x4800942C
CONFIG_PLATFORM_INIT_ADDRESS=0x48007A80
CONFIG_PLATFORM_INIT_CALLER=0x48023BBC
CONFIG_VIDEO_PRINTF_ADDRESS=0x480347F0
```

## configs/huawei/maya_defconfig
```kconfig
CONFIG_APP_ADDRESS=0x41E1C6D0
CONFIG_APP_CALLER=0x41E1AB00
CONFIG_BOOTLOADER_BASE=0x41E00000
CONFIG_BOOTLOADER_SIZE=0x6FB44
CONFIG_BOOTMODE_ADDRESS=0x41E70A30
CONFIG_FASTBOOT_INFO_ADDRESS=0x41E1CC88
CONFIG_FASTBOOT_FAIL_ADDRESS=0x41E1CCD0
CONFIG_FASTBOOT_OKAY_ADDRESS=0x41E1CD20
CONFIG_FASTBOOT_PUBLISH_ADDRESS=0x41E1CA7C
CONFIG_FASTBOOT_REGISTER_ADDRESS=0x41E1CA48
CONFIG_MTK_DETECT_KEY_ADDRESS=0x41E05A70
CONFIG_FREE_ADDRESS=0x41E25CDC
CONFIG_LK_LOG_STORE=n
CONFIG_MALLOC_ADDRESS=0x41E26578
CONFIG_MEDIATEK_MT6737=y
CONFIG_THREAD_RESUME_ADDRESS=0x41E1A284
CONFIG_VIDEO_PRINTF_ADDRESS=0x41E25724
CONFIG_PLATFORM_INIT_ADDRESS=0x41E02054
CONFIG_PLATFORM_INIT_CALLER=0x41E19F0A
CONFIG_INIT_STORAGE_ADDRESS=0x41E06D1C
CONFIG_INIT_STORAGE_CALLER=0x41E020B0
CONFIG_HUAWEI_MAYA=y
CONFIG_LEGACY_LK=y
CONFIG_STAGE1_SUPPORT=y
CONFIG_DPRINTF_ADDRESS=0x41E259B8
CONFIG_MT_PART_GET_DEVICE_ADDRESS=0x41E056DC
CONFIG_MT_PART_GET_PARTITION_ADDRESS=0x41E05538
```

## configs/huawei/modena1_defconfig
```kconfig
CONFIG_APP_ADDRESS=0x4802FEB8
CONFIG_BOOTLOADER_BASE=0x48000000
CONFIG_BOOTLOADER_SIZE=0x1A8384
CONFIG_BOOTMODE_ADDRESS=0x481ABD94
CONFIG_FASTBOOT_FAIL_ADDRESS=0x48030690
CONFIG_FASTBOOT_INFO_ADDRESS=0x48030634
CONFIG_FASTBOOT_OKAY_ADDRESS=0x48030808
CONFIG_FASTBOOT_PUBLISH_ADDRESS=0x48030390
CONFIG_FASTBOOT_REGISTER_ADDRESS=0x48030354
CONFIG_LK_LOG_STORE_ADDRESS=0x4807148C
CONFIG_MTK_DETECT_KEY_ADDRESS=0x4800DB90
CONFIG_PLATFORM_INIT_ADDRESS=0x4800BC38
CONFIG_PLATFORM_INIT_CALLER=0x48027120
CONFIG_VIDEO_PRINTF_ADDRESS=0x4805BDB0
CONFIG_HUAWEI_MODENA1=y
CONFIG_MEDIATEK_MT6765=y
```

## configs/infinix/X6532_defconfig
```kconfig
CONFIG_APP_ADDRESS=0x4C42CBB0
CONFIG_BOOTLOADER_BASE=0x4C400000
CONFIG_BOOTLOADER_SIZE=0x12421C
CONFIG_DPRINTF_ADDRESS=0x4C439D9C
CONFIG_FASTBOOT_CONTINUE=0x4C42DAD4
CONFIG_FASTBOOT_INFO_ADDRESS=0x4C42C0E8
CONFIG_FASTBOOT_PUBLISH_ADDRESS=0x4C42BD74
CONFIG_FASTBOOT_REGISTER_ADDRESS=0x4C42BD38
CONFIG_FREE_ADDRESS=0x4C43A1CC
CONFIG_INFINIX_X6532=y
CONFIG_INIT_STORAGE_ADDRESS=0x4C40383C
CONFIG_INIT_STORAGE_CALLER=0x4C403A5C
CONFIG_LK_LOG_STORE_ADDRESS=0x4C44FAAC
CONFIG_MALLOC_ADDRESS=0x4C43AA98
CONFIG_MEDIATEK_MT6769=y
CONFIG_PARTITION_GET_SIZE_BY_NAME_ADDRESS=0x4C4568F0
CONFIG_PLATFORM_INIT_ADDRESS=0x4C403A2C
CONFIG_PLATFORM_INIT_CALLER=0x4C427524
CONFIG_THREAD_CREATE_ADDRESS=0x4C427D64
CONFIG_THREAD_RESUME_ADDRESS=0x4C427F78
CONFIG_VIDEO_PRINTF_ADDRESS=0x4C43997C
```

## configs/infinix/X670_defconfig
```kconfig
CONFIG_APP_ADDRESS=0x4C429238
CONFIG_APP_CALLER=0x4C4267AC
CONFIG_BOOTLOADER_BASE=0x4C400000
CONFIG_BOOTLOADER_SIZE=0x109500
CONFIG_BOOTMODE_ADDRESS=0x4C50C5A0
CONFIG_DPRINTF_ADDRESS=0x4C436704
CONFIG_ENVIRONMENT_SUPPORT=y
CONFIG_FASTBOOT_CONTINUE=0x4C42AEE8
CONFIG_FASTBOOT_FAIL_ADDRESS=0x4C429C18
CONFIG_FASTBOOT_INFO_ADDRESS=0x4C429B70
CONFIG_FASTBOOT_OKAY_ADDRESS=0x4C429DF4
CONFIG_FASTBOOT_PUBLISH_ADDRESS=0x4C4297FC
CONFIG_FASTBOOT_REGISTER_ADDRESS=0x4C4297C0
CONFIG_FRAMEBUFFER_ADDRESS=0x76C10000
CONFIG_FRAMEBUFFER_ALIGNMENT=64
CONFIG_FRAMEBUFFER_BPP=32
CONFIG_FRAMEBUFFER_HEIGHT=2400
CONFIG_FRAMEBUFFER_SUPPORT=n
CONFIG_FRAMEBUFFER_WIDTH=1080
CONFIG_FREE_ADDRESS=0x4C436B34
CONFIG_GET_ENV_ADDRESS=0x4C45231C
CONFIG_INFINIX_X670=y
CONFIG_INIT_STORAGE_ADDRESS=0x4C402640
CONFIG_INIT_STORAGE_CALLER=0x4C4028C2
CONFIG_LEGACY_LK=n
CONFIG_LK_LOG_STORE_ADDRESS=0x4C44B3CC
CONFIG_MALLOC_ADDRESS=0x4C43740C
CONFIG_MEDIATEK_MT6781=y
CONFIG_MTK_DETECT_KEY_ADDRESS=0x4C404410
CONFIG_PARTITION_GET_SIZE_BY_NAME_ADDRESS=0x4C451FF8
CONFIG_PARTITION_READ_ADDRESS=0x4C453174
CONFIG_PLATFORM_INIT_ADDRESS=0x4C402894
CONFIG_PLATFORM_INIT_CALLER=0x4C425108
CONFIG_SET_ENV_ADDRESS=0x4C452534
CONFIG_SPOOF_SUPPORT=y
CONFIG_STAGE1_SUPPORT=y
CONFIG_VIDEO_PRINTF_ADDRESS=0x4C4362E4
```

## configs/infinix/X6739_defconfig
```kconfig
CONFIG_APP_ADDRESS=0x4822DDE0
CONFIG_BOOTLOADER_BASE=0x48200000
CONFIG_BOOTLOADER_SIZE=0x12388C
CONFIG_CERT_BYPASS=y
CONFIG_BOOTMODE_ADDRESS=0x4830C5A0
CONFIG_DPRINTF_ADDRESS=0x4823BB74
CONFIG_ENVIRONMENT_SUPPORT=y
CONFIG_GET_ENV_ADDRESS=0
CONFIG_SET_ENV_ADDRESS=0
CONFIG_FASTBOOT_CONTINUE=0x4822FC14
CONFIG_FASTBOOT_FAIL_ADDRESS=0x4822E834
CONFIG_FASTBOOT_INFO_ADDRESS=0x4822E78C
CONFIG_FASTBOOT_OKAY_ADDRESS=0x4822EA10
CONFIG_FASTBOOT_PUBLISH_ADDRESS=0x4822E418
CONFIG_FASTBOOT_REGISTER_ADDRESS=0x4822E3DC
CONFIG_FRAMEBUFFER_SUPPORT=n
CONFIG_FREE_ADDRESS=0x4823BFA4
CONFIG_INFINIX_X6739=y
CONFIG_INIT_STORAGE_ADDRESS=0
CONFIG_INIT_STORAGE_CALLER=0
CONFIG_LEGACY_LK=n
CONFIG_LK_LOG_STORE=y
CONFIG_LK_LOG_STORE_ADDRESS=0x482518F0
CONFIG_MALLOC_ADDRESS=0x4823C870
CONFIG_MEDIATEK_MT6781=y
CONFIG_MTK_DETECT_KEY_ADDRESS=0
CONFIG_PARTITION_GET_SIZE_BY_NAME_ADDRESS=0
CONFIG_PARTITION_READ_ADDRESS=0x4825A19C
CONFIG_PLATFORM_INIT_ADDRESS=0x4820356C
CONFIG_PLATFORM_INIT_CALLER=0x48229C24
CONFIG_SPOOF_SUPPORT=y
CONFIG_STAGE1_SUPPORT=n
CONFIG_THREAD_CREATE_ADDRESS=0x4822A464
CONFIG_THREAD_RESUME_ADDRESS=0x4822A678
CONFIG_VIDEO_PRINTF_ADDRESS=0x4823B754
```

## configs/infinix/X6812_defconfig
```kconfig
CONFIG_APP_ADDRESS=0x4C42C474
CONFIG_APP_CALLER=0x4C429A28
CONFIG_BOOTLOADER_BASE=0x4C400000
CONFIG_BOOTLOADER_SIZE=0x108B0C
CONFIG_BOOTMODE_ADDRESS=0x4C50B590
CONFIG_FASTBOOT_FAIL_ADDRESS=0x4C42CE18
CONFIG_FASTBOOT_INFO_ADDRESS=0x4C42CD98
CONFIG_FASTBOOT_OKAY_ADDRESS=0x4C42D624
CONFIG_FASTBOOT_PUBLISH_ADDRESS=0x4C42CA24
CONFIG_FASTBOOT_REGISTER_ADDRESS=0x4C42C9E8
CONFIG_LK_LOG_STORE_ADDRESS=0x4C44BB3C
CONFIG_MTK_DETECT_KEY_ADDRESS=0x4C4054A0
CONFIG_PLATFORM_INIT_ADDRESS=0x4C403700
CONFIG_PLATFORM_INIT_CALLER=0x4C428384
CONFIG_VIDEO_PRINTF_ADDRESS=0x4C43858C
CONFIG_INFINIX_X6812=y
CONFIG_MEDIATEK_MT6768=y
CONFIG_FORCE_INJECT_ADDR=0x4C4CFCD0
```

## configs/infinix/X6815D_defconfig
```kconfig
CONFIG_APP_ADDRESS=0x4822BA94
CONFIG_APP_CALLER=0x48228FE4
CONFIG_BOOTLOADER_BASE=0x48200000
CONFIG_BOOTLOADER_PARTITION_NAME="lk"
CONFIG_BOOTLOADER_SIZE=0x14A8B8
CONFIG_BOOTMODE_ADDRESS=0x4834D5D4
CONFIG_DPRINTF_ADDRESS=0x482393D8
CONFIG_ENVIRONMENT_SUPPORT=y
CONFIG_FASTBOOT_CONTINUE_ADDRESS=0x4822D804
CONFIG_FASTBOOT_FAIL_ADDRESS=0x4822C454
CONFIG_FASTBOOT_INFO_ADDRESS=0x4822C3AC
CONFIG_FASTBOOT_OKAY_ADDRESS=0x4822C630
CONFIG_FASTBOOT_PUBLISH_ADDRESS=0x4822C038
CONFIG_FASTBOOT_REGISTER_ADDRESS=0x4822BFFC
CONFIG_FREE_ADDRESS=0x4823980C
CONFIG_GET_ENV_ADDRESS=0x48256734
CONFIG_INIT_STORAGE_ADDRESS=0x48203758
CONFIG_INIT_STORAGE_CALLER=0x482038A8
CONFIG_INFINIX_X6815D=y
CONFIG_LEGACY_LK=n
CONFIG_LK_LOG_STORE=y
CONFIG_LK_LOG_STORE_ADDRESS=0x4824EF14
CONFIG_MALLOC_ADDRESS=0x4823A1D0
CONFIG_MEDIATEK_MT6877=y
CONFIG_MTK_DETECT_KEY_ADDRESS=0x48205974
CONFIG_PARTITION_GET_SIZE_BY_NAME_ADDRESS=0x48255D8C
CONFIG_PARTITION_READ_ADDRESS=0x48257694
CONFIG_PLATFORM_INIT_ADDRESS=0x48203868
CONFIG_PLATFORM_INIT_CALLER=0x482278CE
CONFIG_SET_ENV_ADDRESS=0x4825694C
CONFIG_SPOOF_SUPPORT=y
CONFIG_STAGE1_SUPPORT=y
CONFIG_THREAD_CREATE_ADDRESS=0x48228114
CONFIG_THREAD_RESUME_ADDRESS=0x4822832C
CONFIG_THREAD_SUPPORT=y
CONFIG_VIDEO_PRINTF_ADDRESS=0x48238FB4
```

## configs/innioasis/y1_defconfig
```kconfig
CONFIG_APP_ADDRESS=0x80038208
CONFIG_BOOTLOADER_BASE=0x80020000
CONFIG_BOOTLOADER_SIZE=0x3D144
CONFIG_BOOTMODE_ADDRESS=0x8006041C
CONFIG_BOOTSTRAP2_ADDRESS=0x80036EF0
CONFIG_DPRINTF_ADDRESS=0x8003B31C
CONFIG_FASTBOOT_FAIL_ADDRESS=0x800384B0
CONFIG_FASTBOOT_INFO_ADDRESS=0x80038470
CONFIG_FASTBOOT_OKAY_ADDRESS=0x80038670
CONFIG_FASTBOOT_PUBLISH_ADDRESS=0x800382D4
CONFIG_FASTBOOT_REGISTER_ADDRESS=0x800382A0
CONFIG_FREE_ADDRESS=0x8003B614
CONFIG_INIT_STORAGE_ADDRESS=0x8002314C
CONFIG_INIT_STORAGE_CALLER=0x800206AE
CONFIG_LK_LOG_STORE=n
CONFIG_MALLOC_ADDRESS=0x8003BF54
CONFIG_MEDIATEK_MT6572=y
CONFIG_INNIOASIS_Y1=y
CONFIG_MTK_DETECT_KEY_ADDRESS=0x80029ED0
CONFIG_BOOTLOADER_PARTITION_NAME="UBOOT"
CONFIG_PLATFORM_INIT_CALLER=0x80036EF6
CONFIG_PLATFORM_INIT_ADDRESS=0x80020694
CONFIG_MT_PART_GET_DEVICE_ADDRESS=0x80022DF8
CONFIG_MT_PART_GET_PARTITION_ADDRESS=0x80022CBC
CONFIG_VIDEO_PRINTF_ADDRESS=0x8003B110
CONFIG_LEGACY_LK=y
# Doesn't work :(
CONFIG_STAGE1_SUPPORT=n
```

## configs/joyar/100071483_defconfig
```kconfig
CONFIG_APP_ADDRESS=0x56023E28
CONFIG_BOOTLOADER_BASE=0x56000000
CONFIG_BOOTLOADER_SIZE=0x91280
CONFIG_BOOTMODE_ADDRESS=0x560940E0
CONFIG_FASTBOOT_FAIL_ADDRESS=0x56024EC0
CONFIG_FASTBOOT_INFO_ADDRESS=0x56024E40
CONFIG_FASTBOOT_OKAY_ADDRESS=0x5602508C
CONFIG_FASTBOOT_PUBLISH_ADDRESS=0x56024B1C
CONFIG_FASTBOOT_REGISTER_ADDRESS=0x56024AE0
CONFIG_LK_LOG_STORE=n
CONFIG_MTK_DETECT_KEY_ADDRESS=0x56003908
CONFIG_PLATFORM_INIT_ADDRESS=0x56002374
CONFIG_PLATFORM_INIT_CALLER=0x56020B0C
CONFIG_VIDEO_PRINTF_ADDRESS=0x5602E9BC
CONFIG_JOYAR_100071483=y
CONFIG_MEDIATEK_MT8168=y
```

## configs/lamu_defconfig
```kconfig
CONFIG_APP_CALLER=0x4C427950
CONFIG_BOOTLOADER_BASE=0x4C400000
CONFIG_BOOTLOADER_SIZE=0x157AAC
CONFIG_FASTBOOT_FAIL_ADDRESS=0x4C42ABA8
CONFIG_FASTBOOT_INFO_ADDRESS=0x4C42AB28
CONFIG_FASTBOOT_OKAY_ADDRESS=0x4C42AD74
CONFIG_FASTBOOT_PUBLISH_ADDRESS=0x4C42A6D4
CONFIG_FASTBOOT_REGISTER_ADDRESS=0x4C42A698
CONFIG_LK_LOG_STORE_ADDRESS=0x4C4593F0
CONFIG_MTK_DETECT_KEY_ADDRESS=0x4C4054F8
CONFIG_PLATFORM_INIT_ADDRESS=0x4C403944
CONFIG_PLATFORM_INIT_CALLER=0x4C4262AC
CONFIG_VIDEO_PRINTF_ADDRESS=0x4C443730
CONFIG_MOTOROLA_LAMU=y
CONFIG_MEDIATEK_MT6768=y
```

## configs/lava/LXX503_defconfig
```kconfig
CONFIG_APP_ADDRESS=0x482273B8
CONFIG_BOOTLOADER_BASE=0x48200000
CONFIG_BOOTLOADER_SIZE=0xE03A0
CONFIG_BOOTMODE_ADDRESS=0x482E3598
CONFIG_DPRINTF_ADDRESS=0x48234CB8
CONFIG_ENVIRONMENT_SUPPORT=y
CONFIG_FASTBOOT_FAIL_ADDRESS=0x48227E74
CONFIG_FASTBOOT_INFO_ADDRESS=0x48227DF4
CONFIG_FASTBOOT_OKAY_ADDRESS=0x48228040
CONFIG_FASTBOOT_PUBLISH_ADDRESS=0x48227A80
CONFIG_FASTBOOT_REGISTER_ADDRESS=0x48227A44
CONFIG_FREE_ADDRESS=0x482350EC
CONFIG_GET_ENV_ADDRESS=0x48250864
CONFIG_INIT_STORAGE_ADDRESS=0x482025DC
CONFIG_INIT_STORAGE_CALLER=0x48202720
CONFIG_LAVA_LXX503=y
CONFIG_LEGACY_LK=n
CONFIG_LK_LOG_STORE_ADDRESS=0x482499D4
CONFIG_MALLOC_ADDRESS=0x48235AB0
CONFIG_MEDIATEK_MT6833=y
CONFIG_MTK_DETECT_KEY_ADDRESS=0x4820448C
CONFIG_PARTITION_GET_SIZE_BY_NAME_ADDRESS=0x48250540
CONFIG_PARTITION_READ_ADDRESS=0x482516C4
CONFIG_PLATFORM_INIT_ADDRESS=0x482026EC
CONFIG_PLATFORM_INIT_CALLER=0x482233A6
CONFIG_SET_ENV_ADDRESS=0x48250A7C
CONFIG_SPOOF_SUPPORT=y
CONFIG_THREAD_CREATE_ADDRESS=0x48223B68
CONFIG_VIDEO_PRINTF_ADDRESS=0x482349C4
```

## configs/lava/T81N_defconfig
```kconfig
CONFIG_APP_ADDRESS=0x48025DA0
CONFIG_BOOTLOADER_BASE=0x48000000
CONFIG_BOOTLOADER_SIZE=0xBFBFC
CONFIG_DPRINTF_ADDRESS=0x48031DF8
CONFIG_FASTBOOT_FAIL_ADDRESS=0x48026838
CONFIG_FASTBOOT_INFO_ADDRESS=0x480267DC
CONFIG_FASTBOOT_OKAY_ADDRESS=0x48026A04
CONFIG_FASTBOOT_PUBLISH_ADDRESS=0x480264E8
CONFIG_FASTBOOT_REGISTER_ADDRESS=0x480264AC
CONFIG_FREE_ADDRESS=0x480321B8
CONFIG_INIT_STORAGE_CALLER=0x48002B70
CONFIG_LK_LOG_STORE_ADDRESS=0x480432E4
CONFIG_MALLOC_ADDRESS=0x480329FC
CONFIG_MTK_DETECT_KEY_ADDRESS=0x48004A78
CONFIG_PARTITION_READ_ADDRESS=0x4804B328
CONFIG_PLATFORM_INIT_ADDRESS=0x48002B40
CONFIG_THREAD_CREATE_ADDRESS=0x48022B1C
CONFIG_THREAD_RESUME_ADDRESS=0x48022D30
CONFIG_LAVA_T81N=y
CONFIG_MEDIATEK_MT6761=y
CONFIG_BOOTMODE_ADDRESS=0x480c25dc
CONFIG_PLATFORM_INIT_CALLER=0x48022360
CONFIG_VIDEO_PRINTF_ADDRESS=0x48031b10
```

## configs/lenovo/akita_row_call_defconfig
```kconfig
CONFIG_APP_ADDRESS=0x48022318
CONFIG_APP_CALLER=0x4801FD34
CONFIG_BOOTLOADER_BASE=0x48000000
CONFIG_BOOTLOADER_SIZE=0xB8694
CONFIG_BOOTMODE_ADDRESS=0x480BB5F4
CONFIG_FASTBOOT_FAIL_ADDRESS=0x48022D00
CONFIG_FASTBOOT_INFO_ADDRESS=0x48022CA4
CONFIG_FASTBOOT_OKAY_ADDRESS=0x48022ECC
CONFIG_FASTBOOT_PUBLISH_ADDRESS=0x480229B0
CONFIG_FASTBOOT_REGISTER_ADDRESS=0x48022974
CONFIG_LK_LOG_STORE_ADDRESS=0x48040580
CONFIG_MEDIATEK_MT6761=y
CONFIG_MTK_DETECT_KEY_ADDRESS=0x480046A4
CONFIG_LENOVO_AKITA_ROW_CALL=y
CONFIG_PLATFORM_INIT_ADDRESS=0x48002940
CONFIG_PLATFORM_INIT_CALLER=0x4801E610
CONFIG_VIDEO_PRINTF_ADDRESS=0x4802F064
```

## configs/lenovo/amar_row_lte_defconfig
```kconfig
CONFIG_APP_ADDRESS=0x48022600
CONFIG_BOOTLOADER_BASE=0x48000000
CONFIG_BOOTLOADER_SIZE=0xBCF9C
CONFIG_BOOTMODE_ADDRESS=0x480B45F0
CONFIG_DPRINTF_ADDRESS=0x4802D140
CONFIG_ENVIRONMENT_SUPPORT=y
CONFIG_FASTBOOT_FAIL_ADDRESS=0x48022ED0
CONFIG_FASTBOOT_INFO_ADDRESS=0x48022E74
CONFIG_FASTBOOT_OKAY_ADDRESS=0x4802309C
CONFIG_FASTBOOT_PUBLISH_ADDRESS=0x48022B80
CONFIG_FASTBOOT_REGISTER_ADDRESS=0x48022B44
CONFIG_FREE_ADDRESS=0x4802D500
CONFIG_GET_ENV_ADDRESS=0x48044E3C
CONFIG_INIT_STORAGE_ADDRESS=0x48002760
CONFIG_INIT_STORAGE_CALLER=0x4800297C
CONFIG_LENOVO_AMAR_ROW_LTE=y
CONFIG_LK_LOG_STORE_ADDRESS=0x4803DCF8
CONFIG_MALLOC_ADDRESS=0x4802DD44
CONFIG_MEDIATEK_MT6762=y
CONFIG_MTK_DETECT_KEY_ADDRESS=0x48004A10
CONFIG_PARTITION_GET_SIZE_BY_NAME_ADDRESS=0x48044B8C
CONFIG_PARTITION_READ_ADDRESS=0x48045D40
CONFIG_PLATFORM_INIT_ADDRESS=0x4800294C
CONFIG_PLATFORM_INIT_CALLER=0x4801E8A8
CONFIG_SET_ENV_ADDRESS=0x480450F8
CONFIG_SPOOF_SUPPORT=y
CONFIG_STAGE1_SUPPORT=y
CONFIG_VIDEO_PRINTF_ADDRESS=0x4802CE50
```

## configs/lenovo/amar_row_wifi_defconfig
```kconfig
CONFIG_APP_ADDRESS=0x48022D58
CONFIG_BOOTLOADER_BASE=0x48000000
CONFIG_BOOTLOADER_SIZE=0xBCEAC
CONFIG_FASTBOOT_FAIL_ADDRESS=0x480237E0
CONFIG_FASTBOOT_INFO_ADDRESS=0x48023760
CONFIG_FASTBOOT_OKAY_ADDRESS=0x480239AC
CONFIG_FASTBOOT_PUBLISH_ADDRESS=0x480233EC
CONFIG_FASTBOOT_REGISTER_ADDRESS=0x480233B0
CONFIG_LK_LOG_STORE_ADDRESS=0x4804091C
CONFIG_PLATFORM_INIT_ADDRESS=0x4800295C
CONFIG_PLATFORM_INIT_CALLER=0x4801EC40
CONFIG_VIDEO_PRINTF_ADDRESS=0x4802E66C
CONFIG_LENOVO_AMAR_ROW_WIFI=y
CONFIG_MEDIATEK_MT6762=y
CONFIG_BOOTMODE_ADDRESS=0x480BF5F0
CONFIG_MTK_DETECT_KEY_ADDRESS=0x4802E95C
```

## configs/m3note_defconfig
```kconfig
CONFIG_APP_ADDRESS=0x4601D098
CONFIG_APP_CALLER=0x4601BEC8
CONFIG_BOOTLOADER_BASE=0x46000000
CONFIG_BOOTLOADER_SIZE=0xD9A0C
CONFIG_BOOTMODE_ADDRESS=0x46060500
CONFIG_FASTBOOT_REGISTER_ADDRESS=0x4601D4E0
CONFIG_FASTBOOT_PUBLISH_ADDRESS=0x4601D4A0
CONFIG_FASTBOOT_FAIL_ADDRESS=0x4601D6E8
CONFIG_FASTBOOT_INFO_ADDRESS=0x4601D6A0
CONFIG_FASTBOOT_OKAY_ADDRESS=0x4601D870
CONFIG_LK_LOG_STORE=n
CONFIG_MTK_DETECT_KEY_ADDRESS=0x56005538
CONFIG_MEDIATEK_MT6750=y
CONFIG_MEIZU_M3NOTE=y
CONFIG_MTK_DETECT_KEY_ADDRESS=0x46004894
CONFIG_PLATFORM_INIT_ADDRESS=0x46001A7C
CONFIG_PLATFORM_INIT_CALLER=0x4601B206
CONFIG_VIDEO_PRINTF_ADDRESS=0x46023640
```
